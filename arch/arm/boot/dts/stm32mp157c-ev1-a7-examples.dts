// SPDX-License-Identifier: (GPL-2.0-or-later OR BSD-3-Clause)
/*
 * Copyright (C) STMicroelectronics 2022 - All Rights Reserved
 * Author: Alexandre Torgue <alexandre.torgue@foss.st.com> for STMicroelectronics.
 */

/dts-v1/;

#include "stm32mp157c-ev1.dts"
#include <dt-bindings/input/input.h>

/ {
	model = "STMicroelectronics STM32MP157C-EV1 configured to run Linux A7 examples";
	compatible = "st,stm32mp157c-ev1-a7-examples", "st,stm32mp157c-ev1", "st,stm32mp157c-ed1", "st,stm32mp157";

	test_keys {
		compatible = "gpio-keys";
		autorepeat;
		status = "okay";
		/* gpio needs vdd core in retention for wakeup */
		power-domains = <&pd_core_ret>;

		button-1 {
			label = "PA13";
			linux,code = <BTN_1>;
			gpios = <&gpioa 13 (GPIO_ACTIVE_LOW | GPIO_PULL_UP)>;
			status = "okay";
			wakeup-source;
		};
	};
};

&usart3 {
	status = "okay";
};
