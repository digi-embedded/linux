// SPDX-License-Identifier: (GPL-2.0-or-later OR BSD-3-Clause)
/*
 * Copyright (C) STMicroelectronics 2022 - All Rights Reserved
 * Author: Alexandre Torgue <alexandre.torgue@foss.st.com> for STMicroelectronics.
 */

/dts-v1/;

#include "stm32mp157a-ev1.dts"
#include <dt-bindings/input/input.h>

/ {
	model = "STMicroelectronics STM32MP157A-EV1 configured to run Linux A7 examples";
	compatible = "st,stm32mp157a-ev1-a7-examples", "st,stm32mp157a-ev1", "st,stm32mp157a-ed1", "st,stm32mp157";
};

&usart3 {
	status = "okay";
};
