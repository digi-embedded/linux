/*
 * Copyright 2013 Digi International, Inc.
 *
 * The code contained herein is licensed under the GNU General Public
 * License. You may obtain a copy of the GNU General Public License
 * Version 2 or later at the following locations:
 *
 * http://www.opensource.org/licenses/gpl-license.html
 * http://www.gnu.org/copyleft/gpl.html
 */

/ {
	ahb@80080000 {
		mac1: ethernet@800f4000 {
			digi,gpio-link-led = <&gpio3 13 1>;
			digi,gpio-act-led = <&gpio3 12 1>;
		};
	};
};
