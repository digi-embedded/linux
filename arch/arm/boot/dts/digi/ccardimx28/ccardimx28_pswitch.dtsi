/*
 * Copyright 2013 Digi International, Inc.
 *
 * The code contained herein is licensed under the GNU General Public
 * License. You may obtain a copy of the GNU General Public License
 * Version 2 or later at the following locations:
 *
 * http://www.opensource.org/licenses/gpl-license.html
 * http://www.gnu.org/copyleft/gpl.html
 */

/ {
	apb@80000000 {
		apbx@80040000 {
			power@80044000 {
				compatible = "digi,mxs-pswitch";
				status = "okay";
                                linux,code = <116>; /* KEY_POWER*/
                                interrupts = <6>; /*IRQ_VDD5V  */
			};
		};
	};
};
