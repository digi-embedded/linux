/*
 * Copyright 2013 Digi International, Inc.
 *
 * The code contained herein is licensed under the GNU General Public
 * License. You may obtain a copy of the GNU General Public License
 * Version 2 or later at the following locations:
 *
 * http://www.opensource.org/licenses/gpl-license.html
 * http://www.gnu.org/copyleft/gpl.html
 */

/ {
	spi1 {
		spidev@0 {
			compatible = "spidev";
			reg = <0>;
			spi-max-frequency = <4000000>;
			status = "okay";
		};
	};
};
