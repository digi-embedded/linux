// SPDX-License-Identifier: (GPL-2.0+ OR BSD-3-Clause)
/*
 * Copyright (C) STMicroelectronics 2022 - All Rights Reserved
 * Author: Alexandre Torgue <alexandre.torgue@foss.st.com> for STMicroelectronics.
 */

/dts-v1/;

#include "stm32mp135d-dk.dts"

/ {
	model = "STMicroelectronics STM32MP135D-DK configured to run Linux A7 examples";
	compatible = "st,stm32mp135d-dk-a7-examples", "st,stm32mp135d-dk", "st,stm32mp135";
};

&timers4 {
	status = "okay";
};

&timers8 {
	status = "okay";
};
