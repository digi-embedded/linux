// SPDX-License-Identifier: (GPL-2.0+ OR BSD-3-Clause)
/*
 * Copyright (C) STMicroelectronics 2019 - All Rights Reserved
 * Author: Alexandre Torgue <alexandre.torgue@st.com> for STMicroelectronics.
 */
/dts-v1/;

#include "stm32mp157f-ed1.dts"
#include "stm32mp15xx-evx.dtsi"
#include <dt-bindings/input/input.h>

/ {
	model = "STMicroelectronics STM32MP157F eval daughter on eval mother";
	compatible = "st,stm32mp157f-ev1", "st,stm32mp157f-ed1", "st,stm32mp157";

	chosen {
		stdout-path = "serial0:115200n8";
	};

	aliases {
		serial0 = &uart4;
		serial1 = &usart3;
		ethernet0 = &ethernet0;
	};
};
