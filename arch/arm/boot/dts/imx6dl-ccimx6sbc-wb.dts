/*
 * Copyright 2015 Digi International, Inc.
 *
 * The code contained herein is licensed under the GNU General Public
 * License. You may obtain a copy of the GNU General Public License
 * Version 2 or later at the following locations:
 *
 * http://www.opensource.org/licenses/gpl-license.html
 * http://www.gnu.org/copyleft/gpl.html
 */

/dts-v1/;
/* ConnectCore 6 (Duallite wireless/bluetooth variant) */
#include "imx6dl-ccimx6-wb.dtsi"
/* ConnectCore 6 SBC carrier board */
#include "imx6dl-ccimx6sbc.dtsi"
