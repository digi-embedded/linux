// SPDX-License-Identifier: (GPL-2.0-only OR BSD-3-Clause)
/*
 * Copyright (C) STMicroelectronics 2022 - All Rights Reserved
 * Author: Alexandre Torgue <alexandre.torgue@foss.st.com> for STMicroelectronics.
 */

/dts-v1/;

#include "stm32mp157d-dk1.dts"

/ {
	model = "STMicroelectronics STM32MP157D-DK1 configured to run Linux A7 examples";
	compatible = "st,stm32mp157d-dk1-a7-examples", "st,stm32mp157d-dk1", "st,stm32mp157";
};

&i2c5 {
	status = "okay";
};

&uart7 {
	status = "okay";
};

&usart3 {
	status = "okay";
};
