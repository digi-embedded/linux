/dts-v1/;
/plugin/;

/ {
	/* Enable the LVDS bridge */
	fragment@0 {
		target-path = "/";
		__overlay__ {
			overlay-description = "DVK: LVDS display";
		};
	};

	fragment@1 {
		target = <&dsi_lvds_bridge>;
		__overlay__ {
			status = "okay";
		};
	};

	/* Disable the HDMI bridge */
	fragment@2 {
		target = <&lt_bridge>;
		__overlay__ {
			status = "disabled";
		};
	};
};
