/*
 * Copyright 2022-2025, Digi International Inc.
 *
 * Permission to use, copy, modify, and/or distribute this software for any
 * purpose with or without fee is hereby granted, provided that the above
 * copyright notice and this permission notice appear in all copies.
 * THE SOFTWARE IS PROVIDED "AS IS" AND THE AUTHOR DISCLAIMS ALL WARRANTIES
 * WITH REGARD TO THIS SOFTWARE INCLUDING ALL IMPLIED WARRANTIES OF
 * MERCHANTABILITY AND FITNESS. IN NO EVENT SHALL THE AUTHOR BE LIABLE FOR
 * ANY SPECIAL, DIRECT, INDIRECT, OR CONSEQUENTIAL DAMAGES OR ANY DAMAGES
 * WHATSOEVER RESULTING FROM LOSS OF USE, DATA OR PROFITS, WHETHER IN AN
 * ACTION OF CONTRACT, NEGLIGENCE OR OTHER TORTIOUS ACTION, ARISING OUT OF
 * OR IN CONNECTION WITH THE USE OR PERFORMANCE OF THIS SOFTWARE.
 */

/dts-v1/;
/plugin/;
#include <dt-bindings/gpio/gpio.h>

/ {
	/* Add the "wireless" node so the wifi driver gets loaded */
	fragment@0 {
		target-path = "/";
		__overlay__ {
			overlay-description = "SOM: Wi-Fi";
			wireless {
				/* U-Boot will fill in the MAC address here */
			};
		};
	};

	/* Enable USDHC3 (Wireless) */
	fragment@1 {
		target = <&usdhc3>;
		__overlay__ {
			pinctrl-names = "default", "state_100mhz", "state_200mhz", "sleep";
			pinctrl-0 = <&pinctrl_usdhc3>;
			pinctrl-1 = <&pinctrl_usdhc3_100mhz>;
			pinctrl-2 = <&pinctrl_usdhc3_200mhz>;
			pinctrl-3 = <&pinctrl_usdhc3>;
			mmc-pwrseq = <&wlan_pwrseq>;
			bus-width = <4>;
			non-removable;
			wakeup-source;
			status = "okay";
		};
	};

	/* Enable WLAN PWR control */
	fragment@2 {
		target-path = "/";
		__overlay__ {
			wlan_pwrseq: wlan-pwrseq {
				compatible = "mmc-pwrseq-simple";
				pinctrl-names = "default";
				pinctrl-0 = <&pinctrl_wlan_pdn>;
				/* WLAN_PDn */
				reset-gpios = <&gpio2 7 GPIO_ACTIVE_LOW>;
				status = "okay";
			};
		};
	};
};
