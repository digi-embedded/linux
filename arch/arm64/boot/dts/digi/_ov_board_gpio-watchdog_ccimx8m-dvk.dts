/*
 * Copyright 2021 Digi International Inc.
 *
 * Permission to use, copy, modify, and/or distribute this software for any
 * purpose with or without fee is hereby granted, provided that the above
 * copyright notice and this permission notice appear in all copies.
 * THE SOFTWARE IS PROVIDED "AS IS" AND THE AUTHOR DISCLAIMS ALL WARRANTIES
 * WITH REGARD TO THIS SOFTWARE INCLUDING ALL IMPLIED WARRANTIES OF
 * MERCHANTABILITY AND FITNESS. IN NO EVENT SHALL THE AUTHOR BE LIABLE FOR
 * ANY SPECIAL, DIRECT, INDIRECT, OR CONSEQUENTIAL DAMAGES OR ANY DAMAGES
 * WHATSOEVER RESULTING FROM LOSS OF USE, DATA OR PROFITS, WHETHER IN AN
 * ACTION OF CONTRACT, NEGLIGENCE OR OTHER TORTIOUS ACTION, ARISING OUT OF
 * OR IN CONNECTION WITH THE USE OR PERFORMANCE OF THIS SOFTWARE.
 */

/dts-v1/;
/plugin/;

/ {
	fragment@0 {
		target-path = "/";
		__overlay__ {
			overlay-description = "DVK: MCA GPIO Watchdog";
		};
	};

	/* Enable mca gpio-wdt */
	fragment@1 {
		target = <&gpio_wdt>;
		__overlay__ {
			status = "okay";
		};
	};

	/* Configure USER1 button to reset the board if not at level-high for 2s */
	fragment@2 {
		target = <&gpio_wdt0>;
		__overlay__ {
			status = "okay";
			full-reset;
			no-way-out;
			/* mode; one of: toggle, level-high, level-low */
			mode = "level-high";
			mca-io-number = <10>;
			timeout-sec = <2>;
		};
	};
};
