// SPDX-License-Identifier: (GPL-2.0+ OR MIT)
/*
 * Copyright 2026 Digi International Inc.
 */

/dts-v1/;
/plugin/;

/ {
	fragment@0 {
		target-path = "/";
		__overlay__ {
			overlay-description = "DVK: MCA GPIO Watchdog";
		};
	};

	/* Enable mca gpio-wdt */
	fragment@1 {
		target = <&gpio_wdt>;
		__overlay__ {
			status = "okay";
		};
	};

	/* Configure mca-io 2 to reset the board if not at level-high for 2s */
	fragment@2 {
		target = <&gpio_wdt0>;
		__overlay__ {
			status = "okay";
			full-reset;
			no-way-out;
			/* mode; one of: toggle, level-high, level-low */
			mode = "level-high";
			mca-io-number = <2>;
			timeout-sec = <2>;
		};
	};
};
