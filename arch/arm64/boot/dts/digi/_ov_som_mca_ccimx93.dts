/*
 * Copyright 2023 Digi International Inc.
 *
 * Permission to use, copy, modify, and/or distribute this software for any
 * purpose with or without fee is hereby granted, provided that the above
 * copyright notice and this permission notice appear in all copies.
 * THE SOFTWARE IS PROVIDED "AS IS" AND THE AUTHOR DISCLAIMS ALL WARRANTIES
 * WITH REGARD TO THIS SOFTWARE INCLUDING ALL IMPLIED WARRANTIES OF
 * MERCHANTABILITY AND FITNESS. IN NO EVENT SHALL THE AUTHOR BE LIABLE FOR
 * ANY SPECIAL, DIRECT, INDIRECT, OR CONSEQUENTIAL DAMAGES OR ANY DAMAGES
 * WHATSOEVER RESULTING FROM LOSS OF USE, DATA OR PROFITS, WHETHER IN AN
 * ACTION OF CONTRACT, NEGLIGENCE OR OTHER TORTIOUS ACTION, ARISING OUT OF
 * OR IN CONNECTION WITH THE USE OR PERFORMANCE OF THIS SOFTWARE.
 */

/dts-v1/;
/plugin/;

/ {
	fragment@0 {
		target-path = "/";
		__overlay__ {
			overlay-description = "SOM: MCA";
		};
	};

	/* Enable Micro Controller Assit */
	fragment@1 {
		target = <&mca_cc93>;
		__overlay__ {
			status = "okay";
		};
	};

	/* Disable cpu power key */
	fragment@2 {
		target = <&bbnsm_pwrkey>;
		__overlay__ {
			status = "disabled";
		};
	};

	/* Configure PMIC IRQ to be shared with MCA */
	fragment@3 {
		target = <&pmic_cc93>;
		__overlay__ {
			interrupt-flags = <0x00002088>;
		};
	};
};
