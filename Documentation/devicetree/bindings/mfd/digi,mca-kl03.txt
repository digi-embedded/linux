## Documentation/devicetree/bindings/perf/stm32-ddrperfm-pmu.yaml
```yaml
# SPDX-License-Identifier: (GPL-2.0-only OR BSD-2-Clause)
%YAML 1.2
---
$id: http://devicetree.org/schemas/perf/stm32-ddrperfm-pmu.yaml#
$schema: http://devicetree.org/meta-schemas/core.yaml#

maintainers:
  - Clément Le Goffic <clement.legoffic@foss.st.com

title: STMicroelectronics STM32 DDR Performance Monitor (DDRPERFM)

properties:
  compatible:
    enum:
      - st,stm32-ddr-pmu
      - st,stm32mp25-ddr-pmu

  reg:
    maxItems: 1

  clocks:
    description: Reference clock for the DDR Performance Monitor
    maxItems: 1

  resets:
    description: Reset control for the DDR Performance Monitor
    maxItems: 1

  access-controllers:
    minItems: 1
    maxItems: 2

  st,dram-type:
    description: type of DRAM on the associated memory controller
    $ref: /schemas/types.yaml#/definitions/uint32
    enum:
      - 0 # LPDDR4
      - 1 # LPDDR3
      - 2 # DDR4
      - 3 # DDR3

required:
  - compatible
  - reg

allOf:
  - if:
      properties:
        compatible:
          contains:
            const: st,stm32-ddr-pmu
    then:
      required:
        - clocks
        - resets

  - if:
      properties:
        compatible:
          contains:
            const: st,stm32mp25-ddr-pmu
    then:
      required:
        - access-controllers
        - st,dram-type

additionalProperties: false

examples:
  - |
    perf@48041000 {
      compatible = "st,stm32mp25-ddr-pmu";
      reg = <0x48041000 0x400>;
      access-controllers = <&rcc 104>;
      st,dram-type = <2>;
      status = "disabled";
    };

  - |
    #include <dt-bindings/clock/st,stm32mp21-rcc.h>
    #include <dt-bindings/reset/st,stm32mp21-rcc.h>

    / {
      #address-cells = <2>;
      #size-cells = <2>;

      soc0: soc@0 {
        compatible = "simple-bus";
        #address-cells = <1>;
        #size-cells = <2>;
        interrupt-parent = <&intc>;
        ranges = <0x0 0x0 0x0 0x0 0x80000000>;
        dma-ranges = <0x0 0x0 0x80000000 0x1 0x0>;

        perf@480c0000 {
          compatible = "st,stm32mp25-ddr-pmu";
          reg = <0x480c0000 0x0 0x400>;
          clocks = <&rcc CK_BUS_DDRPERFM>;
          resets = <&rcc DDRPERFM_R>;
          access-controllers = <&rifsc 67>;
          st,dram-type = <0>;
          status = "disabled";
        };
      };
    };
...
```

## Documentation/devicetree/bindings/phy/st,stm32-combophy.yaml
```yaml
# SPDX-License-Identifier: (GPL-2.0 OR BSD-2-Clause)
%YAML 1.2
---
$id: http://devicetree.org/schemas/phy/st,stm32-combophy.yaml#
$schema: http://devicetree.org/meta-schemas/core.yaml#

title: STMicroelectronics STM32MP25 USB3/PCIe ComboPHY binding.

maintainers:
  - Christian Bruel <christian.bruel@foss.st.com>

description: |
  Single lane PHY shared (exclusive) between the USB3 and PCIe controllers.
  Supports 5Gbit/s for USB3 and PCIe gen2 or 2.5Gbit/s for PCIe gen1.

properties:
  compatible:
    const: st,stm32mp25-combophy

  reg:
    maxItems: 1

  st,syscfg:
    $ref: /schemas/types.yaml#/definitions/phandle-array
    description: Phandle to the SYSCON entry required for configuring PCIe
      or USB3.

  "#phy-cells":
    const: 1
    description: |
      The cells contain the following arguments.

      - description: The PHY type
          enum:
            - PHY_TYPE_USB3
            - PHY_TYPE_PCIE

  clocks:
    anyOf:
      - description: apb-clk Bus clock mandatory to access registers.
      - description: ker-clk Internal RCC reference clock for USB3 or PCIe
      - description: pad-clk Optional on board clock input for PCIe only. Typically an
                     external 100Mhz oscillator wired on dedicated CLKIN pad. Used as reference
                     clock input instead of the ker-clk

  clock-names:
    oneOf:
      - items:
          - const: apb-clk
          - const: ker-clk

      - items:
          - const: apb-clk
          - const: ker-clk
          - const: pad-clk

  resets:
    maxItems: 1

  reset-names:
    const: phy-rst

  st,ssc-on:
    type: boolean
    description:
      A boolean property whose presence indicates that the SSC for common clock
      needs to be set.

required:
  - compatible
  - reg
  - st,syscfg
  - '#phy-cells'
  - resets
  - reset-names
  - clocks
  - clock-names

additionalProperties: false

examples:
  - |
    // Example 1: Combophy configured to use internal reference clock
    #include <dt-bindings/clock/stm32mp25-clks.h>
    #include <dt-bindings/reset/stm32mp25-resets.h>

    combophy_internal: phy@480c0000 {
              compatible = "st,stm32mp25-combophy";
              reg = <0x480c0000 0x1000>;
              #phy-cells = <1>;
              clocks = <&rcc CK_BUS_USB3PCIEPHY>, <&rcc CK_KER_USB3PCIEPHY>;
              clock-names = "apb-clk", "ker-clk";
              resets = <&rcc USB3PCIEPHY_R>;
              reset-names = "phy-rst";
              st,syscfg = <&syscfg>;
    };

  - |
    // Example 2: Combophy configured to use extrenal 100MHz reference clock
    // on CLKIN pad for PCIe
    #include <dt-bindings/clock/stm32mp25-clks.h>
    #include <dt-bindings/reset/stm32mp25-resets.h>

    clocks {
        pad_clk: pad-clk {
                #clock-cells = <0>;
                compatible = "fixed-clock";
                clock-frequency = <100000000>;
        };
    };

    combophy_pad: phy@480c0000 {
              compatible = "st,stm32mp25-combophy";
              reg = <0x480c0000 0x1000>;
              #phy-cells = <1>;
              clocks = <&rcc CK_BUS_USB3PCIEPHY>, <&rcc CK_KER_USB3PCIEPHY>, <&pad_clk>;
              clock-names = "apb-clk", "ker-clk", "pad-clk";
              resets = <&rcc USB3PCIEPHY_R>;
              reset-names = "phy-rst";
              st,syscfg = <&syscfg>;
    };
...
```

## Documentation/devicetree/bindings/pinctrl/fsl,imx8mn-pinctrl.txt
```
* Freescale IMX8MN IOMUX Controller

Please refer to fsl,imx-pinctrl.txt and pinctrl-bindings.txt in this directory
for common binding part and usage.

Required properties:
- compatible: "fsl,imx8mn-iomuxc"
- reg: should contain the base physical address and size of the iomuxc
  registers.

Required properties in sub-nodes:
- fsl,pins: each entry consists of 6 integers and represents the mux and config
  setting for one pin.  The first 5 integers <mux_reg conf_reg input_reg mux_val
  input_val> are specified using a PIN_FUNC_ID macro, which can be found in
  <include/dt-bindings/pinctrl/pins-imx8mn.h>. The last integer CONFIG is
  the pad setting value like pull-up on this pin. Please refer to i.MX8M Nano
  Reference Manual for detailed CONFIG settings.

CONFIG bits definition:
PAD_CTL_PE                      (1 << 8)
PAD_CTL_HYS                     (1 << 7)
PAD_CTL_PUE                     (1 << 6)
PAD_CTL_ODE                     (1 << 5)
PAD_CTL_SRE_SLOW                (0 << 4)
PAD_CTL_SRE_FAST                (1 << 4)
PAD_CTL_DSE_X1                  (0 << 1)
PAD_CTL_DSE_X4                  (1 << 1)
PAD_CTL_DSE_X2                  (2 << 1)
PAD_CTL_DSE_X6                  (3 << 1)

Examples:

&uart1 {
	pinctrl-names = "default";
	pinctrl-0 = <&pinctrl_uart1>;
};

iomuxc: pinctrl@30330000 {
	compatible = "fsl,imx8mn-iomuxc";
	reg = <0x0 0x30330000 0x0 0x10000>;

	pinctrl_uart1: uart1grp {
		fsl,pins = <
			MX8MN_IOMUXC_UART1_RXD_UART1_DCE_RX	0x140
			MX8MN_IOMUXC_UART1_TXD_UART1_DCE_TX	0x140
			MX8MN_IOMUXC_UART3_RXD_UART1_DCE_CTS_B	0x140
			MX8MN_IOMUXC_UART3_TXD_UART1_DCE_RTS_B	0x140
			MX8MN_IOMUXC_SD1_DATA4_GPIO2_IO6	0x19
		>;
	};
};
```

## Documentation/devicetree/bindings/pinctrl/fsl,imx8mn-pinctrl.yaml
```yaml
# SPDX-License-Identifier: GPL-2.0
%YAML 1.2
---
$id: http://devicetree.org/schemas/pinctrl/fsl,imx8mn-pinctrl.yaml#
$schema: http://devicetree.org/meta-schemas/core.yaml#

title: Freescale IMX8MN IOMUX Controller

maintainers:
  - Anson Huang <Anson.Huang@nxp.com>

description:
  Please refer to fsl,imx-pinctrl.txt and pinctrl-bindings.txt in this directory
  for common binding part and usage.

properties:
  compatible:
    const: fsl,imx8mn-iomuxc

  reg:
    maxItems: 1

# Client device subnode's properties
patternProperties:
  'grp$':
    type: object
    description:
      Pinctrl node's client devices use subnodes for desired pin configuration.
      Client device subnodes use below standard properties.

    properties:
      fsl,pins:
        description:
          each entry consists of 6 integers and represents the mux and config
          setting for one pin. The first 5 integers <mux_reg conf_reg input_reg
          mux_val input_val> are specified using a PIN_FUNC_ID macro, which can
          be found in <arch/arm64/boot/dts/freescale/imx8mn-pinfunc.h>. The last
          integer CONFIG is the pad setting value like pull-up on this pin. Please
          refer to i.MX8M Nano Reference Manual for detailed CONFIG settings.

          CONFIG bits definition:
            PAD_CTL_PE                      (1 << 8)
            PAD_CTL_HYS                     (1 << 7)
            PAD_CTL_PUE                     (1 << 6)
            PAD_CTL_ODE                     (1 << 5)
            PAD_CTL_SRE_SLOW                (0 << 4)
            PAD_CTL_SRE_FAST                (1 << 4)
            PAD_CTL_DSE_X1                  (0 << 1)
            PAD_CTL_DSE_X4                  (1 << 1)
            PAD_CTL_DSE_X2                  (2 << 1)
            PAD_CTL_DSE_X6                  (3 << 1)

        $ref: /schemas/types.yaml#/definitions/uint32-matrix
        items:
          items:
            - description: |
                "mux_reg" indicates the offset of mux register.
            - description: |
                "conf_reg" indicates the offset of pad configuration register.
            - description: |
                "input_reg" indicates the offset of select input register.
            - description: |
                "mux_val" indicates the mux value to be applied.
            - description: |
                "input_val" indicates the select input value to be applied.
            - description: |
                "pad_setting" indicates the pad configuration value to be applied.

    required:
      - fsl,pins

    additionalProperties: false

allOf:
  - $ref: "pinctrl.yaml#"

required:
  - compatible
  - reg

additionalProperties: false

examples:
  # Pinmux controller node
  - |
    iomuxc: pinctrl@30330000 {
        compatible = "fsl,imx8mn-iomuxc";
        reg = <0x30330000 0x10000>;

        pinctrl_uart2: uart2grp {
            fsl,pins =
                <0x23C 0x4A4 0x4FC 0x0 0x0	0x140>,
                <0x240 0x4A8 0x000 0x0 0x0	0x140>;
        };
    };

...
```

## Documentation/devicetree/bindings/pwm/digi,mca-pwm.txt
```
Digi ConnectCore SOMs Micro Controller Assist PWM

Required properties:
	- compatible: must be "digi,mca-pwm"
	- #address-cells: must be 1
	- #size-cells: must be 0

	  The child nodes of this node represent the PWM controllers, this
	  means, the pwmchips. If the nodes are not present no pwmchips will be
	  added to the system.

	  The properties of the PWM nodes are the following:

		Required properties:
			* reg: index of the MCA PWM controller.
			* pwm-channels: number of channels of the PWM
			  controller. Note that the frequency is common for all
			  the channels of the pwmchip. If different frequency
			  values are set on different channels the frequency of
			  all the channels will match the value of the last
			  channel set.
			* #pwm-cells: It must be three.See pwm.txt in this
			  directory for a description of the cells format.

Example:
	mca_cc8x: mca@63 {
		pwms {
			compatible = "digi,mca-pwm";
			#address-cells = <1>;
			#size-cells = <0>;

			mca_pwm0: pwm@0 {
				reg = <0>;
				pwm-channels = <6>;
				#pwm-cells = <3>;
			};

			mca_pwm1: pwm@1 {
				reg = <1>;
				pwm-channels = <2>;
				#pwm-cells = <3>;
			};

			mca_pwm2: pwm@2 {
				reg = <2>;
				pwm-channels = <2>;
				#pwm-cells = <3>;
			};
		};
	};
```

## Documentation/devicetree/bindings/pwm/mxs-pwm.txt
```
Freescale MXS PWM controller

Required properties:
- compatible: should be "fsl,imx23-pwm"
- reg: physical base address and length of the controller's registers
- #pwm-cells: should be 3.  The first cell specifies the per-chip index
  of the PWM to use; the second cell is the period in nanoseconds; the third
  cell encodes the polarity of PWM output. Set bit 0 of the third in PWM
  specifier to 1 for inverse polarity & set to 0 for normal polarity.
- fsl,pwm-number: the number of PWM devices

Example:

pwm: pwm@80064000 {
	compatible = "fsl,imx28-pwm", "fsl,imx23-pwm";
	reg = <0x80064000 0x2000>;
	#pwm-cells = <3>;
	fsl,pwm-number = <8>;
};
```

## Documentation/devicetree/bindings/regulator/da9063-regulator.txt
```
Dialog's DA9063 PMIC Voltage regulators

Required properties:
- compatible: Must be "dlg,da9063-regulator"
- interrupts: Local DA9063 interrupt line.
- interrupts-name: Local DA9063 interrupt line name. See the da9063-irq.c
  file for details.
- interrupt-parent: phandle for the interrupt controller.

Optional properties:
- dlg,bcores_merged: Indicates Buck Core 1 and 2 are in merged mode.
- dlg,bmem_bio_merged: Indicates Buck Mem and IO and in merged mode.

Example:
	/* For DA9063 revision AD */
	regulators {
		compatible = "dlg,da9063-regulator";
		/*dlg,bcores_merged;*/
		/*dlg,bmem_bio_merged;*/
		interrupts = <8>;
		interrupts-names = "LDO_LIM";
		interrupt-parent = <&pmic_dialog>;

		bcore1: DA9063_BCORE1 {
			regulator-name = "DA9063_BCORE1";
		};

		bcore2: DA9063_BCORE2 {
			regulator-name = "DA9063_BCORE2";
		};

		bpro: DA9063_BPRO {
			regulator-name = "DA9063_BPRO";
		};

		bmem: DA9063_BMEM {
			regulator-name = "DA9063_BMEM";
		};

		bio: DA9063_BIO {
			regulator-name = "DA9063_BIO";
		};

		bperi: DA9063_BPERI {
			regulator-name = "DA9063_BPERI";
		};

		/*
		bcores_merged: DA9063_BCORES_MERGED {
			regulator-name = "DA9063_BCORES_MERGED";
		};

		bmem_bio_merged: DA9063_BMEM_BIO_MERGED {
			regulator-name = "DA9063_BMEM_BIO_MERGED";
		};
		*/

		ldo1: DA9063_LDO1 {
			regulator-name = "DA9063_LDO1";
		};

		ldo2: DA9063_LDO2 {
			regulator-name = "DA9063_LDO2";
		};

		ldo3: DA9063_LDO3 {
			regulator-name = "DA9063_LDO3";
		};

		ldo4: DA9063_LDO4 {
			regulator-name = "DA9063_LDO4";
		};

		ldo5: DA9063_LDO5 {
			regulator-name = "DA9063_LDO5";
		};

		ldo6: DA9063_LDO6 {
			regulator-name = "DA9063_LDO6";
		};

		ldo7: DA9063_LDO7 {
			regulator-name = "DA9063_LDO7";
		};

		ldo8: DA9063_LDO8 {
			regulator-name = "DA9063_LDO8";
		};

		ldo9: DA9063_LDO9 {
			regulator-name = "DA9063_LDO9";
		};

		ldo10: DA9063_LDO10 {
			regulator-name = "DA9063_LDO10";
		};

		ldo11: DA9063_LDO11 {
			regulator-name = "DA9063_LDO11";
		};

		out_32k: DA9063_32K_OUT {
			regulator-name = "DA9063_32K_OUT";
		};
}
```

## Documentation/devicetree/bindings/regulator/mxs-regulator.txt
```
MXS regulators

Required properties:
- compatible		: Must be "digi,mxs-regulator".
- regulator-type:       : "current" or "voltage"

Optional properties:
- mxs-regulator-brown-out: Specifies a brown out voltage regulator.

Any property defined as part of the core regulator binding defined in
regulator.txt can also be used.

Example:

        vddd@80044040 {
                compatible = "digi,mxs-regulator";
                reg = <0x80044040 0x10>;
                regulator-name = "vddd";
                regulator-min-microvolt = <800000>;
                regulator-max-microvolt = <1575000>;
                regulator-type = "voltage";
                regulator-always-on;
};
```

## Documentation/devicetree/bindings/regulator/protection-consumer.txt
```
regulator protection bindings


Required properties:
	compatible: "protection-consumer"
	protection-supply: the phandle of the regulator to control

Optional properties:
--------------------
	interrupt


Example:

	regulator_protection {
		compatible = "protection-consumer";
		protection-supply = <&vdd>;
		status = "okay";

		interrupts = <15 2>;
		interrupt-parent = <&gpiof>;
	};
```
