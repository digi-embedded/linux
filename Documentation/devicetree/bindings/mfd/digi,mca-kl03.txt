## Documentation/devicetree/bindings/remoteproc/rproc-srm.txt
```
Remoteproc System Resource Manager
----------------------------------

The remoteproc SRM (System Resource Manager) handles resources allocated
to remote processors.
This makes it possible for remote proc to reserve and initialize system
resources for a peripheral assigned to a coprocessor.

The devices are grouped in a core node

Core
====
Required properties:
- compatible: should be "rproc-srm-core"

Dev
===
Required properties:
- compatible: should be "rproc-srm-dev"

Optional properties:
- reg: register base address and length
- clocks: clocks required by the coprocessor
- clock-names: see clock-bindings.txt
- pinctrl-0: pins configurations required by the coprocessor
	The SRM reserves the pins for the coprocessor, which prevents the local
	processor to use them.
- pinctrl-names: must be "default".
- x-supply: power supplies required by the coprocessor
- interrupts: external interrupts configurations required by the coprocessor.
	This is optional since the configuration is done by the coprocessor.
	When defined, the SRM (over)writes the configuration which allows the
	interrupt controller to check for configuration conflicts.
- interrupt-parent: see interrupts.txt
- interrupt-names: see interrupts.txt

Example:
	system_resources {
		compatible = "rproc-srm-core";

		mmc0: sdhci@09060000 {
			compatible = "rproc-srm-dev";
			reg = <0x09060000 0x100>;
			pinctrl-names = "default";
			pinctrl-0 = <&m4_pinctrl_mmc0>;
			clock-names = "mmc", "icn";
			clocks = <&clk_s_c0_flexgen CLK_MMC_0>,
				 <&clk_s_c0_flexgen CLK_RX_ICN_HVA>;
			vdda-supply = <&vdda>;
		};

		button {
			compatible = "rproc-srm-dev";
			interrupt-parent = <&gpioa>;
			interrupts = <5 1>;
			interrupt-names = "gpio_key";
		};
	};
```

## Documentation/devicetree/bindings/rtc/digi,mca-cc6ul-rtc.txt
```
* Digi Real Time Clock for MCA of ConnectCore 6UL

Required properties:
- compatible: must be "digi,mca-cc6ul-rtc".

Example:
	mca: mca-cc6ul@7e {
		rtc {
			compatible = "digi,mca-cc6ul-rtc";
		};
	};
```

## Documentation/devicetree/bindings/rtc/digi,mca-rtc.txt
```
* Digi Real Time Clock for MCA of ConnectCore SOMs

Required properties:
- compatible: must be one of
  "digi,mca-rtc".
  "digi,mca-rtc".
  "digi,mca-rtc".

Example:
	mca_cc6ul: mca@7e {
		rtc {
			compatible = "digi,mca-rtc";
		};
	};

	mca_cc8x: mca@63 {
		rtc {
			compatible = "digi,mca-rtc";
		};
	};

	mca_cc8m: mca@63 {
		rtc {
			compatible = "digi,mca-rtc";
		};
	};
```

## Documentation/devicetree/bindings/serial/digi,mca-cc6ul-uart.txt
```
* Digi MCA UART for ConnectCore 6UL device tree bindings

The MCA UART driver exposes an extra TTY device through the Micro Controller
Assistant. This UART can be used to wake up the system from low power modes.
Notice the MCA UART has limited capabilities compared to CPU's UARTs. Check the
documentation for a list of capabilities.

WARNING!
This driver is legacy.
For MCA version 1.19 and higher use "digi,mca-uart".

Required properties:
- compatible: must be "digi,mca-cc6ul-uart".
              Only valid up to MCA version 1.18.

Optional properties:
- rts-pin: MCA IO line to be used as RTS when using hardware flow control.
- cts-pin: MCA IO line to be used as CTS when using hardware flow control.

Example:

	&mca_uart {
		compatible = "digi,mca-cc6ul-uart";
		status = "okay";
		rts-pin = <3>;
		cts-pin = <5>;
	};
```

## Documentation/devicetree/bindings/serial/digi,mca-uart.txt
```
* Digi MCA UART device tree bindings

The MCA UART driver exposes extra TTY devices through the Micro Controller
Assistant. These UARTs can be used to wake the system from low power modes.
Notice the MCA UART has limited capabilities compared to CPU's UARTs.
Check the documentation for a list of capabilities.

Required properties:
- compatible: must be one of
  "digi,mca-cc8x-uart".
  "digi,mca-cc8m-uart".
  "digi,mca-cc6ul-uart".
	      cc6ul requires MCA version 1.19 or higher.
- #address-cells: must be 1
- #size-cells: must be 0

Subcomponents:

Required properties:
- reg: UART base address
- index: UART index
- iopins-names: "rx", "tx". Optionally also "cts", "rts".
- iopins: the MCA I/O pins associated to 'iopins-names'.
	  NOTE: Not all I/O pins can be used for any functionality on any UART.
	  Refer to the documentation to map appropriate pins and functions.


Example:

mca_uart: uart {
	compatible = "digi,mca-cc8x-uart";
	#address-cells = <1>;
	#size-cells = <0>;

	mca_uart0: serial@0x900 {
		reg = <0x900>;
		index = <0>;
		iopins-names = "rx", "tx";
		iopins = <9 10>;
	};

	mca_uart1: serial@0x920 {
		reg = <0x920>;
		index = <1>;
		iopins-names = "rx", "tx";
		iopins = <11 16>;
	};

	mca_uart2: serial@940 {
		reg = <0x940>;
		index = <2>;
		iopins-names = "rx", "tx", "cts", "rts";
		iopins = <2 1 3 4>;
	};
};

mca_uart: uart {
	compatible = "digi,mca-cc6ul-uart";
	#address-cells = <1>;
	#size-cells = <0>;

	mca_uart0: serial@0x900 {
		reg = <0x900>;
		index = <0>;
		iopins-names = "rx", "tx";
		iopins = <2 1>;
	};
};
```

## Documentation/devicetree/bindings/serial/rs485.txt
```
* RS485 serial communications

The RTS signal is capable of automatically controlling line direction for
the built-in half-duplex mode.
The properties described hereafter shall be given to a half-duplex capable
UART node.

Optional properties:
- rs485-rts-delay: prop-encoded-array <a b> where:
  * a is the delay between rts signal and beginning of data sent in milliseconds.
      it corresponds to the delay before sending data.
  * b is the delay between end of data sent and rts signal in milliseconds
      it corresponds to the delay after sending data and actual release of the line.
  If this property is not specified, <0 0> is assumed.
- rs485-rts-active-low: drive RTS low when sending (default is high).
- linux,rs485-enabled-at-boot-time: empty property telling to enable the rs485
  feature at boot time. It can be disabled later with proper ioctl.
- rs485-rx-during-tx: empty property that enables the receiving of data even
  while sending data.
- digi,rts-gpio: use a standard GPIO (instead of RTS) to control transfer direction.
  This configuration forbids enabling DMA on the UART.

RS485 example for Atmel USART:
	usart0: serial@fff8c000 {
		compatible = "atmel,at91sam9260-usart";
		reg = <0xfff8c000 0x4000>;
		interrupts = <7>;
		atmel,use-dma-rx;
		atmel,use-dma-tx;
		linux,rs485-enabled-at-boot-time;
		rs485-rts-delay = <0 200>;		// in milliseconds
	};

RS485 example for Digi ccimx8x-sbc-pro:
	&lpuart3 {
		pinctrl-names = "default";
		pinctrl-0 = <&pinctrl_lpuart3>,
			    <&pinctrl_flexcan3_lpuart3_gpios>;
		pinctrl-assert-gpios = <&gpio3 23 GPIO_ACTIVE_LOW>;
		linux,rs485-enabled-at-boot-time;
		digi,rts-gpio = <&gpio3 24 GPIO_ACTIVE_HIGH>;
};
```

## Documentation/devicetree/bindings/soc/stm32/st,stm32mp1-hslv.yaml
```yaml
# SPDX-License-Identifier: (GPL-2.0-only OR BSD-2-Clause)
%YAML 1.2
---
$id: http://devicetree.org/schemas/regulator/st,stm32mp1-hslv.yaml#
$schema: http://devicetree.org/meta-schemas/core.yaml#

title: STM32MP1 HSLV IO Speed config assistant

maintainers:
  - Pascal Paillet <p.paillet@st.com>

description: |
  Some of the STMicroelectronics's STM32 MP13 IOs can be set to high speed mode
  if their supply is lower than a 2.7V. The goal of this driver is to
  automatically set the IOs to high speed mode depending on their supply's
  regulator voltage value.

properties:
  compatible:
    const: st,stm32mp13,hslv

  hslv-supply:
    description: Input supply phandle(s) for hslv input

  st,syscon:
    description: hslv sysconf register offset and mask

required:
  - compatible
  - hslv-supply
  - st,syscon

additionalProperties: false

examples:
  - |
      hslv@1 {
            compatible = "st,stm32mp13,hslv";

            /* sdmmc1 hslv = 0x50 + 4 * 4  = 0x60 */
            st,syscon = <&syscfg 0x60 0x1018>;
            hslv-supply = <&sdmmc1_regu>;
      };
...
```

## Documentation/devicetree/bindings/soc/stm32/stm32_hdp.txt
```
STM32 - STM32MP1- HDP Pin configuration for STM32MP1
=======================================================

The Hardware Debug Port (HDP) allows the observation of internal signals. By using multiplexers,
up to 16 signals for each of 8-bit output can be observed.

Required Properties:

  - compatible: Must be "st,stm32mp1-hdp"
  - muxing-hdp: Indicates for each HDP pins selected which HDP output among the 16 available signals you want

For each HDP pins you can select one of 16 signals which will be described in file : include/dt-bindings/soc/stm32-hdp.h

Example
-------

In common dtsi file:

hdp: hdp@5002a000 {
	compatible = "st,stm32mp1-hdp";
	reg = <0x5002a000 0x400>;
	clocks = <&rcc HDP>;
	clock-names = "hdp";
};

In board-specific file:

In this example I've selected HDP0, HDP6 and HDP7, and for HDP0 the output signal is HDP0_GPOVAL_0,
for HDP6 is HDP6_GPOVAL_6, and for HDP7 is HDP7_GPOVAL_7.

&hdp {
	pinctrl-names = "default", "sleep";
	pinctrl-0 = <&hdp0_pins_a &hdp6_pins_a &hdp7_pins_a>;
	pinctrl-1 = <&hdp0_pins_sleep_a &hdp6_pins_sleep_a &hdp7_pins_sleep_a>;

	muxing-hdp = <(STM32_HDP(0, HDP0_GPOVAL_0) |
		       STM32_HDP(6, HDP6_GPOVAL_6) |
		       STM32_HDP(7, HDP7_GPOVAL_7))>;
};
```

## Documentation/devicetree/bindings/sound/imx-audio-max98088.txt
```
Freescale i.MX audio complex with MAX98088/MAX98089 codec

Required properties:
- compatible : "fsl,imx-audio-max98088","fsl,imx-audio-max98089"
- model : The user-visible name of this sound complex
- cpu-dai : The phandle of CPU dai
- gpr : The phandle of i.MX IOMUXC GPR for managing SAI MCLK
- audio-codec : The phandle of the MAX98088/MAX98089 audio codec
- audio-routing : A list of the connections between audio components.
  Each entry is a pair of strings, the first being the connection's sink,
  the second being the connection's source. Valid names could be power
  supplies, MAX98088/MAX98089 pins, and the jacks on the board.

  e.g. Board connectors:
   * Headphone Jack
   * Ext Spk
   * Mic1
   * Mic2
   * LineInA
   * LineInB
   * LineOut

Not implemented:
- Regulators for power supplies
- Interrupt handling
- Jack detection (JACKSNS)

Example:

sound {
        compatible = "fsl,imx-audio-max98088";
        model = "imx-max98088";
        cpu-dai = <&ssi2>;
        gpr = <&gpr>;
        audio-codec = <&codec>;
        audio-routing =
                "Headphone Jack","HPL",
                "Headphone Jack","HPR",
                "Ext Spk","SPKL",
                "Ext Spk","SPKR";
};
```
