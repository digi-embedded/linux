## Documentation/devicetree/bindings/mfd/digi,mca-kl03.txt
```
* Digi ConnectCore 6UL Micro-Controller Assist (MCA)

The CC6UL MCA consists of a varied group of sub-devices (I2C Only):

Device                   Description
------                   ------------
adc                      ADC channels (multiplexed with IOs)
gpio                     IO pins (multiplexed with ADCs)
pwrkey                   Power key
rtc                      Real-Time Clock
watchdog                 Watchdog

======

Required properties:

- compatible : Should be "digi,mca-kl03"
- reg : Specifies the I2C slave address (this defaults to 0x7e but it can be
  modified to match the chip's OTP settings).
- interrupt-parent : Specifies the reference to the interrupt controller for
  the MCA.
- interrupts : IRQ line information.
- interrupt-controller

Optional properties:

- fw-update-gpio : Control GPIO for MCA firmware update.

Sub-nodes:

- adc : This node defines settings for the ADC channels associated with the
  MCA. Refer to binding at:
  "Documentation/devicetree/bindings/iio/adc/digi,mca-adc.txt"

- gpio : This node defines settings for the GPIO pins associated with the MCA.
  Refer to binding at:
  "Documentation/devicetree/bindings/gpio/gpio-mca.txt"

- pwrkey : This node defines settings for the power key associated with the MCA.
  Refer to binding at:
  "Documentation/devicetree/bindings/input/digi,mca-powerkey.txt"

- rtc : This node defines settings for the Real-Time Clock associated with
  the MCA. Refer to binding at:
  "Documentation/devicetree/bindings/rtc/digi,mca-rtc.txt"

- tamper : The presence of this node enables the tamper support.

- uart : This node defines settings for the MCA UART. Refer to binding at:
  "Documentation/devicetree/bindings/serial/digi,mca-uart.txt"

- watchdog : This node defines settings for the Watchdog timer associated
  with the MCA. Refer to binding at:
  "Documentation/devicetree/bindings/watchdog/mca-wdt.txt"



Example:

	mca_cc6ul: mca@7e {
		compatible = "digi,mca-kl03";
		reg = <0x7e>;
		interrupt-parent = <&gpio5>;
		interrupts = <4 IRQ_TYPE_EDGE_FALLING>;
		interrupt-controller;
		#interrupt-cells = <2>;
		fw-update-gpio = <&gpio4 14 GPIO_ACTIVE_HIGH>;
		pinctrl-names = "default";
		pinctrl-0 = <&pinctrl_mca_cc6ul>;

		adc {
			compatible = "digi,mca-adc";
			digi,adc-ch-list = <4>;
		};

		gpio {
			compatible = "digi,mca-gpio";
			gpio-controller;
			#gpio-cells = <2>;

			interrupt-parent = <&mca_cc6ul>;
			interrupt-controller;
			#interrupt-cells = <2>;

			/* Disable all mca GPIOs as power off wake up sources */
			pwroff-wakeup-capable-ios = <>;
		};

		pwrkey {
			compatible = "digi,mca-pwrkey";
			digi,key-power;
			digi,key-power-up;
			digi,key-sleep;
			digi,debounce-ms = <100>;
			digi,pwroff-delay-sec = <6>;
			digi,pwroff-guard-sec = <30>;
		};

		rtc {
			compatible = "digi,mca-rtc";
		};

		tamper {
			compatible = "digi,mca-tamper";
		};

		uart {
			compatible = "digi,mca-uart";
			#address-cells = <1>;
			#size-cells = <0>;

			mca_uart0: serial@0x900 {
				reg = <0x900>;
				index = <0>;
			};
		};

		wdt {
			compatible = "digi,mca-wdt";
		};
	};
```

## Documentation/devicetree/bindings/mfd/digi,mca-kl17.txt
```
* Digi ConnectCore 8 SoMs Micro-Controller Assist (MCA)

The CC8 MCA consists of a varied group of sub-devices (I2C Only):

Device                   Description
------                   ------------
adc                      ADC channels (multiplexed with IOs)
gpio                     IO pins (multiplexed with ADCs)
pwrkey                   Power key
rtc                      Real-Time Clock
watchdog                 Watchdog

======

Required properties:

- compatible: must be "digi,mca-kl17".
- reg : Specifies the I2C slave address (this defaults to 0x63 but it can be
  modified to match the chip's OTP settings).
- interrupt-parent : Specifies the reference to the interrupt controller for
  the MCA.
- interrupts : IRQ line information.
- interrupt-controller

Optional properties:

- fw-update-gpio : Control GPIO for MCA firmware update.

Sub-nodes:

- adc : This node defines settings for the ADC channels associated with the
  MCA. Refer to binding at:
  "Documentation/devicetree/bindings/iio/adc/digi,mca-adc.txt"

- gpio : This node defines settings for the GPIO pins associated with the MCA.
  Refer to binding at:
  "Documentation/devicetree/bindings/gpio/gpio-mca.txt"

- pwrkey : This node defines settings for the power key associated with the MCA.
  Refer to binding at:
  "Documentation/devicetree/bindings/input/digi,mca-powerkey.txt"

- rtc : This node defines settings for the Real-Time Clock associated with
  the MCA. Refer to binding at:
  "Documentation/devicetree/bindings/rtc/digi,mca-rtc.txt"

- tamper : The presence of this node enables the tamper support.

- pwms : This node defines settings for the MCA PWMs.  Refer to binding at:
  "Documentation/devicetree/bindings/pwm/digi,mca-pwm.txt"

- uart : This node defines settings for the MCA UARTs. Refer to binding at:
  "Documentation/devicetree/bindings/serial/digi,mca-uart.txt"

- watchdog : This node defines settings for the Watchdog timer associated
  with the MCA. Refer to binding at:
  "Documentation/devicetree/bindings/watchdog/mca-wdt.txt"



Example:

	mca_cc8x: mca@63 {
		compatible = "digi,mca-kl17";
		reg = <0x63>;
		interrupt-parent = <&wu>;
		interrupts = <GIC_SPI 177 IRQ_TYPE_EDGE_HIGH>;
		interrupt-controller;
		#interrupt-cells = <2>;
		fw-update-gpio = <&gpio3 9 GPIO_ACTIVE_LOW>;
		pinctrl-names = "default";
		pinctrl-0 = <&pinctrl_mca_cc8x>;

		adc {
			compatible = "digi,mca-adc";
			digi,adc-ch-list = <4>;
		};

		gpio {
			compatible = "digi,mca-gpio";
			gpio-controller;
			#gpio-cells = <2>;

			interrupt-parent = <&mca_cc8x>;
			interrupt-controller;
			#interrupt-cells = <2>;

			/* Disable all mca GPIOs as power off wake up sources */
			pwroff-wakeup-capable-ios = <>;
		};

		pwms {
			compatible = "digi,mca-pwm";
			#address-cells = <1>;
			#size-cells = <0>;

			mca_pwm0: pwm@0 {
				reg = <0>;
				pwm-channels = <6>;
				#pwm-cells = <3>;
			};

			mca_pwm1: pwm@1 {
				reg = <1>;
				pwm-channels = <2>;
				#pwm-cells = <3>;
			};

			mca_pwm2: pwm@2 {
				reg = <2>;
				pwm-channels = <2>;
				#pwm-cells = <3>;
			};
		};

		pwrkey {
			compatible = "digi,mca-pwrkey";
			digi,key-power;
			digi,key-power-up;
			digi,key-sleep;
			digi,debounce-ms = <100>;
			digi,pwroff-delay-sec = <6>;
			digi,pwroff-guard-sec = <30>;
		};

		rtc {
			compatible = "digi,mca-rtc";
		};

		tamper {
			compatible = "digi,mca-tamper";
		};

		uart {
			compatible = "digi,mca-uart";
			#address-cells = <1>;
			#size-cells = <0>;

			mca_uart0: serial@0x900 {
				reg = <0x900>;
				index = <0>;
			};

			mca_uart1: serial@0x920 {
				reg = <0x920>;
				index = <1>;
			};

			mca_uart2: serial@0x940 {
				reg = <0x940>;
				index = <2>;
			};
		};

		wdt {
			compatible = "digi,mca-wdt";
		};
	};

	mca_cc8m: mca@63 {
		compatible = "digi,mca-kl17";
		reg = <0x63>;
		interrupt-parent = <&gpio3>;
		interrupts = <8 IRQ_TYPE_LEVEL_HIGH>;
		interrupt-controller;
		#interrupt-cells = <2>;
		fw-update-gpio = <&gpio1 4 GPIO_ACTIVE_LOW>;
		pinctrl-names = "default";
		pinctrl-0 = <&pinctrl_mca_cc8m>;

		adc {
			compatible = "digi,mca-adc";
			digi,adc-ch-list = <4>;
		};

		gpio {
			compatible = "digi,mca-gpio";
			gpio-controller;
			#gpio-cells = <2>;

			interrupt-parent = <&mca_cc8m>;
			interrupt-controller;
			#interrupt-cells = <2>;

			/* Disable all mca GPIOs as power off wake up sources */
			pwroff-wakeup-capable-ios = <>;
		};

		pwms {
			compatible = "digi,mca-pwm";
			#address-cells = <1>;
			#size-cells = <0>;

			pwm@0 {
				reg = <0>;
				pwm-channels = <6>;
				#pwm-cells = <3>;
			};
		};

		pwrkey {
			compatible = "digi,mca-pwrkey";
			digi,key-power;
			digi,key-power-up;
			digi,key-sleep;
			digi,debounce-ms = <100>;
			digi,pwroff-delay-sec = <6>;
			digi,pwroff-guard-sec = <30>;
		};

		rtc {
			compatible = "digi,mca-rtc";
		};

		tamper {
			compatible = "digi,mca-tamper";
		};

		uart {
			compatible = "digi,mca-uart";
			#address-cells = <1>;
			#size-cells = <0>;

			mca_uart0: serial@0x900 {
				reg = <0x900>;
				index = <0>;
			};

			mca_uart1: serial@0x920 {
				reg = <0x920>;
				index = <1>;
			};

			mca_uart2: serial@0x940 {
				reg = <0x940>;
				index = <2>;
			};
		};

		wdt {
			compatible = "digi,mca-wdt";
		};
	};
```

## Documentation/devicetree/bindings/mfd/st,stm32mp1-pwr.txt
```
STMicroelectronics STM32MP1 Power Management Controller
=======================================================

The PWR IP is responsible for handling the power related resources such as
clocks, power supplies and resets. It provides 6 wake-up pins that are handled
by an interrupt-controller. Wake-up pin can be used to wake-up from STANDBY SoC state.

Required properties:
- compatible should be: "st,stm32mp1-pwr"
- reg: should be register base and length as documented in the
  datasheet
- interrupts: contains the reference to the gic wake-up pin interrupt
- interrupt-controller; Enable interrupt controller for wake-up pins.
- #interrupt-cells = <3>
- st,wakeup-pins: contains a list of GPIO spec describing each wake-up pin.

Optional Properties:
- pwr-supply: main soc power supply

Interrupt consumers have to specify 3 cells:
  - cell 1: wake-up pin id from 0 to 5
  - cell 2: IRQ_TYPE_EDGE_FALLING or IRQ_TYPE_EDGE_RISING
  - cell 3: Pull config: 0 = No Pull, 1=Pull Up, 2=Pull Down


Example:

	pwr: pwr@50001000 {
		compatible = "st,stm32mp1-pwr", "simple-mfd";
		reg = <0x50001000 0x400>;
		interrupts = <GIC_SPI 149 IRQ_TYPE_NONE>;
		interrupt-controller;
		#interrupt-cells = <3>;

		st,wakeup-pins = <&gpioa 0 0>, <&gpioa 2 0>,
				 <&gpioc 13 0>, <&gpioi 8 0>,
				 <&gpioi 11 0>, <&gpioc 1 0>;

		pwr-supply = <&vdd>;
	};


Example of interrupt user:
gpio_keys {
	compatible = "gpio-keys";
	#address-cells = <1>;
	#size-cells = <0>;

	button@4 {
		label = "WakeUp4";
		linux,code = <BTN_4>;
		interrupt-parent = <&pwr>;
		interrupts = <3 IRQ_TYPE_EDGE_FALLING 1>;
		wakeup-source;
	};
};
```

## Documentation/devicetree/bindings/mtd/partitions/partition.yaml
```yaml
# SPDX-License-Identifier: GPL-2.0-only OR BSD-2-Clause
%YAML 1.2
---
$id: http://devicetree.org/schemas/mtd/partitions/partition.yaml#
$schema: http://devicetree.org/meta-schemas/core.yaml#

title: Partition

description: |
  This binding describes a single flash partition. Each partition must have its
  relative offset and size specified. Depending on partition function extra
  properties can be used.

  A partition may be dynamically allocated by a specific parser at runtime.
  In this specific case, a specific suffix is required to the node name.
  Everything after 'partition-' will be used as the partition name to compare
  with the one dynamically allocated by the specific parser.
  If the partition contains invalid char a label can be provided that will
  be used instead of the node name to make the comparison.
  This is used to assign an OF node to the dynamiccally allocated partition
  so that subsystem like NVMEM can provide an OF node and declare NVMEM cells.
  The OF node will be assigned only if the partition label declared match the
  one assigned by the parser at runtime.

maintainers:
  - Rafał Miłecki <rafal@milecki.pl>

properties:
  reg:
    description: partition's offset and size within the flash
    maxItems: 1

  label:
    description: The label / name for this partition. If omitted, the label
      is taken from the node name (excluding the unit address).

  read-only:
    description: This parameter, if present, is a hint that this partition
      should only be mounted read-only. This is usually used for flash
      partitions containing early-boot firmware images or data which should
      not be clobbered.
    type: boolean

  lock:
    description: Do not unlock the partition at initialization time (not
      supported on all devices)
    type: boolean

  slc-mode:
    description: This parameter, if present, allows one to emulate SLC mode
      on a partition attached to an MLC NAND thus making this partition
      immune to paired-pages corruptions
    type: boolean

  encrypted:
    description: This parameter flags a partition as encrypted. All accesses
      to and from this partition will be encrypted/decrypted.
    type: boolean

  encryption-keyblob-size:
    $ref: /schemas/types.yaml#/definitions/uint32
    description: Size in bytes of the encryption key blob defined above. The
      size of the key blob is the size of the key itself plus 48 bytes of blob
      overhead. The maximum key size is 64 bytes so the maximum key blob size
      is 112 bytes.

  encryption-keyblob-part:
    $ref: /schemas/types.yaml#/definitions/uint32
    description: Partition number where the CAAM encrypted crypto key is
      stored. Defauls to 1.

  encryption-keyblob-offset:
    $ref: /schemas/types.yaml#/definitions/uint32
    description: Offset in the encryption-keyblob-part where the CAAM
      encrypted crypto key is stored.

if:
  not:
    required: [ reg ]
then:
  properties:
    $nodename:
      pattern: '^partition-.*$'

additionalProperties: true
```

## Documentation/devicetree/bindings/net/btdigi.txt
```
* Bluetooth of Digi SOMs (btdigi driver)

Required properties:

- compatible :  should comply with the format "digi,bluetooth-<platform>"
		where <platform> identifies the Digi platform device,
		see the following list:
			- digi,bluetooth-cc8x

Optional properties:

- vin-supply : Regulator for supplying voltage to Bluetooth chip

Example:

bluetooth {
	/* U-Boot will fill in the MAC address here */
	compatible = "digi,bluetooth-cc8x";
	vin-supply = <&reg_rf_bt_en>;
	status = "okay";
};
```

## Documentation/devicetree/bindings/net/rfkill-bt-cc.txt
```
* RFKILL of Digi ConnectCore Devices (rfkill-bt-cc driver)

Required properties:

- compatible : Should comply with the format "rfkill-bt-cc"
- vin-supply : Regulator for supplying voltage to Bluetooth chip

Example:

bluetooth {
	compatible = "digi,rfkill-bt-cc";
	vin-supply = <&reg_rf_bt_en>;
	status = "okay";
};
```

## Documentation/devicetree/bindings/perf/stm32-ddr-pmu.yaml
```yaml
# SPDX-License-Identifier: (GPL-2.0-only OR BSD-2-Clause)
%YAML 1.2
---
$id: http://devicetree.org/schemas/perf/stm32-ddr-pmu.yaml#
$schema: http://devicetree.org/meta-schemas/core.yaml#

maintainers:
  - Gerald Baeza <gerald.baeza@st.com>

title: STMicroelectronics STM32 DDR Performance Monitor (DDRPERFM) bindings

properties:
  compatible:
    const: st,stm32-ddr-pmu

  reg:
    maxItems: 1

  clocks:
    maxItems: 1

  resets:
    maxItems: 1

required:
  - compatible
  - reg
  - clocks
  - resets

additionalProperties: false

examples:
  - |
    #include <dt-bindings/clock/stm32mp1-clks.h>
    #include <dt-bindings/reset/stm32mp1-resets.h>

    ddrperfm: perf@5a007000 {
        compatible = "st,stm32-ddr-pmu";
        reg = <0x5a007000 0x400>;
        clocks = <&rcc DDRPERFM>;
        resets = <&rcc DDRPERFM_R>;
    };
...
```
