## Documentation/devicetree/bindings/gpio/fsl-imx-gpio.yaml
```yaml
# SPDX-License-Identifier: GPL-2.0
%YAML 1.2
---
$id: http://devicetree.org/schemas/gpio/fsl-imx-gpio.yaml#
$schema: http://devicetree.org/meta-schemas/core.yaml#

title: Freescale i.MX/MXC GPIO controller

maintainers:
  - Anson Huang <Anson.Huang@nxp.com>

properties:
  compatible:
    oneOf:
      - enum:
          - fsl,imx1-gpio
          - fsl,imx21-gpio
          - fsl,imx31-gpio
          - fsl,imx35-gpio
          - fsl,imx7d-gpio
      - items:
          - const: fsl,imx35-gpio
          - const: fsl,imx31-gpio
      - items:
          - enum:
              - fsl,imx50-gpio
              - fsl,imx51-gpio
              - fsl,imx53-gpio
              - fsl,imx6q-gpio
              - fsl,imx6sl-gpio
              - fsl,imx6sll-gpio
              - fsl,imx6sx-gpio
              - fsl,imx6ul-gpio
              - fsl,imx7d-gpio
              - fsl,imx8mm-gpio
              - fsl,imx8mn-gpio
              - fsl,imx8mp-gpio
              - fsl,imx8mq-gpio
              - fsl,imx8qxp-gpio
              - fsl,imxrt1050-gpio
              - fsl,imxrt1170-gpio
          - const: fsl,imx35-gpio

  reg:
    maxItems: 1

  interrupts:
    description: |
      Should be the port interrupt shared by all 32 pins, if one number.
      If two numbers, the first one is the interrupt shared by low 16 pins
      and the second one is for high 16 pins.
    minItems: 1
    maxItems: 2

  interrupt-controller: true

  "#interrupt-cells":
    const: 2

  clocks:
    maxItems: 1

  "#gpio-cells":
    const: 2

  gpio-controller: true
  gpio-line-names: true
  gpio-ranges: true

  power-domains:
    maxItems: 1

  pad-wakeup-num:
    description: Number of pads configured in the port as wake-up sources.

  pad-wakeup:
    description: List of pads configurations on the port. Every pad configuration
      consists of:
        pad: Pad identifier
        type: Wake-up type:
              0 = Off
              1 = Clear flag
              4 = Low level
              5 = Falling edge
              6 = Rising edge
              7 = High level
        line: GPIO line numer in the port.

patternProperties:
  "^(hog-[0-9]+|.+-hog(-[0-9]+)?)$":
    type: object
    properties:
      gpio-hog: true
      gpios: true
      input: true
      output-high: true
      output-low: true
      line-name: true

    required:
      - gpio-hog
      - gpios

    additionalProperties: false

required:
  - compatible
  - reg
  - interrupts
  - interrupt-controller
  - "#interrupt-cells"
  - "#gpio-cells"
  - gpio-controller

additionalProperties: false

examples:
  - |
    gpio0: gpio@73f84000 {
        compatible = "fsl,imx35-gpio";
        reg = <0x73f84000 0x4000>;
        interrupts = <50 51>;
        gpio-controller;
        #gpio-cells = <2>;
        interrupt-controller;
        #interrupt-cells = <2>;
    };
  - |
    &gpio4 {
        ...
        /* Configure GPIO4_20 and GPIO4_21 for Falling Edge wakeup */
        pad-wakeup-num = <2>;
        pad-wakeup = <IMX8QXP_USDHC1_VSELECT 5 20>,
                    <IMX8QXP_USDHC1_WP 5 21>;
    };

...
```

## Documentation/devicetree/bindings/gpio/gpio-da9063.txt
```
Dialog DA9063 PMIC GPIO extender

Required properties:
- compatible : Should be
    - "dlg,da9063-gpio"

- #gpio-cells : Should be two.
  - first cell is the pin number
  - second cell is used to specify flags. Flags are currently unused.

- gpio-controller : Marks the device node as a GPIO controller.

Example:

gpio_extender: gpio {
	compatible = "dlg,da9063-gpio";
	gpio-controller;
	#gpio-cells = <2>;
	};
```

## Documentation/devicetree/bindings/gpio/gpio-mca-cc6ul.txt
```
Digi ConnectCore 6UL Micro Controller Assist GPIO

Required properties:
- compatible : Should be
    - "digi,mca-cc6ul-gpio"

- #gpio-cells : Should be two.
  - first cell is the pin number
  - second cell is used to specify flags. Flags are currently unused.

- gpio-controller : Marks the device node as a GPIO controller.

Example:

	mca: mca-cc6ul@7e {
		gpio {
			compatible = "digi,mca-cc6ul-gpio";
			gpio-controller;
			#gpio-cells = <2>;
		};
	};
```

## Documentation/devicetree/bindings/gpio/gpio-mca-ioexp.txt
```
Digi I/O Expander GPIO

Required properties:
- compatible : Should be "digi,mca-ioexp-gpio"

- #gpio-cells : Should be two.
  - first cell is the pin number
  - second cell is used to specify flags. Flags are currently unused.

- gpio-controller : Marks the device node as a GPIO controller.

Example:

	mca_ioexp: mca_io@6e {
		gpio {
			compatible = "digi,mca-ioexp-gpio";
			gpio-controller;
			#gpio-cells = <2>;

			interrupt-parent = <&mca_ioexp>;
			interrupt-controller;
			#interrupt-cells = <2>;
		};
	};
```

## Documentation/devicetree/bindings/gpu/fsl,gpu-viv.txt
```
Vivante GPU2d/3d on Freescale i.MX6

 Required properties:
  - compatible: "fsl,imx6sl-gpu", "fsl,imx6q-gpu"
  - reg: Physical base address and length of the controller's registers.
  - interrupts: The interrupt outputs from the controller.
  - clocks : the clock sources that it depends on.
  - resets : IPU reset specifier.  See reset.txt and fsl,imx-src.txt in
             Documentation/devicetree/bindings/reset/ for details.

 Optional properties:
  - contiguous-size-percentage: Percentage of total system memory to allocate as
    contiguous memory area. This needs to be less than the configured CMA size.

 Example:

	gpu: gpu@02200000 {
		compatible = "fsl,imx6sl-gpu", "fsl,imx6q-gpu";
		reg = <0x02200000 0x4000>, <0x02204000 0x4000>, <0x80000000 0x0>;
		reg-names = "iobase_2d", "iobase_vg", "phys_baseaddr";
		interrupts = <0 10 0x04>, <0 11 0x04>;
		interrupt-names = "irq_2d", "irq_vg";
		clocks = <&clks IMX6SL_CLK_MMDC_ROOT>,
			 <&clks IMX6SL_CLK_MMDC_ROOT>,
			 <&clks IMX6SL_CLK_GPU2D_OVG>;
		clock-names = "gpu2d_axi_clk", "openvg_axi_clk", "gpu2d_clk";
		resets = <&src 3>, <&src 3>;
		reset-names = "gpu2d", "gpuvg";
		contiguous-size-percentage = <12>;
	}
```

## Documentation/devicetree/bindings/hwlock/hwlock.txt
```
Generic hwlock bindings
=======================

Generic bindings that are common to all the hwlock platform specific driver
implementations.

Please also look through the individual platform specific hwlock binding
documentations for identifying any additional properties specific to that
platform.

hwlock providers:
=================

Required properties:
- #hwlock-cells:        Specifies the number of cells needed to represent a
                        specific lock. Shall be 1 or 2 (see hwlocks below).

hwlock users:
=============

Consumers that require specific hwlock(s) should specify them using the
property "hwlocks", and an optional "hwlock-names" property.

Required properties:
- hwlocks:              List of phandle to a hwlock provider node and an
                        associated hwlock args specifier as indicated by
                        #hwlock-cells. The list can have just a single hwlock
                        or multiple hwlocks, with each hwlock represented by
                        a phandle and a corresponding args specifier.
                        If #hwlock-cells is 1, all of the locks are exclusive
                        (cannot be used by several users).
                        If #hwlock-cells is 2, the value of the second cell
                        defines whether the lock is for exclusive usage (0) or
                        shared (1) i.e. can be used by several users.

Optional properties:
- hwlock-names:         List of hwlock name strings defined in the same order
                        as the hwlocks, with one name per hwlock. Consumers can
                        use the hwlock-names to match and get a specific hwlock.


1. Example of a node using a single specific hwlock:

The following example has a node requesting a hwlock in the bank defined by
the node hwlock1. hwlock1 is a hwlock provider with an argument specifier
of length 1.

	node {
		...
		hwlocks = <&hwlock1 2>;
		...
	};

2. Example of nodes using multiple and shared specific hwlocks:

The following example has a nodeA requesting two hwlocks:
- an exclusive one (#hwlock-cells = 1) within the hwlock device node 'hwlock1'
- a shared one (#hwlock-cells = 2, second cell = 1) within the hwlock device
  node 'hwlock2'.
The shared lock is also be used by nodeB.

	nodeA {
		...
		hwlocks = <&hwlock1 2>, <&hwlock2 0 1>;
		...
	};

	nodeB {
		...
		hwlocks = <&hwlock2 0 1>;
		...
	};
```

## Documentation/devicetree/bindings/hwmon/da9063-hwmon.txt
```
* Dialog's hwmon device tree bindings

The da9063 hwmon driver allow for user space hardware monitoring.

Required properties:

- compatible: Must be "dlg,da9063-hwmon".
- interrupts: Local Da9063 interrupt line.
- interrupt-name: Local DA9063 interrupt line name.

Optional properties:
- dlg,tjunc-offset: Juntion temperature calibration offset [-128,127].

Example:

        onkey {
                compatible = "dlg,da9063-hwmon";
                interrupts = <3>;
                interrupts-names = "HWMON";
                interrupt-parent = <&pmic_dialog>;
                dlg,tjunc-offset = <(-5)>;
        };
```

## Documentation/devicetree/bindings/i2c/i2c-imx-lpi2c.txt
```
* Freescale Low Power Inter IC (LPI2C) for i.MX

Required properties:
- compatible :
  - "fsl,imx7ulp-lpi2c" for LPI2C compatible with the one integrated on i.MX7ULP soc
  - "fsl,imx8qxp-lpi2c" for LPI2C compatible with the one integrated on i.MX8QXP soc
- reg : address and length of the lpi2c master registers
- interrupts : lpi2c interrupt
- clocks : lpi2c clock specifier

Optional properties:
- digi,hold-time-ns : Forces start, repeated start and stop i2c hold time
- scl-gpios: specify the SCL pad GPIO related to SCL pin (required if using a "gpio" pinctrl)
- sda-gpios: specify the SDA pad GPIO related to SDA pin (required if using a "gpio" pinctrl)
- pinctrl: A pinctrl state named "gpio" may be defined to set pins as GPIOs
  (for bit-banging recovery)

Examples:

lpi2c7: lpi2c7@40a50000 {
	compatible = "fsl,imx7ulp-lpi2c";
	reg = <0x40A50000 0x10000>;
	interrupt-parent = <&intc>;
	interrupts = <GIC_SPI 37 IRQ_TYPE_LEVEL_HIGH>;
	clocks = <&clks IMX7ULP_CLK_LPI2C7>;
};

&i2c0 {
	#address-cells = <1>;
	#size-cells = <0>;
	clocks = <&clk IMX8QXP_I2C0_CLK>,
		 <&clk IMX8QXP_I2C0_IPG_CLK>;
	clock-names = "per", "ipg";
	assigned-clock-rates = <48000000>;
	clock-frequency = <1000000>;
	pinctrl-names = "default", "gpio";
	digi,hold-time-ns = <8000>;
	pinctrl-0 = <&pinctrl_lpi2c0>;
	pinctrl-1 = <&pinctrl_lpi2c0_gpio>;
	scl-gpios = <&gpio3 8 GPIO_ACTIVE_HIGH>;
	sda-gpios = <&gpio3 7 GPIO_ACTIVE_HIGH>;
};
```

## Documentation/devicetree/bindings/i2c/i2c-imx-lpi2c.yaml
```yaml
# SPDX-License-Identifier: (GPL-2.0-only OR BSD-2-Clause)
%YAML 1.2
---
$id: http://devicetree.org/schemas/i2c/i2c-imx-lpi2c.yaml#
$schema: http://devicetree.org/meta-schemas/core.yaml#

title: Freescale Low Power Inter IC (LPI2C) for i.MX

maintainers:
  - Anson Huang <Anson.Huang@nxp.com>

allOf:
  - $ref: /schemas/i2c/i2c-controller.yaml#

properties:
  compatible:
    oneOf:
      - enum:
          - fsl,imx7ulp-lpi2c
      - items:
          - enum:
              - fsl,imx8qxp-lpi2c
              - fsl,imx8dxl-lpi2c
              - fsl,imx8qm-lpi2c
              - fsl,imx8ulp-lpi2c
              - fsl,imx93-lpi2c
          - const: fsl,imx7ulp-lpi2c

  reg:
    maxItems: 1

  interrupts:
    maxItems: 1

  assigned-clock-parents: true
  assigned-clock-rates: true
  assigned-clocks: true
  clock-frequency: true

  clock-names:
    items:
      - const: per
      - const: ipg

  clocks:
    maxItems: 2

  dmas:
    items:
      - description: DMA controller phandle and request line for TX
      - description: DMA controller phandle and request line for RX

  dma-names:
    items:
      - const: tx
      - const: rx

  power-domains:
    maxItems: 1

  digi,hold-time-ns:
    description: Forces start, repeated start and stop i2c hold time

  digi,buffer-time-us:
    description: Sets the buffer time in microseconds. This is the bus free
      time between stop and start conditions. Some peripherals may require
      this time to operate properly.

  scl-gpios:
    description: specify the SCL pad GPIO related to SCL pin (required if
      using a "gpio" pinctrl)

  sda-gpios:
    description: specify the SDA pad GPIO related to SDA pin (required if
      using a "gpio" pinctrl)

  pinctrl:
    description: A pinctrl state named "gpio" may be defined to set pins as
      GPIOs (for bit-banging recovery)

required:
  - compatible
  - reg
  - interrupts
  - clocks

unevaluatedProperties: false

examples:
  - |
    #include <dt-bindings/clock/imx7ulp-clock.h>
    #include <dt-bindings/interrupt-controller/arm-gic.h>

    i2c@40a50000 {
        compatible = "fsl,imx7ulp-lpi2c";
        reg = <0x40A50000 0x10000>;
        interrupt-parent = <&intc>;
        interrupts = <GIC_SPI 37 IRQ_TYPE_LEVEL_HIGH>;
        clocks = <&clks IMX7ULP_CLK_LPI2C7>,
                 <&clks IMX7ULP_CLK_NIC1_BUS_DIV>;
    };
  - |
    &i2c0 {
        #address-cells = <1>;
        #size-cells = <0>;
        clocks = <&clk IMX8QXP_I2C0_CLK>,
                <&clk IMX8QXP_I2C0_IPG_CLK>;
        clock-names = "per", "ipg";
        assigned-clock-rates = <48000000>;
        clock-frequency = <1000000>;
        pinctrl-names = "default", "gpio";
        digi,hold-time-ns = <8000>;
        pinctrl-0 = <&pinctrl_lpi2c0>;
        pinctrl-1 = <&pinctrl_lpi2c0_gpio>;
        scl-gpios = <&gpio3 8 GPIO_ACTIVE_HIGH>;
        sda-gpios = <&gpio3 7 GPIO_ACTIVE_HIGH>;
    };
```
