## Documentation/devicetree/bindings/dma/st,stm32-dma.yaml
```yaml
# SPDX-License-Identifier: (GPL-2.0-only OR BSD-2-Clause)
%YAML 1.2
---
$id: http://devicetree.org/schemas/dma/st,stm32-dma.yaml#
$schema: http://devicetree.org/meta-schemas/core.yaml#

title: STMicroelectronics STM32 DMA Controller bindings

description: |
  The STM32 DMA is a general-purpose direct memory access controller capable of
  supporting 8 independent DMA channels. Each channel can have up to 8 requests.
  DMA clients connected to the STM32 DMA controller must use the format
  described in the dma.txt file, using a four-cell specifier for each
  channel: a phandle to the DMA controller plus the following four integer cells:
    1. The channel id
    2. The request line number
    3. A 32bit mask specifying the DMA channel configuration which are device
      dependent:
        -bit 9: Peripheral Increment Address
          0x0: no address increment between transfers
          0x1: increment address between transfers
        -bit 10: Memory Increment Address
          0x0: no address increment between transfers
          0x1: increment address between transfers
        -bit 15: Peripheral Increment Offset Size
          0x0: offset size is linked to the peripheral bus width
          0x1: offset size is fixed to 4 (32-bit alignment)
        -bit 16-17: Priority level
          0x0: low
          0x1: medium
          0x2: high
          0x3: very high
    4. A 32bit bitfield value specifying DMA features which are device dependent:
       -bit 0-1: DMA FIFO threshold selection
         0x0: 1/4 full FIFO
         0x1: 1/2 full FIFO
         0x2: 3/4 full FIFO
         0x3: full FIFO
       -bit 2: DMA direct mode
         0x0: FIFO mode with threshold selectable with bit 0-1
         0x1: Direct mode: each DMA request immediately initiates a transfer
              from/to the memory, FIFO is bypassed.
       -bit 4: alternative DMA request/acknowledge protocol
         0x0: Use standard DMA ACK management, where ACK signal is maintained
              up to the removal of request and transfer completion
         0x1: Use alternative DMA ACK management, where ACK de-assertion does
              not wait for the de-assertion of the REQuest, ACK is only managed
              by transfer completion. This must only be used on channels
              managing transfers for STM32 USART/UART.
       -bit 30-29: indicated SRAM Buffer size in (2^order)*PAGE_SIZE.
         Order is given by those 2 bits starting at 0.
         Valid only whether Intermediate M2M transfer is set.
         For cyclic, whether Intermediate M2M transfer is chosen, any value can be set:
         SRAM buffer size will rely on period size and not on this DT value.
       -bit 31: Intermediate M2M transfer from/to DDR to/from SRAM throughout MDMA
         0: MDMA not used to generate an intermediate M2M transfer
         1: MDMA used to generate an intermediate M2M transfer.


maintainers:
  - Amelie Delaunay <amelie.delaunay@st.com>

allOf:
  - $ref: "dma-controller.yaml#"

properties:
  "#dma-cells":
    const: 4

  compatible:
    const: st,stm32-dma

  reg:
    maxItems: 1

  clocks:
    maxItems: 1

  interrupts:
    maxItems: 8
    description: Should contain all of the per-channel DMA
      interrupts in ascending order with respect to the
      DMA channel index.

  resets:
    maxItems: 1

  st,mem2mem:
    $ref: /schemas/types.yaml#/definitions/flag
    description: if defined, it indicates that the controller
      supports memory-to-memory transfer

  dmas:
    description: A list of eight dma specifiers, one for each entry in dma-names.
      Refer to stm32-mdma.yaml for more details.
    items:
      - description: DMA channel 0 connected to the MDMA channel specified
      - description: DMA channel 1 connected to the MDMA channel specified
      - description: DMA channel 2 connected to the MDMA channel specified
      - description: DMA channel 3 connected to the MDMA channel specified
      - description: DMA channel 4 connected to the MDMA channel specified
      - description: DMA channel 5 connected to the MDMA channel specified
      - description: DMA channel 6 connected to the MDMA channel specified
      - description: DMA channel 7 connected to the MDMA channel specified

  dma-names:
    description: Represents each STM32 DMA channel connected to a STM32 MDMA one.
    items:
      - const: ch0
      - const: ch1
      - const: ch2
      - const: ch3
      - const: ch4
      - const: ch5
      - const: ch6
      - const: ch7

  memory-region:
    description: Phandle to a node describing memory to be used for M2M intermediate transfer
      between DMA and MDMA.

required:
  - compatible
  - reg
  - clocks
  - interrupts

unevaluatedProperties: false

examples:
  - |
    #include <dt-bindings/interrupt-controller/arm-gic.h>
    #include <dt-bindings/clock/stm32mp1-clks.h>
    #include <dt-bindings/reset/stm32mp1-resets.h>
    dma-controller@40026400 {
      compatible = "st,stm32-dma";
      reg = <0x40026400 0x400>;
      interrupts = <56>,
                   <57>,
                   <58>,
                   <59>,
                   <60>,
                   <68>,
                   <69>,
                   <70>;
      clocks = <&clk_hclk>;
      #dma-cells = <4>;
      st,mem2mem;
      resets = <&rcc 150>;
      dma-requests = <8>;
      dmas = <&mdma1 8 0x3 0x1200000a 0x40026408 0x00000020 1>,
             <&mdma1 9 0x3 0x1200000a 0x40026408 0x00000800 1>,
             <&mdma1 10 0x3 0x1200000a 0x40026408 0x00200000 1>,
             <&mdma1 11 0x3 0x1200000a 0x40026408 0x08000000 1>,
             <&mdma1 12 0x3 0x1200000a 0x4002640C 0x00000020 1>,
             <&mdma1 13 0x3 0x1200000a 0x4002640C 0x00000800 1>,
             <&mdma1 14 0x3 0x1200000a 0x4002640C 0x00200000 1>,
             <&mdma1 15 0x3 0x1200000a 0x4002640C 0x08000000 1>;
      dma-names = "ch0", "ch1", "ch2", "ch3", "ch4", "ch5", "ch6", "ch7";
      memory-region = <&sram_dmapool>;
    };

...
```

## Documentation/devicetree/bindings/dma/st,stm32-dma3.yaml
```yaml
# SPDX-License-Identifier: (GPL-2.0-only OR BSD-2-Clause)
%YAML 1.2
---
$id: http://devicetree.org/schemas/dma/st,stm32-dma3.yaml#
$schema: http://devicetree.org/meta-schemas/core.yaml#

title: STMicroelectronics STM32 DMA3 Controller

description: |
  The STM32 DMA3 is a direct memory access controller with different features
  depending on its hardware configuration.
  It is either called LPDMA (Low Power), GPDMA (General Purpose) or
  HPDMA (High Performance).
  Its hardware configuration registers allow to dynamically expose its features.

  GPDMA and HPDMA support 16 independent DMA channels, while only 4 for LPDMA.
  GPDMA and HPDMA supports 256 DMA requests from peripherals, 8 for LPDMA.

  Bindings are generic for the 3 DMA3 configurations.

  DMA clients connected to the STM32 DMA3 controller must use the format described
  in the dma.txt file, using a four-cell specifier for each channel.
  A phandle to the DMA controller plus the following four integer cells:
    1. The request line number
    2. A 32-bit mask specifying the DMA channel requirements
      -bit 0-1: The priority level
        0x0: low priority, low weight
        0x1: low priority, mid weight
        0x2: low priority, high weight
        0x3: high priority
      -bit 4-7: The FIFO requirement for queuing source and destination transfers
        0x0: no FIFO requirement/any channel can fit
        0x2: FIFO of 8 bytes (2^2+1)
        0x4: FIFO of 32 bytes (2^4+1)
        0x6: FIFO of 128 bytes (2^6+1)
    3. A 32-bit mask specifying the DMA transfer requirements
      -bit 0: The source incrementing burst
        0x0: fixed burst
        0x1: contiguously incremented burst
      -bit 1: The source allocated port
        0x0: port 0 is allocated to the source transfer
        0x1: port 1 is allocated to the source transfer
      -bit 4: The destination incrementing burst
        0x0: fixed burst
        0x1: contiguously incremented burst
      -bit 5: The destination allocated port
        0x0: port 0 is allocated to the destination transfer
        0x1: port 1 is allocated to the destination transfer
      -bit 8: The type of hardware request
        0x0: burst
        0x1: block
      -bit 9: The control mode
        0x0: DMA controller control mode
        0x1: peripheral control mode
      -bit 12-13: The transfer complete event mode
        0x0: at block level
        0x2: at LLI level
        0x3: at channel level (last LLI)
    4. A 32-bit mask specifying the DMA transfer extended requirements
      -bit 0-12: The source address offset increment
      -bit 13: The source address increment type
        0x0: source address incremented by adding the source address offset
        0x1: source address decremented by substracting the source address offset
      -bit 14-15: The block alignment mode
        0x0: address offset and block size are programmed in number of bytes
        0x1: address offset and block size are programmed in multiple of 16 bytes
        0x2: address offset and block size are programmed in multiple of 256 bytes
      -bit 16-28: The destination address offset increment
      -bit 29: The destination address increment type
        0x0: destination address incremented by adding the destination address offset
        0x1: destination address decremented by substracting the destination address offset

maintainers:
  - Amelie Delaunay <amelie.delaunay@foss.st.com>

allOf:
  - $ref: "dma-controller.yaml#"

properties:
  "#dma-cells":
    const: 4

  compatible:
    const: st,stm32-dma3

  reg:
    maxItems: 1

  clocks:
    maxItems: 1

  resets:
    maxItems: 1

  interrupts:
    minItems: 4
    maxItems: 16

required:
  - compatible
  - reg
  - clocks
  - interrupts

unevaluatedProperties: false

examples:
  - |
    #include <dt-bindings/interrupt-controller/arm-gic.h>
    #include <dt-bindings/clock/stm32mp25-clks.h>
    dma-controller@40400000 {
      compatible = "st,stm32-dma3";
      reg = <0x40400000 0x1000>;
      interrupts = <GIC_SPI 33 IRQ_TYPE_LEVEL_HIGH>,
                   <GIC_SPI 34 IRQ_TYPE_LEVEL_HIGH>,
                   <GIC_SPI 35 IRQ_TYPE_LEVEL_HIGH>,
                   <GIC_SPI 36 IRQ_TYPE_LEVEL_HIGH>,
                   <GIC_SPI 37 IRQ_TYPE_LEVEL_HIGH>,
                   <GIC_SPI 38 IRQ_TYPE_LEVEL_HIGH>,
                   <GIC_SPI 39 IRQ_TYPE_LEVEL_HIGH>,
                   <GIC_SPI 40 IRQ_TYPE_LEVEL_HIGH>,
                   <GIC_SPI 41 IRQ_TYPE_LEVEL_HIGH>,
                   <GIC_SPI 42 IRQ_TYPE_LEVEL_HIGH>,
                   <GIC_SPI 43 IRQ_TYPE_LEVEL_HIGH>,
                   <GIC_SPI 44 IRQ_TYPE_LEVEL_HIGH>,
                   <GIC_SPI 45 IRQ_TYPE_LEVEL_HIGH>,
                   <GIC_SPI 46 IRQ_TYPE_LEVEL_HIGH>,
                   <GIC_SPI 47 IRQ_TYPE_LEVEL_HIGH>,
                   <GIC_SPI 48 IRQ_TYPE_LEVEL_HIGH>;
      clocks = <&rcc CK_BUS_HPDMA1>;
      #dma-cells = <4>;
    };
...
```

## Documentation/devicetree/bindings/gpio/digi,mca-gpio.txt
```
* Digi GPIO controller for MCA of ConnectCore device tree bindings

Required properties:
- compatible : must be one of
    - "digi,mca-cc6ul-gpio"
    - "digi,mca-ioexp-gpio"
    - "digi,mca-cc8x-gpio"
    - "digi,mca-cc8m-gpio"

- #gpio-cells : Should be two.
  - first cell is the pin number
  - second cell is used to specify flags. Flags are currently unused.

- gpio-controller : Marks the device node as a GPIO controller.

- interrupt-parent:     Phandle for the interrupt controller that
                        services interrupts for this device.
- interrupt-controller: Empty boolean property which marks the GPIO
                        module as an IRQ controller.
- #interrupt-cells:     Should be <2>.  The first cell is the GPIO number,
                        the second should specify the flags.

Optional properties:
- pwroff-wakeup-capable-ios : List of MCA IOs that can wakeup the device from
                              power off state. Note that only those IOs that
                              are IRQ capable can wake up the system from low
                              power modes.
                              If the property is not provided, all MCA IOs are
                              configured to wake up the system from power off,
                              if the irq is enabled by the kernel.

Examples:

	mca_cc6ul: mca@7e {
		mca_gpio: gpio {
			compatible = "digi,mca-cc6ul-gpio";
			gpio-controller;
			#gpio-cells = <2>;

			interrupt-parent = <&mca_cc6ul>;
			interrupt-controller;
			#interrupt-cells = <2>;
		};
	};

	mca_cc8x: mca@63 {
		mca_gpio: gpio {
			compatible = "digi,mca-cc8x-gpio";
			gpio-controller;
			#gpio-cells = <2>;

			interrupt-parent = <&mca_cc8x>;
			interrupt-controller;
			#interrupt-cells = <2>;
		};
	};

	mca_cc8m: mca@63 {
		mca_gpio: gpio {
			compatible = "digi,mca-cc8m-gpio";
			gpio-controller;
			#gpio-cells = <2>;

			interrupt-parent = <&mca_cc8m>;
			interrupt-controller;
			#interrupt-cells = <2>;
		};
	};

	mca_ioexp: mca_io@6e {
		mca_ioexp_gpio: gpio {
			compatible = "digi,mca-ioexp-gpio";
			gpio-controller;
			#gpio-cells = <2>;

			interrupt-parent = <&mca_ioexp>;
			interrupt-controller;
			#interrupt-cells = <2>;
		};
	};
```

## Documentation/devicetree/bindings/gpio/fsl-imx-gpio.txt
```
* Freescale i.MX/MXC GPIO controller

Required properties:
- compatible : Should be "fsl,<soc>-gpio"
- reg : Address and length of the register set for the device
- interrupts : Should be the port interrupt shared by all 32 pins, if
  one number.  If two numbers, the first one is the interrupt shared
  by low 16 pins and the second one is for high 16 pins.
- gpio-controller : Marks the device node as a gpio controller.
- #gpio-cells : Should be two.  The first cell is the pin number and
  the second cell is used to specify the gpio polarity:
      0 = active high
      1 = active low
- interrupt-controller: Marks the device node as an interrupt controller.
- #interrupt-cells : Should be 2.  The first cell is the GPIO number.
  The second cell bits[3:0] is used to specify trigger type and level flags:
      1 = low-to-high edge triggered.
      2 = high-to-low edge triggered.
      4 = active high level-sensitive.
      8 = active low level-sensitive.

Optional properties:
- clocks: the clock for clocking the GPIO silicon
- pad-wakeup-num: Number of pads configured in the port as wake-up sources.
- pad-wakeup: List of pads configurations on the port. Every pad configuration
  consists of:
      pad: Pad identifier
      type: Wake-up type:
           0 = Off
           1 = Clear flag
           4 = Low level
           5 = Falling edge
           6 = Rising edge
           7 = High level
      line: GPIO line numer in the port.

Example:

gpio0: gpio@73f84000 {
	compatible = "fsl,imx51-gpio", "fsl,imx35-gpio";
	reg = <0x73f84000 0x4000>;
	interrupts = <50 51>;
	gpio-controller;
	#gpio-cells = <2>;
	interrupt-controller;
	#interrupt-cells = <2>;
};


&gpio4 {
	...
	/* Configure GPIO4_20 and GPIO4_21 for Falling Edge wakeup */
	pad-wakeup-num = <2>;
	pad-wakeup = <IMX8QXP_USDHC1_VSELECT 5 20>,
		     <IMX8QXP_USDHC1_WP 5 21>;
};
```
