## Documentation/devicetree/bindings/arm/digi.txt
```
Digi i.MX Platforms Device Tree Bindings
------------------------------------------

ConnectCard i.MX28 JumpStart Kit
Required root node properties:
    - compatible = "digi,ccardimx28js", "digi,ccardimx28", "fsl,imx28";

ConnectCard i.MX28 module
Required root node properties:
    - compatible = "digi,ccardimx28", "fsl,imx28";

ConnectPort X2
Required root node properties:
    - compatible = "digi,cpx2", "fsl,imx28";

ConnectCard 6 module
Required root node properties:
    - compatible = "digi,ccimx6", "fsl,imx6q";

ConnectCard 6 SBC
Required root node properties:
    - compatible = "digi,ccimx6sbc", "fsl,imx6q";
```

## Documentation/devicetree/bindings/bluetooth.txt
```
BLUETOOTH

Required properties: None.

Optional properties:

  - digi,pwrdown-gpios: GPIOs used to power down the bluetooth chip.
  - digi,pwrdown_delay: Delay in ms between power down GPIO toggling.
  - digi,disable-gpios: GPIOs used to disable the bluetooth chip.
  - digi,disable_delay: Delay in ms between disable GPIO toggling.

Example:

	bluetooth {
		digi,pwrdown-gpios = <&gpio_extender 4 0>;
		digi,disable-gpios = <&gpio1 9 0>;
		digi,pwrdown_delay = <5>;
		digi,disable_delay = <5>;
		/* U-Boot will fill in the MAC address here */
	}
```

## Documentation/devicetree/bindings/cpufreq/cpufreq-mxs.txt
```
MXS cpufreq driver
-------------------

MXS i.MX28 SoC cpufreq driver for CPU frequency scaling.

Required properties:
- cpufreq_tbl: Table of frequencies CPU could be transitioned into, in the
  increasing order.

Optional properties:
- clock-latency: Specify the possible maximum transition latency for clock, in
  unit of nanoseconds.

Both required and optional properties listed above must be defined under node
/cpus/cpu@0.

Examples:
--------
cpus {

        <...>

        cpu@0 {
                cpufreq {
                        compatible = "digi,mxs-cpufreq";
                        cpufreq_tbl = < 64000
                                        261818
                                        360000
                                        454736 >;

                        clock-latency = <1000>;
                };
        };


        <...>

};
```

## Documentation/devicetree/bindings/cpufreq/stm32-cpufreq.txt
```
STM32 CPUFreq and OPP bindings
==============================

STM32 CPUFreq driver needs to read chip information from the SoC to list
available OPPs. Then it depends on cpufreq-dt bindings.

Required properties:
--------------------
- clocks: Phandle to the cpu clock "cpu".
- clocks-name: Should contain "cpu".
- nvmem-cells: Phandle to nvmem cell that contains "part_number".
- nvmem-cell-names: Must be "part_number".
- operating-points-v2: Phandle to operating points table. See ../power/opp.txt
  for more details.

Optional properties:
--------------------
See cpufreq-dt.txt for optional properties.

Examples:
---------
	cpus {
		#address-cells = <1>;
		#size-cells = <0>;

		cpu0: cpu@0 {
			compatible = "arm,cortex-a7";
			device_type = "cpu";
			reg = <0>;
			clocks = <&rcc CK_MPU>;
			clock-names = "cpu";
			operating-points-v2 = <&cpu0_opp_table>;
			nvmem-cells = <&part_number_otp>;
			nvmem-cell-names = "part_number";
		};

		cpu1: cpu@1 {
			compatible = "arm,cortex-a7";
			device_type = "cpu";
			reg = <1>;
			clocks = <&rcc CK_MPU>;
			clock-names = "cpu";
			operating-points-v2 = <&cpu0_opp_table>;
		};
	};

	cpu0_opp_table: cpu0-opp-table {
		compatible = "operating-points-v2";
		opp-shared;

		opp-650000000 {
			opp-hz = /bits/ 64 <650000000>;
			opp-microvolt = <1200000>;
			opp-supported-hw = <0x1>;
		};
		opp-800000000 {
			opp-hz = /bits/ 64 <800000000>;
			opp-microvolt = <1350000>;
			opp-supported-hw = <0x2>;
		};
	};
```

## Documentation/devicetree/bindings/digi,ath6kl,wireless.txt
```
WIRELESS

Required properties: None.

Optional properties:

  - digi,pwrdown-gpios: GPIOs used to power down the wireless chip.
  - digi,pwrdown_delay: Delay in ms between power down GPIO toggling.
  - ath6kl-p2p-enable: boolean to enable driver's 'p2p' support (wifi direct).
  - ath6kl-softmac-enable: boolean to enable setting interface's MAC address
                           from 'softmac' firmware file.

Example:

	wireless {
		digi,pwrdown-gpios = <&gpio_extender 3 0>;
		digi,pwrdown_delay = <5>;
		/* U-Boot will fill in the MAC address here */
	};
```

## Documentation/devicetree/bindings/display/bridge/digi,dummy_dsi_bridge.txt
```
Digi dummy MIPI-DSI bridge bindings

The MIPI-DSI host controller drives the video signals from
display controller to video peripherals using DSI protocol.
This is an un-managed DSI bridge. In order to use this bridge, an encoder
or bridge must be implemented to manage the platform specific initializations.

Required properties:
- compatible: 		"digi,dummy_dsi_bridge"
- port: 		input port node with endpoint definition as
			defined in Documentation/devicetree/bindings/graph.txt;
			the input port should be connected to a MIPI-DSI device
			driver

Optional properties:
- dsi-lanes:		number of DSI lanes to be used. Must be <1> to <4>.
			Default value is <4>.
- video-mode		video data transfer mode. Must be <0> or <1> as follows:
			    <0>: Video burst mode
			    <1>: Video pulse mode
			Default value is <1>.
- display-timings:	timings for the connected panel according to [1]

[1]: Documentation/devicetree/bindings/display/display-timing.txt

Example:
	dummy_dsi_bridge {
		compatible = "digi,dummy_dsi_bridge";
		dsi-lanes = <4>;
		video-mode = <1>;
		status = "okay";

		display-timings {
			native-mode = <&display>;

			display: timing@0 {
				clock-frequency = <31500000>;
				hactive = <640>;
				vactive = <480>;
				hback-porch = <4>;
				hfront-porch = <10>;
				vback-porch = <34>;
				vfront-porch = <20>;
				hsync-len = <2>;
				vsync-len = <2>;
				hsync-active = <0>;
				vsync-active = <0>;
				de-active = <0>;
				pixelclk-active = <0>;
			};
		};
		port {
			dummy_dsi_bridge_in: endpoint {
				remote-endpoint = <&mipi_dsi_out>;
			};
		};
	};
```

## Documentation/devicetree/bindings/display/bridge/lontium,lt8912.txt
```
Lontium LT8912 MIPI-DSI to LVDS and HDMI/MHL bridge bindings

Required properties:
 - compatible: "lontium,lt8912"
 - reg: virtual channel id
 - reset-gpios: a GPIO spec for the reset pin
 - i2c-bus: phandle of an I2C controller used for register access
 - display-timings : Refer to binding doc display-timing.txt for details
 - digi,dsi-lanes: number of DSI lanes used by the bridge, a whole number
                   between 1 and 4 (both inclusive)
 - no-hpd: disable hot-plug detection, assumes display always connected
 - no-edid: do not use EDID modes, use the display-timings provided in the dt

Optional properties:
 - vdd1-supply: Power supply for the lt8912 chip
 - vdd2-supply: Power supply for the lt8912 chip

Example:

&dsi {
	status = "okay";

	lt8912@0 {
		compatible = "lontium,lt8912";
		reg = <0>;
		reset-gpios = <&gpio0 RK_PA2 GPIO_ACTIVE_LOW>;
		i2c-bus = <&i2c1>;

		display-timings {
			native-mode = <&timing0>;

			timing0: timing0 {
				clock-frequency = <74250000>;
				hactive = <1280>;
				vactive = <720>;
				hfront-porch = <110>;
				hsync-len = <40>;
				hback-porch = <220>;
				vfront-porch = <5>;
				vsync-len = <5>;
				vback-porch = <20>;
				hsync-active = <0>;
				vsync-active = <0>;
				de-active = <0>;
				pixelclk-active = <0>;
			};
		};
	};
};
```

## Documentation/devicetree/bindings/display/panel/forcelead,fl7703ni.yaml
```yaml
# SPDX-License-Identifier: GPL-2.0
%YAML 1.2
---
$id: http://devicetree.org/schemas/display/panel/forcelead,fl7703ni.yaml#
$schema: http://devicetree.org/meta-schemas/core.yaml#

title: Forcelead FL7703NI based LCD panels

maintainers:
  - Arturo Buzarra <arturo.buzarra@digi.com>
  - Gonzalo Ruiz <gonzalo.ruiz@digi.com>

description: |
  FL7703NI designed for small and medium sizes of TFT LCD display, is
  capable of supporting up to 720RGBx2047 in resolution. It provides
  several system interfaces like MIPI/SPI and is able to operate with
  either 1, 2, 3 or 4 data lanes.

  NewHaven NHD-3.5-640480EF-MSXP is 480x640, 4-lane MIPI DSI LCD panel
  which has built-in FL7703NI chip.

allOf:
  - $ref: panel-common.yaml#

properties:
  compatible:
    items:
      - const: newhaven,nhd-3.5-640480ef-msxp

  reg:
    description: DSI virtual channel used by that screen
    maxItems: 1

  VCC-supply:
    description: analog regulator for MIPI circuit

  IOVCC-supply:
    description: I/O system regulator

  reset-gpios: true

  backlight: true

  dsi-lanes:
    description: Number of DSI lanes to be used can be 1 to 4
    $ref: /schemas/types.yaml#/definitions/uint32
    enum: [1, 2, 3, 4]

required:
  - compatible
  - reg
  - VCC-supply
  - IOVCC-supply
  - reset-gpios
  - dsi-lanes

additionalProperties: false

examples:
  - |
    #include <dt-bindings/gpio/gpio.h>

    dsi {
        #address-cells = <1>;
        #size-cells = <0>;

        panel@0 {
            compatible = "newhaven,nhd-3.5-640480ef-msxp";
            reg = <0>;
            VCC-supply = <&reg_5v_board>;
            IOVCC-supply = <&reg_3v3_board>;
            reset-gpios = <&gpiod 7 GPIO_ACTIVE_HIGH>;
            dsi-lanes = <4>;
        };
    };
```

## Documentation/devicetree/bindings/display/panel/rocktech,hx8394.yaml
```yaml
# SPDX-License-Identifier: (GPL-2.0-only OR BSD-2-Clause)
%YAML 1.2
---
$id: http://devicetree.org/schemas/display/panel/rocktech,hx8394.yaml#
$schema: http://devicetree.org/meta-schemas/core.yaml#

title: Rocktech Semiconductor Corporation HX8394 5.5" 720p MIPI-DSI TFT LCD panel

maintainers:
  - YANNICK FERTRE <yannick.fertre@foss.st.com>

description: |
  The Rocktech Semiconductor Corporation HX8394 is a 5.5" 720x1280 TFT LCD
  panel connected using a MIPI-DSI video interface.

allOf:
  - $ref: panel-common.yaml#

properties:

  compatible:
    const: rocktech,hx8394

  reg:
    maxItems: 1
    description: DSI virtual channel

  backlight: true
  enable-gpios: true
  port: true
  power-supply: true

  reset-gpios:
    maxItems: 1

additionalProperties: false

required:
  - compatible
  - power-supply
  - reg

examples:
  - |
    dsi {
      #address-cells = <1>;
      #size-cells = <0>;
      panel@0 {
        compatible = "rocktech,hx8394";
        reg = <0>;
        reset-gpios = <&gpiof 15 0>;
        power-supply = <&v1v8>;
        backlight = <&pwm_backlight>;
      };
    };
...
```

## Documentation/devicetree/bindings/display/panel/xiamen,xm91080.yaml
```yaml
# SPDX-License-Identifier: GPL-2.0
%YAML 1.2
---
$id: http://devicetree.org/schemas/display/panel/xiamen,xm91080.yaml#
$schema: http://devicetree.org/meta-schemas/core.yaml#

title: Xiamen XM91080 based LCD panels

maintainers:
  - Gonzalo Ruiz <gonzalo.ruiz@digi.com>

description: |
  XM91080 designed for small and medium sizes of TFT LCD displays, is
  capable of supporting up to 1080RGBx2400 in resolution. It provides
  MIPI interface and is able to operate with either 2, 3 or 4 data lanes.

  FocusLCDs E55RB-I-MW346-C is 1080x1920, 4-lane MIPI DSI LCD panel
  which has built-in XM91080 chip.

allOf:
  - $ref: panel-common.yaml#

properties:
  compatible:
    items:
      - const: focus,e55rb-i-mw346-c

  reg:
    description: DSI virtual channel used by that screen
    maxItems: 1

  VCC-supply:
    description: analog regulator for MIPI circuit

  IOVCC-supply:
    description: I/O system regulator

  reset-gpios: true

  backlight: true

required:
  - compatible
  - reg
  - VCC-supply
  - IOVCC-supply
  - reset-gpios

additionalProperties: false

examples:
  - |
    #include <dt-bindings/gpio/gpio.h>

    dsi {
        #address-cells = <1>;
        #size-cells = <0>;

        panel@0 {
            compatible = "focus,e55rb-i-mw346-c";
            reg = <0>;
            VCC-supply = <&reg_5v_board>;
            IOVCC-supply = <&reg_3v3_board>;
            reset-gpios = <&gpiod 7 GPIO_ACTIVE_HIGH>;
        };
    };
```
