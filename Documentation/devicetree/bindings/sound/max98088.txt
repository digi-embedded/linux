## Documentation/devicetree/bindings/sound/max98088.txt
```
MAX98088/MAX98089 audio CODEC

This device supports I2C only.

Required properties:

- compatible : "maxim,max98088" or "maxim,max98089".

- reg : The I2C address of the device.

- interrupts : The CODEC's interrupt output.

Optional properties:

- clocks: The phandle of the master clock to the CODEC

- clock-names: Should be "mclk"

- vcc-supply: regulator spec, providing 3.3V
- dvdd-supply: regulator spec, providing 1.8V

Pins on the device (for linking into audio routes):

  * MIC1
  * MIC2
  * INA1
  * INA2
  * INB1
  * INB2
  * HPL
  * HPR
  * SPKL
  * SPKR
  * RECL
  * RECR
  * MICBIAS

Example:

audio-codec@10 {
	compatible = "maxim,max98089";
	reg = <0x10>;
	interrupt-parent = <&gpio>;
	interrupts = <TEGRA_GPIO(H, 4) GPIO_ACTIVE_HIGH>;
	vcc-supply = <&reg_3v3_audio>;
	dvdd-supply = <&reg_1v8_ext>;
};
```

## Documentation/devicetree/bindings/usb/st,typec-stm32g0.yaml
```yaml
# SPDX-License-Identifier: (GPL-2.0 OR BSD-2-Clause)
%YAML 1.2
---
$id: "http://devicetree.org/schemas/usb/st,typec-stm32g0.yaml#"
$schema: "http://devicetree.org/meta-schemas/core.yaml#"

title: STMicroelectronics STM32G0 Type-C controller bindings

description: |
  The STM32G0 MCU can be programmed to control Type-C connector(s) through I2C
  typically using the UCSI protocol over I2C, with a dedicated alert
  (interrupt) pin.

maintainers:
  - Fabrice Gasnier <fabrice.gasnier@foss.st.com>

properties:
  compatible:
    const: st,stm32g0-typec

  reg:
    maxItems: 1

  interrupts:
    maxItems: 1

  connector:
    type: object
    allOf:
      - $ref: ../connector/usb-connector.yaml#

  firmware-name:
    description: |
      Should contain the name of the default firmware image
      file located on the firmware search path

  wakeup-source: true
  power-domains: true

required:
  - compatible
  - reg
  - interrupts

additionalProperties: false

examples:
  - |
    #include <dt-bindings/interrupt-controller/irq.h>
    i2c5 {
      #address-cells = <1>;
      #size-cells = <0>;

      stm32g0@53 {
        compatible = "st,stm32g0-typec";
        reg = <0x53>;
        /* Alert pin on GPIO PE12 */
        interrupts = <12 IRQ_TYPE_EDGE_FALLING>;
        interrupt-parent = <&gpioe>;

        /* Example with one type-C connector */
        connector {
          compatible = "usb-c-connector";
          label = "USB-C";

          port {
            con_usb_c_ep: endpoint {
              remote-endpoint = <&usbotg_hs_ep>;
            };
          };
        };
      };
    };

    usbotg_hs {
      usb-role-switch;
      port {
        usbotg_hs_ep: endpoint {
          remote-endpoint = <&con_usb_c_ep>;
        };
      };
    };
...
```

## Documentation/devicetree/bindings/usb/usbmisc-imx.txt
```
* Freescale i.MX non-core registers

Required properties:
- #index-cells: Cells used to descibe usb controller index. Should be <1>
- compatible: Should be one of below:
	"fsl,imx6q-usbmisc" for imx6q
- reg: Should contain registers location and length

Optional properties:
- fsl,over-current-polarity-active-low: boolean; Indicates the polarity of the
  OTG overcurrent line is active low.
- fsl,power-line-polarity-active-high: boolean; Indicates the polarity of the
  OTG power line is active high.

Examples:
usbmisc@02184800 {
	#index-cells = <1>;
	compatible = "fsl,imx6q-usbmisc";
	reg = <0x02184800 0x200>;
};
```

## Documentation/devicetree/bindings/video/mxc_ad9389_hdmi_video.txt
```
Device-Tree bindings for the ad9389 hdmi video driver

The ad9389 I2C device inherits the i2c-imx properties.

Required properties:
- compatible: value should be "ad,ad9889b-i2c".
- ad,edid_addr: I2C client address to read EDID data.
- ipu_id: IPU ID (0/1) where the controller is connected to.
- disp_id: Display port ID (0/1) in the IPU.
- clocks: IPU0 and IPU1 clocks. See example below.
- clock-names: Clock names used by the driver to enable the corresponding IPU
  clocks. See example below.

Optional properties:
- display: phandle to user specified display timings. To use them, the
  framebuffer device should pass the timings node name in the mode_str.
- ad,debounce_ms: Time to debounce after interrupt, in milliseconds.

This device supports the following framebuffer mode strings settings:

mode_str = "auto"            : This will read the EDID and use the monitor's
			       preferred mode.
mode_str = "<video options>" : This will try to match the video options against
			       the modedb database, and best match the monitor's
                               edid data.
mode_str = "<display name>"  : This will use the user specified display timings.
                               The <display name> must match a display node.
                               This force mode will ignore edid data.

The mxc framebuffer node must set:

	disp_dev = "hdmi_ad9389";

in order to use this display driver.

Example:

	hdmi_ad9389: ad9889b@39 {
		compatible = "ad,ad9889b-i2c";
		reg = <0x39>;
		pinctrl-names = "default";
		pinctrl-0 = <&pinctrl_ipu2_3>;
		interrupt-parent = <&gpio2>;
		interrupts = <1 GPIO_ACTIVE_HIGH>;
		ad,edid_addr = <0x3f>; /* 0x7e >> 1*/
		ipu_id = <1>;
		disp_id = <0>;
		clocks = <&clks 131>, <&clks 132>,
			 <&clks 134>, <&clks 137>,
			 <&clks 39>, <&clks 40>,
			 <&clks 41>, <&clks 44>;
		clock-names = "ipu1_di0", "ipu1_di1",
			      "ipu2_di0", "ipu2_di1",
			      "ipu1_di0_sel", "ip11_di1_sel",
			      "ipu2_di0_sel", "ip12_di1_sel";
	};

	&mxcfb1 {
		disp_dev = "hdmi_ad9389";
		mode_str = "auto";
		/*mode_str = "1920x1080@60";*/
	};

Example of forced mode:

	&hdmi_ad9389 {
		display = <&ad9389_1920x1080>;
	}

	&mxcfb1 {
		mode_str ="HDMI_1920_1080";
	}

	ad9389_1920x1080: HDMI_1920_1080@0 {
		display-timings {
			timing {
				clock-frequency = <130992926>; /* 7634 ps*/
				hactive = <1920>;
				vactive = <1080>;
				hfront-porch = <88>;
				hback-porch = <148>;
				hsync-len = <44>;
				vback-porch = <36>;
				vfront-porch = <4>;
				vsync-len = <5>;
			};
		};
	};
```

## Documentation/devicetree/bindings/watchdog/digi,mca-gpio-wdt.txt
```
* Digi MCA Watchdog timer (GPIO-refreshed) for ConnectCore SOMs

Features:
       - Allow to configure up to 4 GPIOs to kick the watchdog timer.
       - Configurable hw_algo: toggle, level_high and level_low.
       - Configurable timeout value (1-255 seconds).
       - way-out, no-way-out configuration option.

Required properties:
- compatible: must be one of
  "digi,mca-cc8x-gpio-wdt"
  "digi,mca-cc8m-gpio-wdt"

Subcomponents:

Required properties:
- mode: one of: toggle, level-high, level-low
- mca-io-number: MCA GPIO to kick the watchdog timer
- timeout-sec: contains the watchdog timeout in seconds.

Optional properties:
- irq-no-reset: if present, the watchdog will generate an interrupt instead
	of a system reset.
- full-reset: if present, the watchdog will perform a full system reset,
        including the MCA. Otherwise, only the microprocessor is reset. Note
        that this option requires the system to be configured to generate a
        reset and not an interrupt.
- no-way-out: if present, the watchdog can't be stopped once started.

Example:
	mca_cc8x: mca-@63 {
		gpio_wdt: gpio-wdt {
			compatible = "digi,mca-cc8x-gpio-wdt";
			status = "okay";

			gpio_wdt0: gpio-wdt@0x210 {
				full-reset;
				no-way-out;
				/* mode; one of: toggle, level-high, level-low */
				mode = "level-high";
				mca-io-number = <10>;
				timeout-sec = <2>;
				status = "okay";
			};

			gpio_wdt1: gpio-wdt@0x220 {
				full-reset;
				no-way-out;
				/* mode; one of: toggle, level-high, level-low */
				mode = "toggle";
				mca-io-number = <16>;
				timeout-sec = <1>;
				status = "okay";
			};

			gpio_wdt2: gpio-wdt@0x230 {
				status = "disabled";
			};

			gpio_wdt3: gpio-wdt@0x240 {
				status = "disabled";
			};
		};
	};
```

## Documentation/devicetree/bindings/watchdog/digi,mca-wdt.txt
```
* Digi MCA Watchdog timer (software-refreshed) for ConnectCore SOMs

Required properties:
- compatible: must be one of
  "digi,mca-cc6ul-wdt"
  "digi,mca-cc8x-wdt"
  "digi,mca-cc8m-wdt"

Optional properties:
- digi,timeout-sec: contains the watchdog timeout in seconds.
- digi,irq-no-reset: if present, the watchdog will generate an interrupt instead
	of a system reset.
- digi,full-reset: if present, the watchdog will perform a full system reset,
        including the MCA. Otherwise, only the microprocessor is reset. Note
        that this option requires the system to be configured to generate a
        reset and not an interrupt.

Example:
	mca_cc6ul: mca-@7e {
		watchdog {
			compatible = "digi,mca-cc6ul-wdt";
			digi,timeout-sec = <15>;
			digi,full-reset;
		};
	};

	mca_cc8x: mca-@63 {
		watchdog {
			compatible = "digi,mca-cc8x-wdt";
			digi,timeout-sec = <15>;
			digi,full-reset;
		};
	};

	mca_cc8m: mca-@63 {
		watchdog {
			compatible = "digi,mca-cc8m-wdt";
			digi,timeout-sec = <15>;
			digi,full-reset;
		};
	};
```

## Documentation/devicetree/bindings/watchdog/mca-cc6ul-wdt.txt
```
* Digi Watchdog Timer for MCA of ConnectCore 6UL

Required properties:
- compatible: must be "digi,mca-cc6ul-wdt".

Optional properties:
- digi,timeout-sec: contains the watchdog timeout in seconds.
- digi,irq-no-reset: if present, the watchdog will generate an interrupt instead
	of a system reset.
- digi,full-reset: if present, the watchdog will perform a full system reset,
        including the MCA. Otherwise, only the microprocessor is reset. Note
        that this option requires the system to be configured to generate a
        reset and not an interrupt.

Example:
	mca: mca-cc6ul@7e {
		watchdog {
			compatible = "digi,mca-cc6ul-wdt";
			digi,timeout-sec = <15>;
			digi,irq-no-reset;
		};
	};
```

## Documentation/devicetree/bindings/wireless.txt
```
WIRELESS

Required properties: None.

Optional properties:

  - digi,pwrdown-gpios: GPIOs used to power down the wireless chip.
  - digi,pwrdown_delay: Delay in ms between power down GPIO toggling.

Example:

	wireless {
		digi,pwrdown-gpios = <&gpio_extender 3 0>;
		digi,pwrdown_delay = <5>;
		/* U-Boot will fill in the MAC address here */
	};
```

## Documentation/devicetree/bindings/xbee.txt
```
XBEE

Required properties: None.

Optional properties:

  - digi,reset-gpio: GPIO used to reset the XBee.

Example:

	xbee {
		digi,reset-gpio = <&mca_ioexp_gpio 7 GPIO_ACTIVE_HIGH>;
	};
```

## arch/arm/configs/ccimx6sbc_tiny_defconfig
```kconfig
CONFIG_KERNEL_XZ=y
CONFIG_NO_HZ=y
CONFIG_HIGH_RES_TIMERS=y
CONFIG_BLK_DEV_INITRD=y
CONFIG_CC_OPTIMIZE_FOR_SIZE=y
CONFIG_EMBEDDED=y
CONFIG_SLOB=y
CONFIG_ARCH_MXC=y
CONFIG_SOC_IMX6Q=y
CONFIG_SOC_IMX6SL=y
CONFIG_SMP=y
CONFIG_VMSPLIT_2G=y
CONFIG_AEABI=y
CONFIG_CPU_IDLE=y
CONFIG_VFP=y
CONFIG_NEON=y
CONFIG_DEVTMPFS=y
CONFIG_DEVTMPFS_MOUNT=y
CONFIG_PROC_DEVICETREE=y
CONFIG_SERIAL_IMX=y
CONFIG_SERIAL_IMX_CONSOLE=y
# CONFIG_MXC_GPU_VIV is not set
```

## arch/arm/configs/ccimx6ul_mfg_defconfig
```kconfig
CONFIG_KERNEL_LZO=y
CONFIG_SYSVIPC=y
CONFIG_NO_HZ=y
CONFIG_HIGH_RES_TIMERS=y
CONFIG_IKCONFIG=y
CONFIG_IKCONFIG_PROC=y
CONFIG_LOG_BUF_SHIFT=18
CONFIG_CGROUPS=y
CONFIG_RELAY=y
CONFIG_BLK_DEV_INITRD=y
# CONFIG_RD_LZMA is not set
# CONFIG_RD_XZ is not set
# CONFIG_RD_LZ4 is not set
CONFIG_EXPERT=y
CONFIG_KALLSYMS_ALL=y
CONFIG_PERF_EVENTS=y
# CONFIG_SLUB_DEBUG is not set
# CONFIG_COMPAT_BRK is not set
CONFIG_MODULES=y
CONFIG_MODULE_UNLOAD=y
CONFIG_MODVERSIONS=y
CONFIG_MODULE_SRCVERSION_ALL=y
# CONFIG_BLK_DEV_BSG is not set
CONFIG_ARCH_MXC=y
CONFIG_SOC_IMX6UL=y
CONFIG_HAVE_ARM_ARCH_TIMER=y
CONFIG_VMSPLIT_2G=y
CONFIG_PREEMPT=y
CONFIG_AEABI=y
CONFIG_HIGHMEM=y
CONFIG_CMA=y
CONFIG_CPU_FREQ=y
CONFIG_CPU_FREQ_DEFAULT_GOV_ONDEMAND=y
CONFIG_CPU_FREQ_GOV_POWERSAVE=y
CONFIG_CPU_FREQ_GOV_USERSPACE=y
CONFIG_CPU_FREQ_GOV_INTERACTIVE=y
CONFIG_CPU_FREQ_GOV_CONSERVATIVE=y
CONFIG_CPU_IDLE=y
CONFIG_VFP=y
CONFIG_NEON=y
CONFIG_BINFMT_MISC=m
CONFIG_PM_DEBUG=y
CONFIG_NET=y
CONFIG_PACKET=y
CONFIG_UNIX=y
# CONFIG_WIRELESS is not set
CONFIG_DEVTMPFS=y
CONFIG_DEVTMPFS_MOUNT=y
# CONFIG_STANDALONE is not set
# CONFIG_ALLOW_DEV_COREDUMP is not set
CONFIG_DMA_CMA=y
CONFIG_CMA_SIZE_MBYTES=0
CONFIG_CONNECTOR=y
CONFIG_BLK_DEV_RAM=y
CONFIG_BLK_DEV_RAM_SIZE=65536
CONFIG_EEPROM_AT24=y
CONFIG_SCSI=y
CONFIG_BLK_DEV_SD=y
CONFIG_NETDEVICES=y
# CONFIG_ETHERNET is not set
CONFIG_PHYLIB=y
CONFIG_SMSC_PHY=y
# CONFIG_USB_NET_DRIVERS is not set
# CONFIG_WLAN is not set
CONFIG_INPUT_POLLDEV=y
CONFIG_INPUT_MATRIXKMAP=y
# CONFIG_INPUT_MOUSEDEV is not set
CONFIG_INPUT_EVDEV=y
CONFIG_INPUT_EVBUG=m
# CONFIG_INPUT_KEYBOARD is not set
# CONFIG_INPUT_MOUSE is not set
CONFIG_SERIO_SERPORT=m
CONFIG_VT_HW_CONSOLE_BINDING=y
# CONFIG_LEGACY_PTYS is not set
# CONFIG_DEVKMEM is not set
CONFIG_SERIAL_IMX=y
CONFIG_SERIAL_IMX_CONSOLE=y
CONFIG_FSL_OTP=y
# CONFIG_HW_RANDOM is not set
CONFIG_I2C=y
# CONFIG_I2C_COMPAT is not set
CONFIG_I2C_CHARDEV=y
CONFIG_I2C_MUX=y
# CONFIG_I2C_HELPER_AUTO is not set
CONFIG_I2C_ALGOBIT=y
CONFIG_I2C_ALGOPCF=m
CONFIG_I2C_ALGOPCA=m
CONFIG_I2C_IMX=y
CONFIG_PPS=y
CONFIG_GPIO_SYSFS=y
CONFIG_GPIO_MCA_CC6UL=y
CONFIG_POWER_SUPPLY=y
CONFIG_POWER_RESET=y
# CONFIG_HWMON is not set
# CONFIG_HID is not set
# CONFIG_USB_HID is not set
CONFIG_USB=y
CONFIG_USB_OTG_WHITELIST=y
CONFIG_USB_OTG_FSM=y
CONFIG_USB_EHCI_HCD=y
CONFIG_USB_EHCI_MXC=y
CONFIG_USB_HCD_TEST_MODE=y
CONFIG_USB_ACM=m
CONFIG_USB_STORAGE=y
CONFIG_USB_CHIPIDEA=y
CONFIG_USB_CHIPIDEA_UDC=y
CONFIG_USB_CHIPIDEA_HOST=y
CONFIG_USB_SERIAL=m
CONFIG_USB_SERIAL_GENERIC=y
CONFIG_USB_SERIAL_FTDI_SIO=m
CONFIG_USB_SERIAL_OPTION=m
CONFIG_USB_EHSET_TEST_FIXTURE=y
CONFIG_NOP_USB_XCEIV=y
CONFIG_USB_MXS_PHY=y
CONFIG_USB_GADGET=y
CONFIG_USB_CONFIGFS=m
CONFIG_USB_CONFIGFS_SERIAL=y
CONFIG_USB_CONFIGFS_ACM=y
CONFIG_USB_CONFIGFS_OBEX=y
CONFIG_USB_CONFIGFS_NCM=y
CONFIG_USB_CONFIGFS_RNDIS=y
CONFIG_USB_CONFIGFS_MASS_STORAGE=y
CONFIG_USB_CONFIGFS_F_LB_SS=y
CONFIG_USB_CONFIGFS_F_FS=y
CONFIG_USB_MASS_STORAGE=m
# CONFIG_MXC_GPU_VIV is not set
CONFIG_DMADEVICES=y
CONFIG_MXC_PXP_V2=y
CONFIG_MXC_PXP_V3=y
CONFIG_IMX_SDMA=y
CONFIG_MXS_DMA=y
# CONFIG_IOMMU_SUPPORT is not set
# CONFIG_RESET_GPIO is not set
# CONFIG_FILE_LOCKING is not set
# CONFIG_DNOTIFY is not set
# CONFIG_INOTIFY_USER is not set
CONFIG_VFAT_FS=y
CONFIG_TMPFS=y
# CONFIG_MISC_FILESYSTEMS is not set
# CONFIG_NETWORK_FILESYSTEMS is not set
CONFIG_NLS_DEFAULT="cp437"
CONFIG_NLS_CODEPAGE_437=y
CONFIG_NLS_ASCII=y
CONFIG_NLS_ISO8859_1=y
CONFIG_NLS_UTF8=y
# CONFIG_ENABLE_WARN_DEPRECATED is not set
# CONFIG_ENABLE_MUST_CHECK is not set
# CONFIG_SCHED_DEBUG is not set
# CONFIG_DEBUG_PREEMPT is not set
# CONFIG_DEBUG_BUGVERBOSE is not set
# CONFIG_RCU_CPU_STALL_INFO is not set
# CONFIG_FTRACE is not set
# CONFIG_ARM_UNWIND is not set
# CONFIG_CRYPTO_MANAGER_DISABLE_TESTS is not set
CONFIG_CRYPTO_XTS=y
CONFIG_CRYPTO_CRC32C=y
CONFIG_CRYPTO_MD5=y
CONFIG_CRYPTO_SHA1=y
CONFIG_CRYPTO_SHA256=y
CONFIG_CRYPTO_SHA512=y
CONFIG_CRYPTO_DES=y
CONFIG_CRYPTO_LZO=y
# CONFIG_CRYPTO_ANSI_CPRNG is not set
# CONFIG_CRYPTO_HW is not set
CONFIG_CRC_CCITT=m
CONFIG_CRC16=y
CONFIG_CRC_T10DIF=y
CONFIG_CRC_ITU_T=m
CONFIG_CRC7=m
CONFIG_LIBCRC32C=m
```
