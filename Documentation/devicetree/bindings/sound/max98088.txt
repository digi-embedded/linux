## drivers/gpu/drm/bridge/digi/Kconfig
```kconfig
config DRM_DIGI_DUMMY_DSI_BRIDGE
	bool "Digi dummy MIPI DSI bridge"
	depends on OF
	select DRM_MIPI_DSI
	help
	  Digi dummy MIPI DSI bridge driver.
	  Select this driver to activate and configure MIPI DSI output.
```

## drivers/iio/tamper/Kconfig
```kconfig
#
# Tamper Devices
#

menu "Tamper devices"

config TAMPER_MCA
	tristate "Tamper support for MCA on Digi ConnectCore SOMs"
	select MFD_MCA
	help
	  Say Y here to build the tamper driver on the MCA of the
	  ConnectCore system-on-modules.

	  To compile this driver as a module, choose M here: the
	  module will be called mca_tamper

endmenu
```

## drivers/soc/st/Kconfig
```kconfig
if ARCH_STM32

config STM32_HOG
	tristate "STM32 hog"
	default y
	help
	  Say y to enable clock(s) at the start of the Kernel.

config STM32_PM_DOMAINS
	bool "STM32 PM domains"
	depends on MACH_STM32MP157
	select PM_GENERIC_DOMAINS
	default y if MACH_STM32MP157

config STM32MP_PM_DOMAIN
	tristate "STM32MP PM domain"
	select PM_GENERIC_DOMAINS
	default y

config STM32_RISAB
	tristate "STM32 RISAB"
	depends on ARM64 && DEBUG_FS
	default y
	help
	  Say y to enable RISAB dump debug helper driver. This creates an entry
	  in the debugfs to dump RISAB pages and blocks configurations. It
	  implicitly requires that the RISAB is clocked by a capable software
	  component.

config STM32_RISAF
	tristate "STM32 RISAF"
	depends on ARM64 && DEBUG_FS
	default y
	help
	  Say y to enable RISAF dump debug helper driver. This creates an entry
	  in the debugfs to dump RISAF memory regions configurations and
	  topology. It implicitly requires that the RISAF is clocked by a
	  capable software component.

endif # ARCH_STM32
```

## drivers/som/Kconfig
```kconfig
# SPDX-License-Identifier: GPL-2.0-only
menu "SoM drivers"

config SOM_CONNECTCORE
       bool "ConnectCore SoM"
       default n
       help
         Say yes for ConnectCore embedded SoMs.

endmenu
```
