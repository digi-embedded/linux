## Documentation/devicetree/bindings/leds/digi,mca-leds.yaml
```yaml
# SPDX-License-Identifier: (GPL-2.0-only OR BSD-2-Clause)
%YAML 1.2
---
$id: "http://devicetree.org/schemas/leds/digi,mca-leds.yaml#"
$schema: "http://devicetree.org/meta-schemas/core.yaml#"

title: Digi MCA LEDs controller

maintainers:
  - name: Digi International
    email: hector.palacios@digi.com

description: |
  LED controller provided by the Digi MCA (Micro Controller Assist).
  Each LED is represented as a sub-node and is backed by an MCA IO.

properties:
  compatible:
    const: digi,mca-led

  "#address-cells":
    const: 1

  "#size-cells":
    const: 0

patternProperties:
  "^led@[0-9a-f]+$":
    type: object
    description: MCA LED instance

    properties:
      reg:
        maxItems: 1
        description: Index of the MCA LED controller.

      io:
        $ref: /schemas/types.yaml#/definitions/uint32
        description: MCA IO number the LED is connected to.

      label:
        description: Human-readable LED name.

      active-low:
        type: boolean
        description: LED is active low.

      linux,default-trigger:
        description: Default LED trigger.

      led-pattern:
        description: |
          LED blinking pattern (on/off periods in milliseconds).
        $ref: /schemas/types.yaml#/definitions/uint32-array

      retain-state-suspended:
        type: boolean
        description: |
          Retain LED state during suspend. Applies to some triggers like
          default-on or timer.

      retain-state-shutdown:
        type: boolean
        description: Retain LED state during system shutdown.

      panic-indicator:
        type: boolean
        description: LED indicates kernel panic.

    required:
      - reg
      - io

    additionalProperties: false

required:
  - compatible
  - "#address-cells"
  - "#size-cells"

additionalProperties: false

examples:
  - |
    mca@63 {
        led {
            compatible = "digi,mca-led";
            #address-cells = <1>;
            #size-cells = <0>;

            led0: led@0 {
                reg = <0>;
                label = "power:green";
                io = <13>;
                linux,default-trigger = "default-on";
            };

            led1: led@1 {
                reg = <1>;
                label = "USER_LED1:green";
                io = <12>;
                linux,default-trigger = "timer";
                led-pattern = <100 1000>;
                retain-state-suspended;
            };

            led2: led@2 {
                reg = <2>;
                label = "USER_LED2:orange";
                io = <18>;
                linux,default-trigger = "timer";
                led-pattern = <5000 5000>;
                retain-state-suspended;
            };
        };
    };
```

## Documentation/devicetree/bindings/mfd/digi,mca-common.yaml
```yaml
# SPDX-License-Identifier: (GPL-2.0-only OR BSD-2-Clause)
%YAML 1.2
---
$id: "http://devicetree.org/schemas/mfd/digi,mca-common.yaml#"
$schema: "http://devicetree.org/meta-schemas/core.yaml#"

title: Digi Micro-Controller Assist common properties

maintainers:
  - name: Digi International
    email: hector.palacios@digi.com

description: |
  Common properties for Digi MCA (Micro Controller Assist) and related
  I2C-connected devices.

allOf:
  - $ref: /schemas/i2c/i2c-device.yaml#

properties:
  reg:
    description: I2C slave address
    maxItems: 1

  interrupt-parent:
    $ref: /schemas/types.yaml#/definitions/phandle

  interrupts:
    maxItems: 1

  interrupt-controller:
    type: boolean

  "#interrupt-cells":
    const: 2

  fw-update-gpios:
    maxItems: 1
    description: GPIO used to force firmware update mode

required:
  - reg
  - interrupt-parent
  - interrupts
  - interrupt-controller
  - "#interrupt-cells"

# Only *truly shared* subnodes here
patternProperties:
  "^gpio$":
    $ref: /schemas/gpio/digi,mca-gpio.yaml#

  "^rtc$":
    $ref: /schemas/rtc/digi,mca-rtc.yaml#

additionalProperties: true
```

## Documentation/devicetree/bindings/mfd/digi,mca-ioexp.yaml
```yaml
$id: "http://devicetree.org/schemas/mfd/digi,mca-ioexp.yaml#"

allOf:
  - $ref: /schemas/mfd/digi,mca-common.yaml#

properties:
  compatible:
    const: digi,mca-ioexp

  digi,restore-config-on-resume:
    type: boolean

patternProperties:
  "^gpio$":
    $ref: /schemas/gpio/digi,mca-gpio.yaml#

  "^adc$":
    $ref: /schemas/iio/adc/digi,mca-adc.yaml#

required:
  - compatible

unevaluatedProperties: false
```

## Documentation/devicetree/bindings/mfd/digi,mca-kl03.yaml
```yaml
$id: "http://devicetree.org/schemas/mfd/digi,mca-kl03.yaml#"

allOf:
  - $ref: /schemas/mfd/digi,mca-common.yaml#

properties:
  compatible:
    const: digi,mca-kl03

patternProperties:
  "^adc$":
    $ref: /schemas/iio/adc/digi,mca-adc.yaml#

  "^pwrkey$":
    $ref: /schemas/input/digi,mca-pwrkey.yaml#

  "^tamper$":
    $ref: /schemas/misc/digi,mca-tamper.yaml#

  "^uart$":
    $ref: /schemas/serial/digi,mca-uart.yaml#

  "^wdt$":
    $ref: /schemas/watchdog/digi,mca-wdt.yaml#

required:
  - compatible

unevaluatedProperties: false
```

## Documentation/devicetree/bindings/mfd/digi,mca-kl17.yaml
```yaml
$id: "http://devicetree.org/schemas/mfd/digi,mca-kl17.yaml#"

allOf:
  - $ref: /schemas/mfd/digi,mca-common.yaml#

properties:
  compatible:
    const: digi,mca-kl17

patternProperties:
  "^adc$":
    $ref: /schemas/iio/adc/digi,mca-adc.yaml#

  "^pwrkey$":
    $ref: /schemas/input/digi,mca-pwrkey.yaml#

  "^tamper$":
    $ref: /schemas/misc/digi,mca-tamper.yaml#

  "^uart$":
    $ref: /schemas/serial/digi,mca-uart.yaml#

  "^wdt$":
    $ref: /schemas/watchdog/digi,mca-wdt.yaml#

  "^pwms$":
    $ref: /schemas/pwm/digi,mca-pwm.yaml#

required:
  - compatible

unevaluatedProperties: false
```

## Documentation/devicetree/bindings/mfd/digi,mca-stm32u031.txt
```
* Digi ConnectCore 95 SMARC Micro-Controller Assist (MCA)

MCA consists of a varied group of sub-devices (I2C Only):

Device                   Description
------                   ------------
gpio                     IO pins (multiplexed with ADCs)
rtc                      Real-Time Clock

======

Required properties:

- compatible: must be "digi,mca-stm32u031".
- reg : Specifies the I2C slave address (this defaults to 0x20).
- interrupt-parent : Specifies the reference to the interrupt controller for
  the MCA.
- interrupts : IRQ line information.
- interrupt-controller

Optional properties:

- fw-update-gpio : Control GPIO for MCA firmware update.

Sub-nodes:

- gpio : This node defines settings for the GPIO pins associated with the MCA.
  Refer to binding at:
  "Documentation/devicetree/bindings/gpio/gpio-mca.txt"

- rtc : This node defines settings for the Real-Time Clock associated with
  the MCA. Refer to binding at:
  "Documentation/devicetree/bindings/rtc/digi,mca-rtc.txt"



Example:

	mca_cc95_smarc: mca@20 {
		compatible = "digi,mca-stm32u031";
		reg = <0x20>;
		interrupt-parent = <&wu>;
		interrupts = <GIC_SPI 177 IRQ_TYPE_EDGE_HIGH>;
		interrupt-controller;
		#interrupt-cells = <2>;
		fw-update-gpio = <&gpio3 9 GPIO_ACTIVE_LOW>;
		pinctrl-names = "default";
		pinctrl-0 = <&pinctrl_mca_cc95_smarc>;

		gpio {
			compatible = "digi,mca-gpio";
			gpio-controller;
			#gpio-cells = <2>;

			interrupt-parent = <&mca_cc95_smarc>;
			interrupt-controller;
			#interrupt-cells = <2>;

			/* Disable all mca GPIOs as power off wake up sources */
			pwroff-wakeup-capable-ios = <>;
		};
	};
```

## Documentation/devicetree/bindings/mfd/digi,mca-stm32u031.yaml
```yaml
$id: "http://devicetree.org/schemas/mfd/digi,mca-stm32u031.yaml#"

allOf:
  - $ref: /schemas/mfd/digi,mca-common.yaml#

properties:
  compatible:
    const: digi,mca-stm32u031

patternProperties:
  "^pwrkey$":
    $ref: /schemas/input/digi,mca-pwrkey.yaml#

required:
  - compatible

unevaluatedProperties: false
```

## Documentation/devicetree/bindings/pwm/digi,mca-pwm.yaml
```yaml
# SPDX-License-Identifier: (GPL-2.0-only OR BSD-2-Clause)
%YAML 1.2
---
$id: "http://devicetree.org/schemas/pwm/digi,mca-pwm.yaml#"
$schema: "http://devicetree.org/meta-schemas/core.yaml#"

title: Digi MCA PWM controllers

maintainers:
  - name: Digi International
    email: hector.palacios@digi.com

description: |
  Digi MCA PWM controller block. The child nodes represent individual PWM
  controllers (pwmchips) exposed by the MCA.

properties:
  compatible:
    const: digi,mca-pwm

  "#address-cells":
    const: 1

  "#size-cells":
    const: 0

patternProperties:
  "^pwm@[0-9a-f]+$":
    type: object
    description: MCA PWM controller instance

    properties:
      reg:
        description: Index of the MCA PWM controller.
        maxItems: 1

      pwm-channels:
        description:
          Number of channels provided by this PWM controller. The PWM period
          is common to all channels in the same controller.
        minimum: 1
        maxItems: 1

      "#pwm-cells":
        const: 3

    required:
      - reg
      - pwm-channels
      - "#pwm-cells"

    additionalProperties: false

required:
  - compatible
  - "#address-cells"
  - "#size-cells"

additionalProperties: false

examples:
  - |
    mca@63 {
        #address-cells = <1>;
        #size-cells = <0>;

        pwms {
            compatible = "digi,mca-pwm";
            #address-cells = <1>;
            #size-cells = <0>;

            pwm@0 {
                reg = <0>;
                pwm-channels = <6>;
                #pwm-cells = <3>;
            };

            pwm@1 {
                reg = <1>;
                pwm-channels = <2>;
                #pwm-cells = <3>;
            };

            pwm@2 {
                reg = <2>;
                pwm-channels = <2>;
                #pwm-cells = <3>;
            };
        };
    };
```

## Documentation/devicetree/bindings/rtc/digi,mca-rtc.yaml
```yaml
# SPDX-License-Identifier: (GPL-2.0-only OR BSD-2-Clause)
%YAML 1.2
---
$id: "http://devicetree.org/schemas/rtc/digi,mca-rtc.yaml#"
$schema: "http://devicetree.org/meta-schemas/core.yaml#"

title: Digi MCA Real Time Clock

maintainers:
  - name: Digi International
    email: hector.palacios@digi.com

description: |
  Real-time clock provided by the Digi MCA (Micro Controller Assist)
  on ConnectCore system-on-modules.

properties:
  compatible:
    const: digi,mca-rtc

required:
  - compatible

additionalProperties: false

examples:
  - |
    mca@7e {
        rtc {
            compatible = "digi,mca-rtc";
        };
    };
```

## Documentation/devicetree/bindings/serial/digi,mca-uart.yaml
```yaml
# SPDX-License-Identifier: (GPL-2.0-only OR BSD-2-Clause)
%YAML 1.2
---
$id: "http://devicetree.org/schemas/serial/digi,mca-uart.yaml#"
$schema: "http://devicetree.org/meta-schemas/core.yaml#"

title: Digi MCA UART controller

maintainers:
  - name: Digi International
    email: hector.palacios@digi.com

description: |
  UART block provided by the Digi MCA (Micro Controller Assist).
  The MCA exposes one or more UART instances as child nodes.

  These UARTs can be used to wake the system from low power modes, but they
  have more limited capabilities than the main CPU UART controllers.

properties:
  compatible:
    const: digi,mca-uart

  "#address-cells":
    const: 1

  "#size-cells":
    const: 0

patternProperties:
  "^serial@[0-9a-f]+$":
    type: object
    description: MCA UART instance

    properties:
      reg:
        description: MCA UART base address.
        maxItems: 1

      iopins-names:
        description: |
          Names of the MCA I/O pins assigned to this UART.
          At least "rx" and "tx" must be provided. Optional flow-control
          signals "rts", "cts" may also be provided.
        oneOf:
          - items:
              - const: rx
              - const: tx
          - items:
              - const: rx
              - const: tx
              - const: rts
          - items:
              - const: rx
              - const: tx
              - const: cts
              - const: rts

      iopins:
        description: |
          MCA I/O pin numbers corresponding to iopins-names.

          Not all MCA I/O pins can be used for all UART functions. Refer to
          the hardware documentation for valid pin/function mappings.
        minItems: 2
        maxItems: 4
        items:
          $ref: /schemas/types.yaml#/definitions/uint32

    required:
      - reg
      - iopins-names
      - iopins

    additionalProperties: false

required:
  - compatible
  - "#address-cells"
  - "#size-cells"

additionalProperties: false

examples:
  - |
    mca@63 {
        mca_uart: uart {
            compatible = "digi,mca-uart";
            #address-cells = <1>;
            #size-cells = <0>;

            mca_uart0: serial@900 {
                reg = <0x900>;
                iopins-names = "rx", "tx";
                iopins = <9 10>;
            };

            mca_uart1: serial@920 {
                reg = <0x920>;
                iopins-names = "rx", "tx";
                iopins = <11 16>;
            };

            mca_uart2: serial@940 {
                reg = <0x940>;
                iopins-names = "rx", "tx", "cts", "rts";
                iopins = <2 1 3 4>;
            };
        };
    };
```
