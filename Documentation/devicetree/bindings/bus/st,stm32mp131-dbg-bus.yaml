## Documentation/devicetree/bindings/bus/st,stm32mp131-dbg-bus.yaml
```yaml
# SPDX-License-Identifier: (GPL-2.0-only OR BSD-2-Clause)
%YAML 1.2
---
$id: http://devicetree.org/schemas/bus/st,stm32mp131-dbg-bus.yaml#
$schema: http://devicetree.org/meta-schemas/core.yaml#

title: STM32 Coresight bus

maintainers:
  - Gatien Chevallier <gatien.chevallier@foss.st.com>

description: |
  The STM32 debug bus is in charge of checking the debug configuration
  of the platform before probing the peripheral drivers that rely on the debug
  domain.

properties:
  compatible:
    oneOf:
      - items:
          - enum:
              - st,stm32mp131-dbg-bus
              - st,stm32mp151-dbg-bus
              - st,stm32mp211-dbg-bus
              - st,stm32mp231-dbg-bus
              - st,stm32mp251-dbg-bus

  "#address-cells":
    const: 1

  "#size-cells":
    const: 1

  clocks:
    maxItems: 1

  ranges: true

  reg:
    maxItems: 1

  "#access-controller-cells":
    const: 1
    description:
      Contains the debug profile necessary to access the peripheral.

patternProperties:
  "^.*@[0-9a-f]+$":
    description: Debug related peripherals
    type: object

    additionalProperties: true

    required:
      - access-controllers

required:
  - compatible
  - "#address-cells"
  - "#size-cells"
  - clocks
  - ranges
  - reg

additionalProperties: false

examples:
  - |
    #include <dt-bindings/clock/stm32mp1-clks.h>

    dbg_bus: bus {
      compatible = "st,stm32mp131-dbg-bus";
      #address-cells = <1>;
      #size-cells = <1>;
      clocks = <&rcc CK_DBG>;
      #access-controller-cells = <1>;
      ranges;
      status = "disabled";

      hdp: pinctrl@5002a000 {
        compatible = "st,stm32mp-hdp";
        reg = <0x5002a000 0x400>;
        clocks = <&rcc HDP>;
        access-controllers = <&dbg_bus 1>;
        status = "disabled";
      };
    };
```

## Documentation/devicetree/bindings/gpio/digi,mca-gpio.yaml
```yaml
# SPDX-License-Identifier: (GPL-2.0-only OR BSD-2-Clause)
%YAML 1.2
---
$id: "http://devicetree.org/schemas/gpio/digi,mca-gpio.yaml#"
$schema: "http://devicetree.org/meta-schemas/core.yaml#"

title: Digi MCA GPIO controller

maintainers:
  - name: Digi International
    email: hector.palacios@digi.com

description: |
  GPIO controller provided by the Digi MCA (Micro Controller Assist) and
  Digi MCA I/O expander devices.

properties:
  compatible:
    enum:
      - digi,mca-gpio
      - digi,mca-ioexp-gpio

  gpio-controller:
    type: boolean

  "#gpio-cells":
    const: 2
    description:
      The first cell is the pin number and the second cell is used for flags.
      Flags are currently unused.

  interrupt-parent:
    $ref: /schemas/types.yaml#/definitions/phandle
    description:
      Phandle to the interrupt controller that services interrupts for this
      device.

  interrupt-controller:
    type: boolean
    description:
      Marks the GPIO module as an interrupt controller.

  "#interrupt-cells":
    const: 2
    description:
      The first cell is the GPIO number and the second cell specifies the
      interrupt flags.

  pwroff-wakeup-capable-ios:
    $ref: /schemas/types.yaml#/definitions/uint32-array
    description: |
      List of MCA IOs that can wake up the device from power-off state.
      Only IOs that are IRQ-capable can wake up the system from low power
      modes. If this property is not present, all MCA IOs are configured
      to wake up the system from power-off, provided the IRQ is enabled
      by the kernel.

required:
  - compatible
  - gpio-controller
  - "#gpio-cells"
  - interrupt-parent
  - interrupt-controller
  - "#interrupt-cells"

additionalProperties: false

examples:
  - |
    mca@7e {
        mca_gpio: gpio {
            compatible = "digi,mca-gpio";
            gpio-controller;
            #gpio-cells = <2>;

            interrupt-parent = <&mca_cc6ul>;
            interrupt-controller;
            #interrupt-cells = <2>;
        };
    };

  - |
    mca_io@6e {
        mca_ioexp_gpio: gpio {
            compatible = "digi,mca-ioexp-gpio";
            gpio-controller;
            #gpio-cells = <2>;

            interrupt-parent = <&mca_ioexp>;
            interrupt-controller;
            #interrupt-cells = <2>;
        };
    };
```

## Documentation/devicetree/bindings/iio/adc/digi,mca-adc.yaml
```yaml
# SPDX-License-Identifier: (GPL-2.0-only OR BSD-2-Clause)
%YAML 1.2
---
$id: "http://devicetree.org/schemas/iio/adc/digi,mca-adc.yaml#"
$schema: "http://devicetree.org/meta-schemas/core.yaml#"

title: Digi MCA ADC

maintainers:
  - name: Digi International
    email: hector.palacios@digi.com

description: |
  ADC block provided by the Digi MCA (Micro Controller Assist) and
  Digi MCA I/O expander devices.

  MCA IOs that are ADC-capable can be configured as ADC inputs. They can
  also be configured as analog comparators. In comparator mode, the input
  is sampled periodically and an interrupt is generated based on the
  comparison result against configured thresholds.

properties:
  compatible:
    enum:
      - digi,mca-adc
      - digi,mca-ioexp-adc

  digi,adc-ch-list:
    $ref: /schemas/types.yaml#/definitions/uint32-array
    description: List of MCA IOs enabled as ADC channels.

  digi,comparator-ch-list:
    $ref: /schemas/types.yaml#/definitions/uint32-array
    description: List of MCA IOs enabled as analog comparator channels.

  digi,adc-vref:
    $ref: /schemas/types.yaml#/definitions/uint32
    description: ADC reference voltage in microvolts.

  digi,internal-vref:
    type: boolean
    description: |
      Use the internal 1.2 V reference.

      On ConnectCore 8X, this forces MCA_VREF_OUT to be configured as a
      1.2 V output.

      On ConnectCore 6UL, this forces MCA_IO2/EXT_VREF to be configured as
      a 1.2 V output. A 100 nF capacitor must be placed between
      MCA_IO2/EXT_VREF and GND for proper operation.

required:
  - compatible

allOf:
  - oneOf:
      - required:
          - digi,adc-vref
      - required:
          - digi,internal-vref

additionalProperties: false

examples:
  - |
    mca@7e {
        mca_adc: adc {
            compatible = "digi,mca-adc";
            digi,adc-ch-list = <0 4>;
            digi,comparator-ch-list = <3>;
            digi,adc-vref = <3000000>;
        };
    };

  - |
    mca_io@6e {
        ioexp_adc: adc {
            compatible = "digi,mca-ioexp-adc";
            digi,adc-ch-list = <0 4>;
            digi,comparator-ch-list = <3>;
            digi,adc-vref = <3000000>;
        };
    };
```

## Documentation/devicetree/bindings/iio/tamper/digi,mca-tamper.yaml
```yaml
# SPDX-License-Identifier: (GPL-2.0-only OR BSD-2-Clause)
%YAML 1.2
---
$id: "http://devicetree.org/schemas/misc/digi,mca-tamper.yaml#"
$schema: "http://devicetree.org/meta-schemas/core.yaml#"

title: Digi MCA tamper detector

maintainers:
  - name: Digi International
    email: hector.palacios@digi.com

description: |
  Tamper detection block provided by the Digi MCA (Micro Controller Assist).

  The MCA tamper block can monitor up to four tamper interfaces. Interfaces
  0 and 1 are used for digital tamper detection, while interfaces 2 and 3
  are used for analog comparison.

properties:
  compatible:
    const: digi,mca-tamper

  digi,tamper-if-list:
    $ref: /schemas/types.yaml#/definitions/uint32-array
    description: |
      List of enabled tamper interfaces.
    items:
      enum: [0, 1, 2, 3]
    uniqueItems: true
    minItems: 1
    maxItems: 4

required:
  - compatible

additionalProperties: false

examples:
  - |
    mca@7e {
        mca_tamper: tamper {
            compatible = "digi,mca-tamper";
            digi,tamper-if-list = <0 1 2 3>;
        };
    };
```

## Documentation/devicetree/bindings/input/digi,mca-keypad.yaml
```yaml
# SPDX-License-Identifier: (GPL-2.0-only OR BSD-2-Clause)
%YAML 1.2
---
$id: "http://devicetree.org/schemas/input/digi,mca-keypad.yaml#"
$schema: "http://devicetree.org/meta-schemas/core.yaml#"

title: Digi MCA matrix keypad controller

maintainers:
  - name: Digi International
    email: hector.palacios@digi.com

description: |
  Matrix keypad controller provided by the Digi MCA (Micro Controller Assist).

  The MCA keypad controller interfaces with matrix keypads using 2-point
  contact keys. It can detect, debounce, and decode one or multiple keys
  pressed simultaneously, and also detects key release events.

properties:
  compatible:
    const: digi,mca-keypad

  rows-io-list:
    description: List of MCA IOs used as row lines.
    $ref: /schemas/types.yaml#/definitions/uint32-array
    minItems: 1

  cols-io-list:
    description: List of MCA IOs used as column lines.
    $ref: /schemas/types.yaml#/definitions/uint32-array
    minItems: 1

  linux,keymap:
    description: Matrix keypad keymap definition.
    $ref: /schemas/types.yaml#/definitions/uint32-array
    minItems: 1

  debounce-ms:
    description: Debounce filter in milliseconds.
    $ref: /schemas/types.yaml#/definitions/uint32
    minimum: 0

  pwr-off-wakeup:
    type: boolean
    description: Enable wakeup from power-off through keypad events.

  autorepeat:
    type: boolean
    description: Enable Linux input subsystem auto-repeat.

required:
  - compatible
  - rows-io-list
  - cols-io-list
  - linux,keymap

additionalProperties: false

examples:
  - |
    mca@63 {
        mca_keypad: keypad {
            compatible = "digi,mca-keypad";
            rows-io-list = <7 9>;
            cols-io-list = <5 17 6 8>;
            pwr-off-wakeup;
            debounce-ms = <10>;

            linux,keymap = <MATRIX_KEY(0, 0, KEY_UP)
                            MATRIX_KEY(0, 1, KEY_DOWN)
                            MATRIX_KEY(0, 2, KEY_VOLUMEDOWN)
                            MATRIX_KEY(0, 3, KEY_HOME)
                            MATRIX_KEY(1, 0, KEY_RIGHT)
                            MATRIX_KEY(1, 1, KEY_LEFT)
                            MATRIX_KEY(1, 2, KEY_ENTER)
                            MATRIX_KEY(1, 3, KEY_VOLUMEUP)>;

            autorepeat;
        };
    };
```

## Documentation/devicetree/bindings/input/digi,mca-powerkey.yaml
```yaml
# SPDX-License-Identifier: (GPL-2.0-only OR BSD-2-Clause)
%YAML 1.2
---
$id: "http://devicetree.org/schemas/input/digi,mca-pwrkey.yaml#"
$schema: "http://devicetree.org/meta-schemas/core.yaml#"

title: Digi MCA power key

maintainers:
  - name: Digi International
    email: hector.palacios@digi.com

description: |
  Power key input driver provided by the Digi MCA (Micro Controller Assist).

  The exact event generation semantics depend on the MCA variant:

    - digi,mca-pwrkey:
      Used on KL03/KL17-based MCA variants. KEY_POWER is associated with
      long press of the POWER button, and KEY_SLEEP with short press of
      the POWER button.

    - digi,mca-smarc-pwrkey:
      Used on STM32U031-based MCA variants. KEY_POWER is associated with
      press of the POWER button, while KEY_SLEEP is associated with press
      of the STANDBY button.

properties:
  compatible:
    enum:
      - digi,mca-pwrkey
      - digi,mca-smarc-pwrkey

  digi,key-power:
    type: boolean
    description: |
      Enable KEY_POWER event generation.

      On digi,mca-pwrkey, this generates KEY_POWER on long press of the
      POWER button.

      On digi,mca-smarc-pwrkey, this generates KEY_POWER on press of
      the POWER button.

  digi,key-power-up:
    type: boolean
    description: |
      Generate KEY_POWER release event on release of the POWER button.

  digi,key-sleep:
    type: boolean
    description: |
      Enable KEY_SLEEP event generation.

      On digi,mca-pwrkey, this generates KEY_SLEEP on short press of the
      POWER button.

      On digi,mca-smarc-pwrkey, this generates KEY_SLEEP on press of
      the STANDBY button.

  digi,debounce-ms:
    $ref: /schemas/types.yaml#/definitions/uint32
    maximum: 12750
    description: |
      Debounce filter in milliseconds.

      On digi,mca-pwrkey, debounce applies to the POWER button.

      On digi,mca-smarc-pwrkey, debounce applies to both the POWER
      and STANDBY buttons.

  digi,pwroff-delay-sec:
    $ref: /schemas/types.yaml#/definitions/uint32
    minimum: 0
    maximum: 255
    description: |
      Delay in seconds associated with POWER button press handling.

      On digi,mca-pwrkey, this is the number of seconds the POWER button
      must be pressed to generate a KEY_POWER event.

      On digi,mca-smarc-pwrkey, this is the number of seconds the
      POWER button must be pressed to force PMIC power-off.

  digi,pwroff-guard-sec:
    $ref: /schemas/types.yaml#/definitions/uint32
    minimum: 0
    maximum: 255
    description: |
      Number of seconds the MCA waits for the OS to power off the system
      before forcing power-off.

      Supported only on digi,mca-pwrkey.

required:
  - compatible

allOf:
  - if:
      properties:
        compatible:
          const: digi,mca-smarc-pwrkey
    then:
      properties:
        digi,pwroff-guard-sec: false

additionalProperties: false

examples:
  - |
    mca@7e {
        pwrkey {
            compatible = "digi,mca-pwrkey";
            digi,key-power;
            digi,key-power-up;
            digi,key-sleep;
            digi,debounce-ms = <100>;
            digi,pwroff-delay-sec = <6>;
            digi,pwroff-guard-sec = <30>;
        };
    };

  - |
    mca@20 {
        pwrkey {
            compatible = "digi,mca-smarc-pwrkey";
            digi,key-power;
            digi,key-power-up;
            digi,key-sleep;
            digi,debounce-ms = <100>;
            digi,pwroff-delay-sec = <6>;
        };
    };
```

## Documentation/devicetree/bindings/input/digi,stpmic-pwrkey.yaml
```yaml
# SPDX-License-Identifier: (GPL-2.0 OR BSD-2-Clause)
%YAML 1.2
---
$id: http://devicetree.org/schemas/input/digi,stpmic-pwrkey.yaml#
$schema: http://devicetree.org/meta-schemas/core.yaml#

title: Power Key device driver for ConnectCore modules

maintainers:
  - Arturo Buzarra <Arturo.Buzarra@digi.com>

allOf:
  - $ref: input.yaml#

properties:
  compatible:
    enum:
      - digi,stpmic-pwrkey

  interrupts:
    maxItems: 2

required:
  - compatible
  - interrupts

unevaluatedProperties: false

examples:
  - |
    #include "dt-bindings/input/input.h"
    power_button {
        compatible = "digi,stpmic-pwrkey";
        interrupts-extended = <&optee 0>, <&optee 1>;
        interrupt-names = "stpmic_pwrkey_fall", "stpmic_pwrkey_rise";
        status = "okay";
    };
```
