## Documentation/devicetree/bindings/media/st,stm32mp25-video-codec.yaml
```yaml
# SPDX-License-Identifier: (GPL-2.0 OR BSD-2-Clause)

%YAML 1.2
---
$id: http://devicetree.org/schemas/media/st,stm32mp25-video-codec.yaml#
$schema: http://devicetree.org/meta-schemas/core.yaml#

title: STMicroelectronics STM32MP25 VDEC video decoder & VENC video encoder

maintainers:
  - Hugues Fruchet <hugues.fruchet@foss.st.com>

description:
  The STMicroelectronics STM32MP25 SOCs embeds a VDEC video hardware
  decoder peripheral based on Verisilicon VC8000NanoD IP (former Hantro G1)
  and a VENC video hardware encoder peripheral based on Verisilicon
  VC8000NanoE IP (former Hantro H1).

properties:
  compatible:
    items:
      - enum:
          - st,stm32mp25-vdec
          - st,stm32mp25-venc

  reg:
    maxItems: 1

  interrupts:
    maxItems: 1

  clocks:
    maxItems: 1

required:
  - compatible
  - reg
  - interrupts
  - clocks

additionalProperties: false

examples:
  - |
    #include <dt-bindings/interrupt-controller/arm-gic.h>
    vdec: video-codec@580d0000 {
        compatible = "st,stm32mp25-vdec";
        reg = <0x580d0000 0x3c8>;
        interrupts = <GIC_SPI 117 IRQ_TYPE_LEVEL_HIGH>;
        clocks = <&ck_icn_p_vdec>;
    };
  - |
    venc: video-codec@580e0000 {
        compatible = "st,stm32mp25-venc";
        reg = <0x580e0000 0x800>;
        interrupts = <GIC_SPI 167 IRQ_TYPE_LEVEL_HIGH>;
        clocks = <&ck_icn_p_venc>;
    };
```

## Documentation/devicetree/bindings/mfd/da9063.txt
```
* Dialog da9063 Power Management IC

Required parent device properties:

- compatible : "dlg,da9063"
- reg : the I2C slave address for the da9063 chip
- interrupts : IRQ line for the da9063 chip
- interrupt-controller: describes the da9063 as an interrupt
  controller (has its own domain)
- #interrupt-cells : should be 1.
        - The cell is the da9063 local IRQ number

The da9063 consists of a large and varied group of sub-devices:

Device                   Supply Names    Description
------                   ------------    -----------
da9063-onkey            :               : On key
da9063-rtc              :               : RTC
da9063-regulator        :               : Regulators
da9063-hwmon            :               : Hardware monitoring

Example:

        pmic: da9063@58 {
                compatible = "dlg,da9063";
                reg = <0x58>;
                interrupts = <12 2>;
                interrupt-parent = <&gpio7>;
                interrupt-controller;
                #interrupt-cells = <1>;

                regulators {
                };

		rtc {
			compatible = "dlg,da9063-rtc";
			interrupts = <1 2>;
			interrupts-names = "ALARM" , "TIMER";
			interrupt-parent = <&pmic>;
		};
        };
```

## Documentation/devicetree/bindings/mfd/digi,mca-cc6ul.txt
```
* Digi ConnectCore 6UL Micro-Controller Assist (MCA)

The CC6UL MCA consists of a varied group of sub-devices (I2C Only):

Device                   Description
------                   ------------
adc                      ADC channels (multiplexed with IOs)
gpio                     IO pins (multiplexed with ADCs)
pwrkey                   Power key
rtc                      Real-Time Clock
watchdog                 Watchdog

======

Required properties:

- compatible : Should be "digi,mca-cc6ul"
- reg : Specifies the I2C slave address (this defaults to 0x7e but it can be
  modified to match the chip's OTP settings).
- interrupt-parent : Specifies the reference to the interrupt controller for
  the MCA.
- interrupts : IRQ line information.
- interrupt-controller

Optional properties:

- fw-update-gpio : Control GPIO for MCA firmware update.

Sub-nodes:

- adc : This node defines settings for the ADC channels associated with the
  MCA. Refer to binding at:
  "Documentation/devicetree/bindings/iio/adc/digi,mca-adc.txt"

- gpio : This node defines settings for the GPIO pins associated with the MCA.
  Refer to binding at:
  "Documentation/devicetree/bindings/gpio/gpio-mca.txt"

- pwrkey : This node defines settings for the power key associated with the MCA.
  Refer to binding at:
  "Documentation/devicetree/bindings/input/digi,mca-powerkey.txt"

- rtc : This node defines settings for the Real-Time Clock associated with
  the MCA. Refer to binding at:
  "Documentation/devicetree/bindings/rtc/digi,mca-rtc.txt"

- watchdog : This node defines settings for the Watchdog timer associated
  with the MCA. Refer to binding at:
  "Documentation/devicetree/bindings/watchdog/mca-wdt.txt"



Example:

	mca_cc6ul: mca@7e {
		compatible = "digi,mca-cc6ul";
		reg = <0x7e>;
		interrupt-parent = <&gpio5>;
		interrupts = <4 IRQ_TYPE_EDGE_FALLING>;
		interrupt-controller;
		#interrupt-cells = <2>;
		fw-update-gpio = <&gpio4 14 GPIO_ACTIVE_HIGH>;
		pinctrl-names = "default";
		pinctrl-0 = <&pinctrl_mca_cc6ul>;

		mca_adc: adc {
			compatible = "digi,mca-cc6ul-adc";
			digi,adc-ch-list = <4>;
		};

		pwrkey {
			compatible = "digi,mca-cc6ul-pwrkey";
			digi,key-power;
			digi,key-power-up;
			digi,key-sleep;
			digi,debounce-ms = <100>;
			digi,pwroff-delay-sec = <6>;
			digi,pwroff-guard-sec = <30>;
		};

		mca_gpio: gpio {
			compatible = "digi,mca-cc6ul-gpio";
			gpio-controller;
			#gpio-cells = <2>;

			interrupt-parent = <&mca_cc6ul>;
			interrupt-controller;
			#interrupt-cells = <2>;

			/* Disable all mca GPIOs as power off wake up sources */
			pwroff-wakeup-capable-ios = <>;
		};

		rtc {
			compatible = "digi,mca-cc6ul-rtc";
		};

		wdt {
			compatible = "digi,mca-cc6ul-wdt";
		};

		mca_tamper: tamper {
			compatible = "digi,mca-cc6ul-tamper";
		};
	};
```

## Documentation/devicetree/bindings/mfd/digi,mca-cc8.txt
```
* Digi ConnectCore 8 SoMs Micro-Controller Assist (MCA)

The CC8 MCA consists of a varied group of sub-devices (I2C Only):

Device                   Description
------                   ------------
adc                      ADC channels (multiplexed with IOs)
gpio                     IO pins (multiplexed with ADCs)
pwrkey                   Power key
rtc                      Real-Time Clock
watchdog                 Watchdog

======

Required properties:

- compatible: must be one of
  "digi,mca_cc8x".
  "digi,mca_cc8m".
- reg : Specifies the I2C slave address (this defaults to 0x63 but it can be
  modified to match the chip's OTP settings).
- interrupt-parent : Specifies the reference to the interrupt controller for
  the MCA.
- interrupts : IRQ line information.
- interrupt-controller

Optional properties:

- fw-update-gpio : Control GPIO for MCA firmware update.

Sub-nodes:

- adc : This node defines settings for the ADC channels associated with the
  MCA. Refer to binding at:
  "Documentation/devicetree/bindings/iio/adc/digi,mca-adc.txt"

- gpio : This node defines settings for the GPIO pins associated with the MCA.
  Refer to binding at:
  "Documentation/devicetree/bindings/gpio/gpio-mca.txt"

- pwrkey : This node defines settings for the power key associated with the MCA.
  Refer to binding at:
  "Documentation/devicetree/bindings/input/digi,mca-powerkey.txt"

- rtc : This node defines settings for the Real-Time Clock associated with
  the MCA. Refer to binding at:
  "Documentation/devicetree/bindings/rtc/digi,mca-rtc.txt"

- watchdog : This node defines settings for the Watchdog timer associated
  with the MCA. Refer to binding at:
  "Documentation/devicetree/bindings/watchdog/mca-wdt.txt"



Example:

	mca_cc8x: mca@63 {
		compatible = "digi,mca_cc8x";
		reg = <0x63>;
		interrupt-parent = <&wu>;
		interrupts = <GIC_SPI 177 IRQ_TYPE_EDGE_HIGH>;
		interrupt-controller;
		#interrupt-cells = <2>;
		fw-update-gpio = <&gpio3 9 GPIO_ACTIVE_LOW>;
		pinctrl-names = "default";
		pinctrl-0 = <&pinctrl_mca_cc8x>;

		mca_adc: adc {
			compatible = "digi,mca-cc8x-adc";
			digi,adc-ch-list = <4>;
		};

		pwrkey {
			compatible = "digi,mca-cc8x-pwrkey";
			digi,key-power;
			digi,key-power-up;
			digi,key-sleep;
			digi,debounce-ms = <100>;
			digi,pwroff-delay-sec = <6>;
			digi,pwroff-guard-sec = <30>;
		};

		mca_gpio: gpio {
			compatible = "digi,mca-cc8x-gpio";
			gpio-controller;
			#gpio-cells = <2>;

			interrupt-parent = <&mca_cc8x>;
			interrupt-controller;
			#interrupt-cells = <2>;

			/* Disable all mca GPIOs as power off wake up sources */
			pwroff-wakeup-capable-ios = <>;
		};

		rtc {
			compatible = "digi,mca-cc8x-rtc";
		};

		wdt {
			compatible = "digi,mca-cc8x-wdt";
		};

		pwms {
			compatible = "digi,mca-pwm";
			#address-cells = <1>;
			#size-cells = <0>;

			mca_pwm0: pwm@0 {
				reg = <0>;
				pwm-channels = <6>;
				#pwm-cells = <3>;
			};

			mca_pwm1: pwm@1 {
				reg = <1>;
				pwm-channels = <2>;
				#pwm-cells = <3>;
			};

			mca_pwm2: pwm@2 {
				reg = <2>;
				pwm-channels = <2>;
				#pwm-cells = <3>;
			};
		};

		mca_tamper: tamper {
			compatible = "digi,mca-cc8x-tamper";
		};

		mca_uart: uart {
			compatible = "digi,mca-cc8x-uart";
			#address-cells = <1>;
			#size-cells = <0>;

			mca_uart0: serial@0x900 {
				reg = <0x900>;
				index = <0>;
			};

			mca_uart1: serial@0x920 {
				reg = <0x920>;
				index = <1>;
			};

			mca_uart2: serial@0x940 {
				reg = <0x940>;
				index = <2>;
			};
		};
	};

	mca_cc8m: mca@63 {
		compatible = "digi,mca_cc8m";
		reg = <0x63>;
		interrupt-parent = <&gpio3>;
		interrupts = <8 IRQ_TYPE_LEVEL_HIGH>;
		interrupt-controller;
		#interrupt-cells = <2>;
		fw-update-gpio = <&gpio1 4 GPIO_ACTIVE_LOW>;
		pinctrl-names = "default";
		pinctrl-0 = <&pinctrl_mca_cc8m>;

		mca_adc: adc {
			compatible = "digi,mca-cc8m-adc";
			digi,adc-ch-list = <4>;
		};

		pwrkey {
			compatible = "digi,mca-cc8m-pwrkey";
			digi,key-power;
			digi,key-power-up;
			digi,key-sleep;
			digi,debounce-ms = <100>;
			digi,pwroff-delay-sec = <6>;
			digi,pwroff-guard-sec = <30>;
		};

		mca_gpio: gpio {
			compatible = "digi,mca-cc8m-gpio";
			gpio-controller;
			#gpio-cells = <2>;

			interrupt-parent = <&mca_cc8m>;
			interrupt-controller;
			#interrupt-cells = <2>;

			/* Disable all mca GPIOs as power off wake up sources */
			pwroff-wakeup-capable-ios = <>;
		};

		rtc {
			compatible = "digi,mca-cc8m-rtc";
		};

		wdt {
			compatible = "digi,mca-cc8m-wdt";
		};

		pwms {
			compatible = "digi,mca-pwm";
			#address-cells = <1>;
			#size-cells = <0>;

			mca_pwm0: pwm@0 {
				reg = <0>;
				pwm-channels = <6>;
				#pwm-cells = <3>;
			};
		};

		mca_tamper: tamper {
			compatible = "digi,mca-cc8m-tamper";
		};

		mca_uart: uart {
			compatible = "digi,mca-cc8m-uart";
			#address-cells = <1>;
			#size-cells = <0>;

			mca_uart0: serial@0x900 {
				reg = <0x900>;
				index = <0>;
			};

			mca_uart1: serial@0x920 {
				reg = <0x920>;
				index = <1>;
			};

			mca_uart2: serial@0x940 {
				reg = <0x940>;
				index = <2>;
			};
		};
	};
```

## Documentation/devicetree/bindings/mfd/digi,mca-cc8x.txt
```
* Digi ConnectCore 8X Micro-Controller Assist (MCA)

The CC8X MCA consists of a varied group of sub-devices (I2C Only):

Device                   Description
------                   ------------
adc                      ADC channels (multiplexed with IOs)
gpio                     IO pins (multiplexed with ADCs)
pwrkey                   Power key
rtc                      Real-Time Clock
watchdog                 Watchdog

======

Required properties:

- compatible : Should be "digi,mca_cc8x"
- reg : Specifies the I2C slave address (this defaults to 0x63 but it can be
  modified to match the chip's OTP settings).
- interrupt-parent : Specifies the reference to the interrupt controller for
  the MCA.
- interrupts : IRQ line information.
- interrupt-controller

Optional properties:

- fw-update-gpio : Control GPIO for MCA firmware update.

Sub-nodes:

- adc : This node defines settings for the ADC channels associated with the
  MCA. Refer to binding at:
  "Documentation/devicetree/bindings/iio/adc/digi,mca-adc.txt"

- gpio : This node defines settings for the GPIO pins associated with the MCA.
  Refer to binding at:
  "Documentation/devicetree/bindings/gpio/gpio-mca.txt"

- pwrkey : This node defines settings for the power key associated with the MCA.
  Refer to binding at:
  "Documentation/devicetree/bindings/input/digi,mca-powerkey.txt"

- rtc : This node defines settings for the Real-Time Clock associated with
  the MCA. Refer to binding at:
  "Documentation/devicetree/bindings/rtc/digi,mca-rtc.txt"

- watchdog : This node defines settings for the Watchdog timer associated
  with the MCA. Refer to binding at:
  "Documentation/devicetree/bindings/watchdog/mca-wdt.txt"



Example:

	mca_cc8x: mca@63 {
		compatible = "digi,mca_cc8x";
		reg = <0x63>;
		interrupt-parent = <&wu>;
		interrupts = <GIC_SPI 177 IRQ_TYPE_EDGE_HIGH>;
		interrupt-controller;
		#interrupt-cells = <2>;
		fw-update-gpio = <&gpio3 9 GPIO_ACTIVE_LOW>;
		pinctrl-names = "default";
		pinctrl-0 = <&pinctrl_mca_cc8x>;

		adc {
			compatible = "digi,mca-cc8x-adc";
			digi,adc-ch-list = <4>;
		};

		pwrkey {
			compatible = "digi,mca-cc8x-pwrkey";
			digi,key-power;
			digi,key-sleep;
			digi,debounce-ms = <100>;
			digi,pwroff-delay-sec = <6>;
			digi,pwroff-guard-sec = <30>;
		};

		gpio {
			compatible = "digi,mca-cc8x-gpio";
			gpio-controller;
			#gpio-cells = <2>;
		};

		rtc {
			compatible = "digi,mca-cc8x-rtc";
		};

		watchdog {
			compatible = "digi,mca-cc8x-wdt";
		};
	};
```

## Documentation/devicetree/bindings/mfd/digi,mca-ioexp.txt
```
* Digi I/O Expander

The I/O Expander consists of a group of sub-devices (I2C Only):

Device                   Description
------                   ------------
adc                      ADC channels (multiplexed with IOs)
gpio                     IO pins (multiplexed with ADCs)

======

Required properties:

- compatible : Should be "digi,mca_ioexp"
- reg : Specifies the I2C slave address (this defaults to 0x6e but it can be
  modified to match the chip's OTP settings).
- interrupt-parent : Specifies the reference to the interrupt controller for
  the I/O Expander.
- interrupts : IRQ line information.
- interrupt-controller

Optional properties:

- restore-config-on-resume : Read configuration registers before going to sleep
  and write them back on resume, allowing the I/O Expander to be powered off.
  This also disables the IRQ of this device which means that it will not be
  available as a wake-up source.

Sub-nodes:

- adc : This node defines settings for the ADC channels associated with the
  I/O Expander. Refer to binding at:
  "Documentation/devicetree/bindings/iio/adc/digi,mca-adc.txt"

- gpio : This node defines settings for the GPIO pins associated with the I/O
  Expander.
  Refer to binding at:
  "Documentation/devicetree/bindings/gpio/gpio-mca.txt"

Example:

	mca_ioexp: mca_io@6e {
		compatible = "digi,mca_ioexp";
		reg = <0x6e>;
		interrupt-parent = <&mca_gpio>;
		interrupts = <0 IRQ_TYPE_EDGE_FALLING>;
		status = "okay";

		interrupt-controller;
		#interrupt-cells = <2>;
		pinctrl-names = "default";

		restore-config-on-resume;

		mca_ioexp_gpio: gpio {
			compatible = "digi,mca-ioexp-gpio";
			gpio-controller;
			#gpio-cells = <2>;

			interrupt-parent = <&mca_ioexp>;
			interrupt-controller;
			#interrupt-cells = <2>;
		};

		mca_ioexp_adc: adc {
			compatible = "digi,mca-ioexp-adc";
			digi,adc-vref = <3300000>;
		};
	};
```
