## Documentation/devicetree/bindings/input/digi,mca-keypad.txt
```
* MCA matrix keypad device tree bindings

The MCA keypad controller is designed to interface with a matrix keypad with
2-point contact keys. The keypad subsystem is capable of detecting, debouncing
and decoding one or multiple keys pressed simultaneously. Key release events
are also detected.

Required Properties:
- compatible:		Should be "digi,mca-keypad"
- rows-io-list:		List of MCA IOs used as row lines.
- cols-io-list:		List of MCA IOs used as column lines.
- linux,keymap:		The definition can be found at
			bindings/input/matrix-keymap.txt

Optional Properties:
- debounce-ms:		debounce filter in ms.
- pwr-off-wakeup:	Enable wake up from power off through keypad events.
- autorepeat:		Boolean, enable auto repeat feature of Linux input
			subsystem.

Example:

	&mca_keypad {
		rows-io-list = <7 9>;
		cols-io-list = <5 17 6 8>;
		pwr-off-wakeup;
		debounce-ms = <10>;

		linux,keymap = <MATRIX_KEY(0, 0, KEY_UP)
				MATRIX_KEY(0, 1, KEY_DOWN)
				MATRIX_KEY(0, 2, KEY_VOLUMEDOWN)
				MATRIX_KEY(0, 3, KEY_HOME)
				MATRIX_KEY(1, 0, KEY_RIGHT)
				MATRIX_KEY(1, 1, KEY_LEFT)
				MATRIX_KEY(1, 2, KEY_ENTER)
				MATRIX_KEY(1, 3, KEY_VOLUMEUP)>;
	};
```

## Documentation/devicetree/bindings/input/digi,stpmic1-pwrkey.yaml
```yaml
# SPDX-License-Identifier: (GPL-2.0 OR BSD-2-Clause)
%YAML 1.2
---
$id: http://devicetree.org/schemas/input/digi,stpmic1-pwrkey.yaml#
$schema: http://devicetree.org/meta-schemas/core.yaml#

title: Power Key device driver for ConnectCore modules

maintainers:
  - Arturo Buzarra <Arturo.Buzarra@digi.com>

allOf:
  - $ref: input.yaml#

properties:
  compatible:
    enum:
      - digi,stpmic1-pwrkey

  interrupts:
    maxItems: 2

required:
  - compatible
  - interrupts

unevaluatedProperties: false

examples:
  - |
    #include "dt-bindings/input/input.h"
    power_button {
        compatible = "digi,stpmic1-pwrkey";
        interrupts-extended = <&optee 0>, <&optee 1>;
        interrupt-names = "stpmic1_pwrkey_fall", "stpmic1_pwrkey_rise";
        status = "okay";
    };
```

## Documentation/devicetree/bindings/input/mxs-pswitch.txt
```
* Digi International MXS power switch device tree bindings

The Freescale's MX28 SoC has a pswitch pin which has several power related
functions determined by a product's hardware and software design.

The pswitch keyboard driver allow for the user space handling of power events
like suspend to RAM or poweroff.

Required properties:

- compatible: Should be "digi,mxs-pswitch".

- reg: Physical base address of the power hardware subsystem and length of the
        memory mapped region.

- interrupts: The pswitch interrupt number.

- linux,code: The linux key code the event maps to.

Example:

        pswitch@80044000 {
                compatible = "digi,mxs-pswitch";
                linux,code = <116>;
                interrupts = <6>;
        };
```

## Documentation/devicetree/bindings/input/touchscreen/goodix.txt
```
Device tree bindings for Goodix GT9xx series touchscreen controller

Required properties:

 - compatible		: Should be "goodix,gt1151"
				 or "goodix,gt5663"
				 or "goodix,gt5688"
				 or "goodix,gt911"
				 or "goodix,gt9110"
				 or "goodix,gt912"
				 or "goodix,gt927"
				 or "goodix,gt9271"
				 or "goodix,gt928"
				 or "goodix,gt967"
 - reg			: I2C address of the chip. Should be 0x5d or 0x14
 - interrupts		: Interrupt to which the chip is connected

Optional properties:

 - irq-gpios		: GPIO pin used for IRQ. The driver uses the
			  interrupt gpio pin as output to reset the device.
 - reset-gpios		: GPIO pin used for reset
 - AVDD28-supply	: Analog power supply regulator on AVDD28 pin
 - VDDIO-supply		: GPIO power supply regulator on VDDIO pin
 - touchscreen-inverted-x
 - touchscreen-inverted-y
 - touchscreen-size-x
 - touchscreen-size-y
 - touchscreen-swapped-x-y
 - reload-fw-on-resume  : Reload the touch controller configuration when re-
			  suming from suspend. This is required to allow
			  powering off the device during low power modes.
 - skip-firmware-request: Do not load the touch config through the kernel firm-
                          ware framework. Use the on chip configuration.

Example:

	i2c@00000000 {
		/* ... */

		gt928@5d {
			compatible = "goodix,gt928";
			reg = <0x5d>;
			interrupt-parent = <&gpio>;
			interrupts = <0 0>;

			irq-gpios = <&gpio1 0 0>;
			reset-gpios = <&gpio1 1 0>;
		};

		/* ... */
	};
```

## Documentation/devicetree/bindings/input/touchscreen/goodix.yaml
```yaml
# SPDX-License-Identifier: GPL-2.0
%YAML 1.2
---
$id: http://devicetree.org/schemas/input/touchscreen/goodix.yaml#
$schema: http://devicetree.org/meta-schemas/core.yaml#

title: Goodix GT9xx series touchscreen controller Bindings

maintainers:
  - Dmitry Torokhov <dmitry.torokhov@gmail.com>

allOf:
  - $ref: touchscreen.yaml#

properties:
  compatible:
    enum:
      - goodix,gt1151
      - goodix,gt1158
      - goodix,gt5663
      - goodix,gt5688
      - goodix,gt911
      - goodix,gt9110
      - goodix,gt912
      - goodix,gt9147
      - goodix,gt917s
      - goodix,gt927
      - goodix,gt9271
      - goodix,gt928
      - goodix,gt9286
      - goodix,gt967

  reg:
    enum: [ 0x5d, 0x14 ]

  interrupts:
    maxItems: 1

  irq-gpios:
    description: GPIO pin used for IRQ. The driver uses the interrupt gpio pin
      as output to reset the device.
    maxItems: 1

  reset-gpios:
    maxItems: 1

  AVDD28-supply:
    description: Analog power supply regulator on AVDD28 pin

  VDDIO-supply:
    description: GPIO power supply regulator on VDDIO pin

  touchscreen-inverted-x: true
  touchscreen-inverted-y: true
  touchscreen-size-x: true
  touchscreen-size-y: true
  touchscreen-swapped-x-y: true

  reload-fw-on-resume:
    description: Reload the touch controller configuration when resuming
      from suspend. This is required to allow powering off the device during
      low power modes.

  skip-firmware-request:
    description: Do not load the touch config through the kernel firmware
      framework. Use the on chip configuration.

  extends-desktop:
    description: used when the touch controller is on the secondary display
      of an extended desktop setup. In this case, the property is the phandle
      of the primary display. The driver will then parse the width of the
      display and add it as an offset to the X axis.

  vin-supply:
    description: Regulator that powers the touch controller.

additionalProperties: false

required:
  - compatible
  - reg
  - interrupts

examples:
  - |
    i2c {
      #address-cells = <1>;
      #size-cells = <0>;
      gt928@5d {
        compatible = "goodix,gt928";
        reg = <0x5d>;
        interrupt-parent = <&gpio>;
        interrupts = <0 0>;
        irq-gpios = <&gpio1 0 0>;
        reset-gpios = <&gpio1 1 0>;
      };
    };

...
```

## Documentation/devicetree/bindings/leds/backlight/gpio-backlight.yaml
```yaml
# SPDX-License-Identifier: GPL-2.0-only
%YAML 1.2
---
$id: http://devicetree.org/schemas/leds/backlight/gpio-backlight.yaml#
$schema: http://devicetree.org/meta-schemas/core.yaml#

title: gpio-backlight

maintainers:
  - Lee Jones <lee@kernel.org>
  - Daniel Thompson <daniel.thompson@linaro.org>
  - Jingoo Han <jingoohan1@gmail.com>

properties:
  compatible:
    const: gpio-backlight

  gpios:
    description: The gpio that is used for enabling/disabling the backlight.
    maxItems: 1

  default-on:
    description: enable the backlight at boot.
    type: boolean

  default-brightness-level:
    description:
      The default brightness level (index into the array defined by the
      "brightness-levels" property).
    $ref: /schemas/types.yaml#/definitions/uint32

dependencies:
  default-brightness-level: [brightness-levels]

required:
  - compatible
  - gpios

additionalProperties: false

examples:
  - |
    #include <dt-bindings/gpio/gpio.h>
    backlight {
        compatible = "gpio-backlight";
        gpios = <&gpio3 4 GPIO_ACTIVE_HIGH>;
        default-on;
    };

...
```

## Documentation/devicetree/bindings/leds/leds-da9063.txt
```
Binding for Dialog's DA9063 PMIC led driver.

Required properties:
- compatible: "dlg,da9063-leds".

Each LED is represented as a sub-node of the leds device.

Required sub-node properties:

- dlg,led-gpio-reg: The register offset for the GPIO configuration register,.
and the mask to access the GPIO configuration register (each register
configures two GPIO pins)
- dlg,dlg,led-reg: The register offset for the LED configuration register.

Optional properties:

- dlg,inverse-polarity: Invert the brightness pin polarity.

Example:

leds {
	compatible = "dlg,da9063-leds";
	#address-cells = <1>;
	#size-cells = <1>;

	led@0xc6 {
		dlg,led-gpio-reg = <0x1a 0x0f>;
		dlg,led-reg = <0xc6>;
		dlg,inverse-polarity;
		linux,default-trigger = "backlight";
	};

	led@0xc7 {
		dlg,led-gpio-reg = <0x1c 0x0f>;
		dlg,led-reg = <0xc7>;
		linux,default-trigger = "heartbeat";
	};

	led@0xc8 {
		dlg,led-gpio-reg = <0x1c 0xf0>;
		dlg,led-reg = <0xc8>;
		linux,default-trigger = "heartbeat";
	};
};
```

## Documentation/devicetree/bindings/leds/leds-mca.txt
```
Digi ConnectCore SOMs Micro Controller Assist LEDs controller

Required properties:
  - compatible: 	must be "digi,mca-led"
  - #address-cells:	must be 1.
  - #size-cells:	must be 0.

Each LED is represented as a sub-node of the mca_led device.

LED sub-node required properties:
  - reg:	index of the MCA LED controller.
  - io:		MCA IO the LED is connected to.

LED sub-node optional properties:
  - label:		    see Documentation/devicetree/bindings/leds/common.txt
  - active-low:		    Boolean, makes LED active low.
  - linux,default-trigger:  see Documentation/devicetree/bindings/leds/common.txt
  - led-pattern:	    see Documentation/devicetree/bindings/leds/common.txt
  - retain-state-suspended: The LED retains configured functionality during suspend.
			    Only applies to some triggers like default-on, timer.
  - retain-state-shutdown:  Retain the state of the LED on shutdown.
  - panic-indicator: 	    see Documentation/devicetree/bindings/leds/common.txt

Examples:
mca_led: led {
	compatible = "digi,mca-led";
	#address-cells = <1>;
	#size-cells = <0>;

	led0: led@0 {
		reg = <0>;
		label = "power:green";
		io = <13>;
		linux,default-trigger = "default-on";
	};

	led1: led@1 {
		reg = <1>;
		label = "USER_LED1:green";
		io = <12>;
		/* Configure it to blink at boot as an example */
		linux,default-trigger = "timer";
		led-pattern = <100>, <1000>;
		retain-state-suspended;
	};

	led2: led@2 {
		reg = <2>;
		label = "USER_LED2:orange";
		io = <18>;
		/* Configure it to blink at boot as an example */
		linux,default-trigger = "timer";
		led-pattern = <5000>, <5000>;
		retain-state-suspended;
	};
};
```

## Documentation/devicetree/bindings/media/i2c/galaxycore,gc2145.yaml
```yaml
# SPDX-License-Identifier: (GPL-2.0-only OR BSD-2-Clause)
%YAML 1.2
---
$id: http://devicetree.org/schemas/media/i2c/galaxycore,gc2145.yaml#
$schema: http://devicetree.org/meta-schemas/core.yaml#

title: Galaxy Core 1/5'' UXGA CMOS Image Sensor

maintainers:
  - Alain Volmat <alain.volmat@foss.st.com>

description: |
  The Galaxy Core GC2145 is a high quality 2 Mega CMOS image sensor, for mobile phone camera
  applications and digital camera products. GC2145 incorporates a 1616V x 1232H active pixel
  array, on-chip 10-bit ADC, and image signal processor. It is programmable through an I2C
  interface. Image data is sent either through a parallel interface or through MIPI CSI-2.

allOf:
  - $ref: ../video-interface-devices.yaml#

properties:
  compatible:
    const: galaxycore,gc2145

  reg:
    enum:
      - 0x3c

  clocks:
    description: Reference to the xclk clock.
    maxItems: 1

  powerdown-gpios:
    description: GPIO descriptor for the powerdown pin.
    maxItems: 1

  reset-gpios:
    description: GPIO descriptor for the reset pin.
    maxItems: 1

  IOVDD-supply:
    description: Power Supply for I/O circuits (1.7 - 3V).

  AVDD-supply:
    description: Power for analog circuit/sensor array (2.7 - 3V).

  DVDD-supply:
    description: Power for digital core (1.7 - 1.9V).

  port:
    $ref: /schemas/graph.yaml#/$defs/port-base
    description: |
      Video output port.

    properties:
      endpoint:
        $ref: /schemas/media/video-interfaces.yaml#
        unevaluatedProperties: false

        properties:
          data-lanes:
            anyOf:
              - items:
                  - const: 1
                  - const: 2
              - items:
                  - const: 1
                  - const: 2

        required:
          - data-lanes

    additionalProperties: false

required:
  - compatible
  - reg
  - clocks
  - powerdown-gpios
  - reset-gpios
  - IOVDD-supply
  - AVDD-supply
  - DVDD-supply
  - port

additionalProperties: false

examples:
  - |
    #include <dt-bindings/gpio/gpio.h>

    i2c5 {
        #address-cells = <1>;
        #size-cells = <0>;

        gc2145@3c {
            compatible = "galaxycore,gc2145";
            reg = <0x3c>;
            clocks = <&clk_ext_camera>;
            IOVDD-supply = <&scmi_v3v3_sw>;
            AVDD-supply = <&scmi_v3v3_sw>;
            DVDD-supply = <&scmi_v3v3_sw>;
            powerdown-gpios = <&mcp23017 3 (GPIO_ACTIVE_LOW | GPIO_PUSH_PULL)>;
            reset-gpios = <&mcp23017 4 (GPIO_ACTIVE_LOW | GPIO_PUSH_PULL)>;

            port {
                gc2145_ep: endpoint {
                    remote-endpoint = <&mipid02_0>;
                    data-lanes = <1 2>;
                };
            };
        };
    };

...
```

## Documentation/devicetree/bindings/media/i2c/ov5642.txt
```
* Omnivision OV5642 CSI sensor

Required Properties:
- compatible: should be "ov564x"
- clocks: reference to the xclk input clock.
- clock-names: should be "xclk".
- DOVDD-supply: Digital I/O voltage supply, 1.8 volts
- AVDD-supply: Analog voltage supply, 2.8 volts
- DVDD-supply: Digital core voltage supply, 1.5 volts
- csi_id: csi id for v4l2 capture device

Optional Properties:
- pwn-gpios: set according to the board.
- rst-gpios: set according to the board.
- digi,defer-probe: Voluntarily defer probe to give other camera sensors
  the chance to probe first and if using digi,alt-pwn-gpios place this one
  in power down so that they can reconfigure its i2c slave address (in case
  of i2c slave address clash)

The device node must contain one 'port' child node for its digital output
video port, in accordance with the video interface bindings defined in
Documentation/devicetree/bindings/media/video-interfaces.txt.

Example:

&i2c1 {
	ov5642: ov5642@3c {
		compatible = "ov564x";
		reg = <0x3c>;
		pinctrl-names = "default";
		pinctrl-0 = <&pinctrl_csi>;
		clocks = <&clks IMX6UL_CLK_CSI>;
		clock-names = "csi_mclk";
		csi_id = <0>;
		mclk = <24000000>;
		mclk_source = <0>;
		status = "disabled";
		digi,defer-probe;
		port {
			ov5642_ep: endpoint {
				remote-endpoint = <&csi_ep>;
			};
		};
	};
};
```
