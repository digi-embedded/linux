## Documentation/devicetree/bindings/iio/adc/digi,mca-adc.txt
```
* Digi MCA ADCs of ConnectCore SOMs device tree bindings

The MCA ADC driver allows to read voltages from the MCA IOs that are ADC
capable. Check the MCA ADC-capable IOs on the specific ConnectCore SOM Hardware
Reference Manual.

Also, the ADC inputs can be configured as analog comparators. In this mode the
input is sampled periodically and an interrupt is generated based on the
comparison of the value with two thresholds. See the documentation for more
information on this feature.

Required properties:
- compatible : must be one of
    - "digi,mca-cc6ul-adc", for the ConnectCore 6UL internal MCA
    - "digi,mca-ioexp-adc", for the ConnectCore 6UL SBC Pro I/O Expander chip
    - "digi,mca-cc8x-adc", for the ConnectCore 8X internal MCA

Optional properties:
- digi,adc-ch-list: list of MCA IOs to be enabled as ADCs
- digi,comparator-ch-list: list of MCA IOs to be enabled as Analog Comparators
- digi,adc-vref: ADC reference voltage in uV, corresponds with the VCC_MCA
  voltage.
- digi,internal-vref:
  If this property is set:
     - Internal 1.2 V reference will be used.
     - The value in 'digi,adc-vref' will be ignored.
     - On the ConnectCore 8X version 1 this functionality is not available.
       Later versions of ConnectCore 8X have this functionality available and
       will force EXT_VREF pin to be configured as a 1.2 V output.
     - On the ConnectCore 6UL, this will force MCA_IO2/EXT_VREF pin to be
       configured as a 1.2 V output and a 100 nF capacitor must be placed between
       MCA_IO2/EXT_VREF line and GND for it to work properly.

Example:

	&mca_adc {
		digi,adc-ch-list = <0 4>;
		digi,comparator-ch-list = <3>;
		digi,adc-vref = <3000000>;
	};
```

## Documentation/devicetree/bindings/iio/adc/digi,mca-cc6ul-adc.txt
```
* Digi MCA ADCs of ConnectCore 6UL device tree bindings

The MCA ADC driver allows to read voltages from the MCA IOs that are ADC
capable. Check the MCA ADC-capable IOs on the CC6UL Hardware Reference Manual.

Also, the ADC inputs can be configured as analog comparators. In this mode the
input is sampled periodically and an interrupt is generated based on the
comparison of the value with two thresholds. See the documentation for more
information on this feature.

Required properties:
- compatible: must be "digi,mca-cc6ul-adc".

Optional properties:
- digi,adc-ch-list: list of MCA IOs to be enabled as ADCs
- digi,comparator-ch-list: list of MCA IOs to be enabled as Analog Comparators
- digi,adc-vref: ADC reference voltage in uV, corresponds with the VCC_MCA
  voltage.
- digi,internal-vref: if present, the internal 1.2 V reference will be used.
  This will force MCA_IO2/EXT_VREF to be configured as a 1.2 V output, and a
  100 nF capacitor must be placed between this line and GND for it to work
  properly.
  If this property is set, the value in 'digi,adc-vref' will be ignored.

Example:

	&mca_adc {
		digi,adc-ch-list = <0 4>;
		digi,comparator-ch-list = <3>;
		digi,adc-vref = <3000000>;
	};
```

## Documentation/devicetree/bindings/iio/adc/digi,mca-ioexp-adc.txt
```
* Digi I/O Expander ADCs device tree bindings

The Digi I/O Expander ADC driver allows to read voltages from the MCA IOs that
are ADC capable. Check the I/O Expander ADC-capable IOs on the CC6UL Hardware
Reference Manual.

Required properties:
- compatible: must be "digi,mca-ioexp-adc".

Optional properties:
- adc-ch-list: list of I/O Expander IOs to be enabled as ADCs
- adc-vref: ADC reference voltage in uV.

Example:

	&mca_ioexp_adc {
		digi,adc-ch-list = <0 4>;
		digi,adc-vref = <3000000>;
	};
```

## Documentation/devicetree/bindings/iio/adc/imx8qxp-adc.txt
```
Freescale imx8qxp ADC bindings

The devicetree bindings are for the ADC driver written for imx8qxp SoC.

Required properties:
- compatible: Should contain "fsl,imx8qxp-adc"
- reg: Offset and length of the register set for the ADC device
- interrupt-parent : Core interrupt controller
- interrupts: The interrupt number for the ADC device
- clocks : phandle + clock specifier pairs, one for each entry in clock-names
- clock-names : Should contain: "ipg" - the ADC peripheral register accessing
  clock source, if "per" clock missing, the "ipg" clock also is the ADC module
  clock.
- vref-supply: The regulator supply ADC reference voltage.
- digi,max-channel: Value of the highest adc channel number that is valid in
                    'digi,adc-ch-list' (0 - max-channel). This value is platform
                    specific.
- digi,adc-ch-list: List of channels that will be enabled.

Recommended properties:
- clock-names : "per" - the ADC module clock.

Example:
adc0: adc@5a880000 {
	compatible = "fsl,imx8qxp-adc";
	reg = <0x0 0x5a880000 0x0 0x10000>;
	interrupts = <GIC_SPI 240 IRQ_TYPE_LEVEL_HIGH>;
	interrupt-parent = <&gic>;
	clocks = <&clk IMX8QXP_ADC0_CLK>,
		 <&clk IMX8QXP_ADC0_IPG_CLK>;
	clock-names = "per", "ipg";
	assigned-clocks = <&clk IMX8QXP_ADC0_CLK>;
	assigned-clock-rates = <24000000>;
	power-domains = <&pd_dma_adc0>;
	digi,max-channel = <5>;
	digi,adc-ch-list = <0 2 4 5>;
};
```

## Documentation/devicetree/bindings/iio/adc/st,stm32-mdf-adc.yaml
```yaml
# SPDX-License-Identifier: (GPL-2.0-only OR BSD-2-Clause)
%YAML 1.2
---
$id: http://devicetree.org/schemas/iio/adc/st,stm32-mdf-adc.yaml#
$schema: http://devicetree.org/meta-schemas/core.yaml#

title: STMicroelectronics STM32 Multi-function Digital Filter (MDF) ADC

maintainers:
  - Olivier Moysan <olivier.moysan@foss.st.com>

description: |
  STM32 MDF ADC is a sigma delta analog-to-digital converter dedicated to
  interface external sigma delta modulators to STM32 micro controllers.

properties:
  compatible:
    enum:
      - st,stm32mp25-mdf

  reg:
    minItems: 1
    maxItems: 2

  clocks:
    maxItems: 1

  clock-names:
    description: Internal clock used for MDF digital processing.
    items:
      - const: ker_ck

  "#clock-cells":
    const: 1

  clock-indices:
    minItems: 1
    maxItems: 2

  clock-output-names:
    description: |
      CCK0 and CCK1 are optional output clocks, which share the same clock frequency,
      but can be gated independently to save power.
    items:
      - const: cck0
      - const: cck1

  st,cck-freq-hz:
    description: |
      CCK0/1 clock out frequency (Hz).
      The frequency must be a multiple of the "ker_ck" clock frequency.
    maximum: 25000000

  "#address-cells":
    const: 1

  "#size-cells":
    const: 1

  ranges: true

  clock-ranges: true

required:
  - compatible
  - reg
  - ranges
  - clocks
  - clock-names
  - clock-ranges
  - "#address-cells"
  - "#size-cells"

additionalProperties: false

patternProperties:
  "^sitf@[0-9]+$":
    type: object
    description: Serial interface child node

    properties:
      reg:
        description: Specify the SITF serial interface instance
        maxItems: 1

      clocks:
        description: |
          Serial interface clock (optional depending on interface mode)
        maxItems: 1

      st,sitf-mode:
        description: |
          Select serial interface protocol
          - spi: SPI mode
        $ref: "/schemas/types.yaml#/definitions/string"
        enum:
          - spi

        required:
          - reg
          - st,sitf-mode

    additionalProperties: false

  "^filter@[0-9]+$":
    type: object
    description: Digital filter path child node

    properties:
      compatible:
        enum:
          - st,stm32mp25-mdf-dmic

      reg:
        description: Specify the MDF filter instance
        maxItems: 1

      interrupts:
        maxItems: 1

      clocks:
        minItems: 1
        description: Internal clock used for MDF digital processing and control blocks.

      clock-names:
        items:
          - const: ker_ck

      dmas:
        maxItems: 1

      dma-names:
        items:
          - const: rx

      "#io-channel-cells":
        const: 1

      st,cic-mode:
        description: |
          Cascaded-integrator-comb (CIC) filter configuration
          - 0: MCIC & ACIC filters in FastSinc mode
          - [1-3]: MCIC & ACIC filters in Sinc mode order 1 to 3
          - [4-5]: Single CIC filter in Sinc mode order 4 to 5
          For audio purpose it is recommended to use CIC Sinc4 or Sinc5
        $ref: /schemas/types.yaml#/definitions/uint32
        minimum: 0
        maximum: 5

      st,sitf-indexes:
        description: Index of the serial interface connected to the digital filter
        $ref: /schemas/types.yaml#/definitions/uint32
        minimum: 0
        maximum: 7

      st,sitf-streams:
        description: |
          Select the bitstream on the falling or rising edge of the serial interface clock
          - 0: rising edge
          - 1: falling edge
        $ref: /schemas/types.yaml#/definitions/uint32
        enum: [0, 1]

    required:
      - compatible
      - reg
      - interrupts
      - "#io-channel-cells"
      - st,cic-mode
      - st,sitf-indexes
      - st,sitf-streams

    patternProperties:
      "^mdf-dai+$":
        type: object
        description: child node

        properties:
          compatible:
            enum:
              - st,stm32mp25-mdf-dai

          "#sound-dai-cells":
            const: 0

          io-channels:
            description:
              From common IIO binding. Used to pipe external sigma delta
              modulator or internal ADC output to MDF channel.

        required:
          - compatible
          - "#sound-dai-cells"
          - io-channels

    additionalProperties: false

examples:
  - |
    #include <dt-bindings/clock/stm32mp25-clks.h>
    #include <dt-bindings/interrupt-controller/arm-gic.h>
    mdf1: mdf@504d0000 {
      compatible = "st,stm32mp25-mdf";
      ranges = <0 0x504d0000 0x1000>;
      reg = <0x504d0000 0x8>, <0x504d0ff0 0x10>;
      #address-cells = <1>;
      #size-cells = <1>;
      clocks = <&rcc CK_KER_MDF1>;
      clock-names = "ker_ck";
      clock-ranges;
      #clock-cells = <1>;
      clock-indices = <0>, <1>;
      clock-output-names = "cck0", "cck1";
      st,cck-freq-hz = <2048000>;

      sitf5: sitf@300 {
        reg = <0x300 0x4>;
        st,sitf-mode = "spi";
        clocks = <&mdf1 0>;
      };

      filter0: filter@84 {
        compatible = "st,stm32mp25-mdf-dmic";
        reg = <0x84 0x70>;
        #io-channel-cells = <1>;
        interrupts = <GIC_SPI 184 IRQ_TYPE_LEVEL_HIGH>;
        dmas = <&hpdma 63 0x63 0x12 0>;
        dma-names = "rx";
        st,cic-mode	= <5>;
        st,sitf-indexes = <5>;
        st,sitf-streams = <0>;

        asoc_pdm0: mdf-dai {
          compatible = "st,stm32mp25-mdf-dai";
          #sound-dai-cells = <0>;
          io-channels = <&filter0 0>;
        };
      };
    };

...
```

## Documentation/devicetree/bindings/iio/tamper/digi,mca-cc6ul-tamper.txt
```
* Digi ConnectCore 6UL Micro Controller Assist tamper support

The MCA Tamper driver allows to detect tamper events.

Required properties:
- compatible: must be "digi,mca-cc6ul-tamper".

Optional properties:
- tamper-if-list: list of enabled tamper interfaces. Interfaces 0 and 1 are for
		  digital signals while 2 and 3 are for analog comparison. Refer
		  to the documentation for more information on how to use these
		  features.

Example:

	&mca_tamper {
		digi,tamper-if-list = <0 1 2 3>;
	};
```

## Documentation/devicetree/bindings/iio/tamper/digi,mca-tamper.txt
```
* Digi ConnectCore SOMs Micro Controller Assist tamper support

The MCA Tamper driver allows to detect tamper events.

Required properties:
- compatible: must be "digi,mca-tamper".

Optional properties:
- tamper-if-list: list of enabled tamper interfaces. Interfaces 0 and 1 are for
		  digital signals while 2 and 3 are for analog comparison. Refer
		  to the documentation for more information on how to use these
		  features.

Example:

	mca_cc6ul: mca@7e {
		mca_tamper: tamper {
			compatible = "digi,mca-tamper";
			digi,tamper-if-list = <0 1 2 3>;
		};
	};

	mca_cc8x: mca@63 {
		mca_tamper: tamper {
			compatible = "digi,mca-tamper";
			digi,tamper-if-list = <0 1 2 3>;
		};
	};

	mca_cc8m: mca@63 {
		mca_tamper: tamper {
			compatible = "digi,mca-tamper";
			digi,tamper-if-list = <0 1 2 3>;
		};
	};
```

## Documentation/devicetree/bindings/input/da9063-onkey.txt
```
* Dialog's onkey device tree bindings

The da9063 onkey driver allow for the user space handling of power events
like suspend to RAM or poweroff.

Required properties:

- compatible: Must be "dlg,da9063-onkey".
- interrupts: Local Da9063 interrupt line.
- interrupt-name: Local DA9063 interrupt line name.

Optional properties:
- dlg,key-power: Indicates the power key is enabled in OTP.

Example:

	onkey {
		compatible = "dlg,da9063-onkey";
		interrupts = <0>;
		interrupts-names = "ONKEY";
		interrupt-parent = <&pmic_dialog>;
		dlg,key-power;
	};
```

## Documentation/devicetree/bindings/input/digi,mca-cc6ul-powerkey.txt
```
* Digi Power Key for MCA of ConnectCore 6UL device tree bindings

The MCA Power key driver enables the POWER Key function on the ConnectCore 6UL
embedded module.

The Power Key is used to:
 - Power ON the system, from the OFF state.
 - Suspend the system.
 - Resume from suspend state.
 - Power OFF the system.

When enabled, the driver can generate two type of Key events (KEY_POWER and
KEY_SLEEP).
The event generated by the driver depends on the duration of the "key press"
(time that the POWER_ON input is at low level).
There is a debounce filter that can be used to filter undesired rebounds when
using a power button.

Long press
 If the duration exceeds the configured "Delay" time, the driver will trigger a
 KEY_POWER event to start the Power OFF of the device.
 After a configurable "Guard" time, if linux has not sent the Power Off command
 to the MCA it will automatically perform the Power OFF of the system.

Short press
 If the duration of the key press is shorter than the configured "Delay" time,
 the driver will generate a KEY_SLEEP event when the key is released.
 This should be used by the OS to set the system in suspend state.

When the system is in suspend state or in Power OFF, pressing the Power Key will
wakeup the system.

Required properties:
- compatible: must be "digi,mca-cc6ul-pwrkey".

Optional properties:
- key-power: enable the KEY_POWER events
- key-sleep: enable the KEY_SLEEP events
- debounce-ms (0-255): debounce filter in ms. Number of ms that the input/Key
                       must be stable (low level) in order to be considered
                       valid.
- pwroff-delay-sec (0-255): number of seconds that the Power Key must be pressed
                            to generate a KEY_POWER event.
- pwroff-guard-sec (0-255): time that the MCA will wait for the OS to power off
                            the system. After that the MCA will switch it off.

Example:
	mca: mca-cc6ul@7e {
		pwrkey {
			compatible = "digi,mca-cc6ul-pwrkey";
			digi,key-power;
			digi,key-sleep;
			digi,debounce-ms = <100>;
			digi,pwroff-delay-sec = <6>;
			digi,pwroff-guard-sec = <30>;
		};
	};
```
